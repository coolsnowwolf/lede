## package/lean/mt/drivers/mt7612e/config.in
```kconfig
if PACKAGE_kmod-mt76x2e

config MT76X2E_RT_SECOND_IF_MT7612E
	bool
	default y

config MT76X2E_RT_FIRST_CARD
	int
	default 7603

config MT76X2E_RT_SECOND_CARD
	int
	default 7612

config MT76X2E_AP_LED
	bool
	default y

config MT76X2E_AP_LLTD
	bool
	default y

config MT76X2E_AP_WDS
	bool
	default y

config MT76X2E_AP_MBSS
	bool
	default y

config MT76X2E_AP_MBSS_NEW_MBSSID_MODE
	bool
	default y

config MT76X2E_AP_APCLI
	bool
	default y

config MT76X2E_AP_80211AC_VHT
	bool
        default y

config MT76X2E_AP_TXBF_SUPPORT
	bool
        default n


endif
```

## package/lean/mt/drivers/mt7612e/src/mt76x2_ap/Kconfig
```kconfig
config MT76X2_AP
	tristate "MediaTek MT7620/MT7602E/7612E 802.11 AP driver"
	select WIRELESS_EXT
	select WEXT_SPY
	select WEXT_PRIV

config  MT76X2_AP_LED
	bool "LED support"
	depends on MT76X2_AP
	default y

config  MT76X2_AP_LED_SOFT
	bool "Soft LED support"
	depends on MT76X2_AP && !MT76X2_AP_LED && RALINK_GPIO_LED
	default n

config  MT76X2_AP_LED_SOFT_GPIO
	int "Soft LED GPIO pin (dev #0)"
	depends on MT76X2_AP
	depends on MT76X2_AP_LED_SOFT
	default -1

config  MT76X2_AP_LED_SOFT_GPIO_DEV1
	int "Soft LED GPIO pin (dev #1)"
	depends on MT76X2_AP
	depends on MT76X2_AP_LED_SOFT
	depends on (RT_FIRST_IF_MT7602E || RT_FIRST_IF_MT7612E || RT_FIRST_IF_MT7620) && (RT_SECOND_IF_MT7602E || RT_SECOND_IF_MT7612E)
	default -1

config  MT76X2_AP_LLTD
	bool "LLTD (Link Layer Topology Discovery Protocol)"
	depends on MT76X2_AP
	default y

config  MT76X2_AP_WDS
	bool "WDS support"
	depends on MT76X2_AP
	default y

config  MT76X2_AP_MBSS
	bool "MBSSID support"
	depends on MT76X2_AP
	default y

config  MT76X2_AP_MBSS_NEW_MBSSID_MODE
	bool "New MBSSID mode support"
	depends on MT76X2_AP
	depends on MT76X2_AP_MBSS
	default n

config  MT76X2_AP_APCLI
	bool "AP-Client support"
	depends on MT76X2_AP
	default y

config  MT76X2_AP_APCLI_CERT
	bool "AP-Client TGn Cert support"
	depends on MT76X2_AP
	depends on MT76X2_AP_APCLI
	default n

config  MT76X2_AP_APCLI_AUTO_BW
	bool "AP-Client Auto Bandwidth Support"
	depends on MT76X2_AP
	depends on MT76X2_AP_APCLI
	default n

config  MT76X2_AP_MAC_REPEATER
	bool "MAC Repeater Mode support"
	depends on MT76X2_AP
	depends on MT76X2_AP_APCLI
	default n

config  MT76X2_AP_MWDS
	bool "Wireless Mixed Bridge Mode (MWDS)"
	depends on MT76X2_AP
	select MT76X2_AP_APCLI
	default n

config  MT76X2_AP_SMART_MESH
	bool "Smart Mesh"
	depends on MT76X2_AP
	select MT76X2_AP_MWDS
	default n

config  MT76X2_AP_CON_WPS
	bool "Concurrent WPS support"
	depends on MT76X2_AP
	depends on MT76X2_AP_APCLI
	depends on RT_WSC_V2
	default n

config  MT76X2_AP_AIRPLAY
	bool "AirPlay support"
	depends on MT76X2_AP
	default n

config  MT76X2_AP_DFS
	bool "DFS support"
	depends on MT76X2_AP
	default n

config  MT76X2_AP_CARRIER
	bool "Carrier Detection support"
	depends on MT76X2_AP
	default n

config  MT76X2_AP_GREENAP
	bool "Green AP mode support"
	depends on MT76X2_AP
	depends on RT_FIRST_IF_MT7620

config  MT76X2_AP_IDS
	bool "IDS (Intrusion Detection System) support"
	depends on MT76X2_AP
	default n

config  MT76X2_AP_DLS
	bool "802.11e DLS (Direct-Link Setup) support"
	depends on MT76X2_AP
	default n

config  MT76X2_AP_80211AC_VHT
	bool "802.11ac support"
	depends on MT76X2_AP
	depends on (RT_FIRST_IF_MT7612E || RT_SECOND_IF_MT7612E)
	default y

config  MT76X2_AP_TXBF_SUPPORT
	bool "Tx Beam Forming support"
	depends on MT76X2_AP
	depends on (RT_FIRST_IF_MT7612E || RT_SECOND_IF_MT7612E)
	default n

choice
	prompt "MT7620 Power Design"
	depends on MT76X2_AP
	depends on RT_FIRST_IF_MT7620
	default MT76X2_AP_INTERNAL_PA_INTERNAL_LNA
config MT76X2_AP_INTERNAL_PA_INTERNAL_LNA
	bool "Internal PA & Internal LNA"
config MT76X2_AP_INTERNAL_PA_EXTERNAL_LNA
	bool "Internal PA & External LNA"
config MT76X2_AP_EXTERNAL_PA_EXTERNAL_LNA
	bool "External PA & External LNA"
endchoice

config  MT76X2_AP_RTMP_INTERNAL_TX_ALC
	bool "MT7620 TSSI Compensation (Internal TX ALC)"
	depends on MT76X2_AP
	depends on RT_FIRST_IF_MT7620
	depends on !MT76X2_AP_EXTERNAL_PA_EXTERNAL_LNA
	default n

config  MT76X2_AP_RTMP_TEMPERATURE_COMPENSATION
	bool "MT7620 Temperature Compensation (External TX ALC)"
	depends on MT76X2_AP
	depends on RT_FIRST_IF_MT7620
	default n

config  MT76X2_AP_ADJ_PWR_CONSUMPTION
	bool "MT7620 Reduce Power Consumption"
	depends on MT76X2_AP
	depends on RT_FIRST_IF_MT7620
	default n

config RT_READ_MAC_FROM_MTD
    bool "Read and set MAC address from MTD/EEPROM"
	depends on (RT_FIRST_IF_MT7615E && RT_SECOND_IF_MT7612E)
	default y
```
