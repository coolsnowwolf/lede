## package/lean/mt/drivers/mt7603e/src/mt7603_wifi/Kconfig.mt_wifi
```kconfig
if FIRST_IF_MT7603E || SECOND_IF_MT7603E
config MT_WIFI
	tristate "MT WIFI Driver"

config MT_WIFI_PATH
        string
        depends on MT_WIFI
        default "mt_wifi"

if MT_WIFI
menu "WiFi Generic Feature Options"

if FIRST_IF_MT7603E
choice
        prompt "EEPROM Type of 1st Card"
        depends on ! FIRST_IF_NONE

        config FIRST_MT_IF_EEPROM_PROM
        bool "EEPROM"

        config FIRST_MT_IF_EEPROM_EFUSE
        bool "EFUSE"

        config FIRST_MT_IF_EEPROM_FLASH
        bool "FLASH"
endchoice

config RT_FIRST_CARD_EEPROM
        string
        depends on ! FIRST_IF_NONE
        default "prom" if FIRST_MT_IF_EEPROM_PROM
        default "efuse" if FIRST_MT_IF_EEPROM_EFUSE
        default "flash" if FIRST_MT_IF_EEPROM_FLASH
endif
# endif FIRST_IF_MT7603E

if SECOND_IF_MT7603E
choice
        prompt "EEPROM Type of 2nd Card"
        depends on ! SECOND_IF_NONE

        config SECOND_MT_IF_EEPROM_PROM
        bool "EEPROM"

        config SECOND_MT_IF_EEPROM_EFUSE
        bool "EFUSE"

        config SECOND_MT_IF_EEPROM_FLASH
        bool "FLASH"
endchoice

config RT_SECOND_CARD_EEPROM
        string
        depends on ! SECOND_IF_NONE
        default "prom" if SECOND_MT_IF_EEPROM_PROM
        default "efuse" if SECOND_MT_IF_EEPROM_EFUSE
        default "flash" if SECOND_MT_IF_EEPROM_FLASH
endif
#endif SECOND_IF_MT7603E

config MULTI_INF_SUPPORT
        bool
        default y if !FIRST_IF_NONE && !SECOND_IF_NONE

#config WIFI_BASIC_FUNC
#	bool "Basic Functions"
#	select WIRELESS_EXT
#	select WEXT_SPY
#	select WEXT_PRIV
        
config MT_WSC_INCLUDED
	bool "WSC (WiFi Simple Config)"
	depends on WIFI_DRIVER
    default y

config MT_WSC_V2_SUPPORT
	bool "WSC V2(WiFi Simple Config Version 2.0)"
	depends on MT_WSC_INCLUDED
    default y

config MT_DOT11N_DRAFT3
	bool "802.11n Draft3"
	depends on WIFI_DRIVER
    default y
    
config MT_DOT11_VHT_AC
	bool "802.11 ac"
	depends on WIFI_DRIVER
    default n

config WSC_NFC_SUPPORT
	bool "WSC out-of-band(NFC)"
        depends on WIFI_DRIVER
    	default n
	    
config MT_DOT11W_PMF_SUPPORT
	bool "PMF Support"
	depends on WIFI_DRIVER
    default y

config MT_TXBF_SUPPORT
    bool "Tx Bean Forming Support"
    depends on WIFI_DRIVER
    default n

#config MT_WMM_ACM_SUPPORT
#	bool "WMM ACM"
#	depends on WIFI_DRIVER
#   default n
	
config MT_LLTD_SUPPORT
	bool "LLTD (Link Layer Topology Discovery Protocol)"
	depends on WIFI_DRIVER
    default y

config MT_QOS_DLS_SUPPORT
	bool "802.11e DLS ((Direct-Link Setup) Support"
	depends on WIFI_DRIVER
    default n

config MT_WAPI_SUPPORT
	bool "WAPI Support"
	depends on WIFI_DRIVER
    default y

config MT_CARRIER_DETECTION_SUPPORT
	bool "Carrier Detect"
	depends on WIFI_DRIVER
    default n
	
config MT7603E_MBO_SUPPORT
	bool "MBO Support"
	depends on WIFI_DRIVER
	select INTERWORKING
	select WNM_SUPPORT
	select DOT11K_RRM_SUPPORT
	select DOT11R_FT_SUPPORT
	select DOT11W_PMF_SUPPORT
	select PASSPOINT_R2
	default n
	
config MT_IGMP_SNOOP_SUPPORT
	bool "IGMP Snooping"
	depends on WIFI_DRIVER
    default n

config MT_BLOCK_NET_IF
	bool "NETIF Block"
	depends on WIFI_DRIVER
    default n
	help
	Support Net interface block while Tx-Sw queue full

config MT_DMA_CACHE_OPTIMIZE
	bool "optimize dma cache mapping for internal mips platform"
	depends on WIFI_DRIVER
	default n
	
#config MT_TXBF_SUPPORT
#    bool "Tx Bean Forming Support (Only 3883)"
#    depends on WIFI_DRIVER
#    depends on RALINK_RT2883 || RALINK_RT3883
#    default n

#config MT_VIDEO_TURBINE_SUPPORT
#	bool "Video Turbine support"
#	depends on WIFI_DRIVER
#   default n

#config MT_RA_CLASSIFIER
#	tristate "Ralink Flow Classifier"
#	depends on WIFI_DRIVER
#	default n

config MT_RATE_ADAPTION
    bool "New Rate Adaptation support"
    depends on WIFI_DRIVER
    default y

config MT_NEW_RATE_ADAPT_SUPPORT
    bool "Intelligent Rate Adaption"
    depends on WIFI_DRIVER && MT_RATE_ADAPTION
    default y

config MT_AGS_SUPPORT
	bool "Adaptive Group Switching"
	depends on WIFI_DRIVER && MT_RATE_ADAPTION
    default n
    
config MT_IDS_SUPPORT
	bool "IDS (Intrusion Detection System) Support"
	depends on WIFI_DRIVER
    default n

config MT_WIFI_WORK_QUEUE
	bool "Work Queue"
	depends on WIFI_DRIVER
    default n

config MT_WIFI_SKB_RECYCLE
    bool "SKB Recycle(Linux)"
    depends on WIFI_DRIVER
    default n

config MT_RTMP_FLASH_SUPPORT
	bool "Flash Support"
	depends on WIFI_DRIVER
    default n

config CONFIG_PUSH_SUPPORT
    bool "Config Push Support"
    depends on WIFI_DRIVER
    default y
config CONFIG_EASY_SETUP_SUPPORT
    bool "Whole Home Coverage - Easy Setup"
    depends on WIFI_DRIVER
    default n

config EVENT_NOTIFIER_SUPPORT
    bool "Whole Home Coverage - Event Notifier"
    depends on WIFI_DRIVER
    default n
config MWDS_SUPPORT
    bool "Mixed WDS(MWDS)"
    default y
config AIR_MONITOR_SUPPORT
	bool "Air Monitor Support"
	depends on WIFI_DRIVER
    default y

config STA_FORCE_ROAM_SUPPORT
	bool "Sta Force Roam Support"
	depends on WIFI_DRIVER
    default y

config ROAMING_ENHANCE_SUPPORT
	bool "Roaming Enhance Support"
	depends on WIFI_DRIVER
    default y

config WIFI_FWD_UPDATED
	bool "Wifi Forwarding Support Update"
	depends on WIFI_DRIVER
    default n

config MT_BTCOEX_CONCURRENT
    bool "Coexisence Event Notify between BT and WiFi"
    depends on WIFI_DRIVER
    default n

config MT_LED_CONTROL_SUPPORT
	bool "LED Support"
	depends on WIFI_DRIVER
    default n

config MT_SINGLE_SKU_V2
    bool "Single SKU V2"
    depends on WIFI_DRIVER
    default n

config MT_HW_ANTENNA_DIVERSITY
	bool "Antenna Diversity Support"
	depends on RLT_AP_SUPPORT || RLT_STA_SUPPORT
	depends on RALINK_RT5350
    default n

config MT_ATE_SUPPORT
	bool "ATE/QA Support"
	depends on WIFI_DRIVER
    default y

config MT_RT2860V2_AP_V24_DATA_STRUCTURE
	bool
	depends on WIFI_DRIVER
	default y

config  MT_RT2860V2_AP_32B_DESC
	bool "32 Byte Descriptor Support"
	depends on WIFI_DRIVER
	depends on RALINK_RT6352 || RALINK_MT7620
	default n

config MT_MEMORY_OPTIMIZATION
	bool "Memory Optimization"
	depends on WIFI_DRIVER
    default n

#config MT_RTMP_INTERNAL_TX_ALC
#    bool "TSSI Compensation"
#    depends on WIFI_DRIVER
#    depends on RALINK_RT3350 || RALINK_RT3352 || RALINK_RT5350 || RALINK_RT6352
#	default n
    
#config MT_RTMP_TEMPERATURE_CALIBRATION
#    bool "Temperature Calibration"
#    depends on WIFI_DRIVER
#    depends on RALINK_RT6352
#    default n

config MT_HOTSPOT
	bool "Passpoint-R1"
	depends on WIFI_DRIVER
    default n

config MT_HOTSPOT_R2
	bool "Passpoint Release-2 Support"
	depends on HOTSPOT
	select MT_DOT11W_PMF_SUPPORT
	default n

config MT_UAPSD
	bool "UAPSD support"
	depends on WIFI_DRIVER
	default y

#config MT_EPA_ELNA
#	bool "ePAeLNA"
#	depends on WIFI_DRIVER
#	default n

choice
        prompt "PA,LNA Type"
        depends on MT_WIFI

        config MT_IPA_ILNA
        bool "iPAiLNA"

        config MT_IPA_ELNA
        bool "iPAeLNA"

        config MT_EPA_ILNA
        bool "ePAiLNA"
        
        config MT_EPA_ELNA
        bool "ePAeLNA"
endchoice

config MT_PA_LNA
        string
        depends on MT_WIFI
        default "iPAiLNA" if MT_IPA_ILNA
        default "iPAeLNA" if MT_IPA_ELNA
        default "ePAiLNA" if MT_EPA_ILNA
        default "ePAeLNA" if MT_EPA_ELNA

#
# Section for chip architectures
#
# "RLT MAC Support"
config RLT_MAC
	bool
	depends on WIFI_DRIVER
	default n

config RLT_BBP
	bool

config RLT_RF
	bool

# "RTMP MAC Support"
config RTMP_MAC
	bool
	depends on WIFI_DRIVER
	default n

config RTMP_BBP
    	bool

config RTMP_RF
    	bool

#
# Section for interfaces
#
config RTMP_PCI_SUPPORT
    	bool

config RTMP_USB_SUPPORT
	bool

config RTMP_RBUS_SUPPORT
    	bool

endmenu

menu "WiFi Operation Modes"
    choice
        prompt "Main Mode"
        default MT_WIFI_MODE_AP

        config MT_WIFI_MODE_AP
                bool "AP"

        config MT_WIFI_MODE_STA
                bool "STA"

        config MT_WIFI_MODE_BOTH
                bool "APSTA"
    endchoice

    if MT_WIFI_MODE_AP || MT_WIFI_MODE_BOTH
        source "drivers/net/wireless/mt_wifi_ap/Kconfig"
    endif

    #if MT_WIFI_MODE_STA || MT_WIFI_MODE_BOTH
     #   source "drivers/net/wireless/rlt_wifi_sta/Kconfig"
    #endif
endmenu	

#"RT2860 series"
config RALINK_RT28XX
        bool
        default n
        select RTMP_PCI_SUPPORT

#"RT3092"
config RALINK_RT3092
        bool
        default n
        select RTMP_PCI_SUPPORT

#"RT3572"
config RALINK_RT3572
        bool
        default n
        select RTMP_USB_SUPPORT

#"RT5392"
config RALINK_RT5392
        bool
        default n
        select RTMP_PCI_SUPPORT

#"RT5572"
config RALINK_RT5572
        bool
        default n
        select RTMP_USB_SUPPORT

#"RT5592"
config RALINK_RT5592
        bool
        default n
        select RTMP_PCI_SUPPORT

#"MT7620/RT6352"
config RALINK_RT6352
        bool
        default n
        select RTMP_RBUS_SUPPORT
#        select RTMP_TEMPERATURE_CALIBRATION
#        select RTMP_INTERNAL_TX_ALC

#"MT7610E"
config RALINK_MT7610E
        bool
        default n
        select RTMP_PCI_SUPPORT

#"MT7610U"
config RALINK_MT7610U
        bool
        default n
        select RTMP_USB_SUPPORT

#"RT8592"
config RALINK_RT8592
        bool
        default n
        select RTMP_PCI_SUPPORT

#"MT7612E"
config RALINK_MT7612E
        bool
        default n
        select RTMP_PCI_SUPPORT

#"MT7612U"
config RALINK_MT7612U
        bool
        default n
        select RTMP_USB_SUPPORT

#"MT7603E"
config RALINK_MT7603E
        bool
        default n
        select RTMP_PCI_SUPPORT

endif

#if RLT_MAC
#	config RLT_MAC
#		bool
#		default y
#endif

#if RTMP_MAC
#	config RTMP_MAC
#		bool
#		default y
#endif

#if MT_MAC
if RALINK_MT7603E
	config MT_MAC
		bool
		default y
endif
#endif MT_WIFI
endif
#endif FIRST_IF_MT7603E || SECOND_IF_MT7603E
```

## package/lean/mt/drivers/mt7603e/src/mt7603_wifi/os/linux/Kconfig.ap.usb
```kconfig
config RTUSB_AP
	tristate "Ralink WiFi USB combo driver AP module"
	depends on m
	default m

config RTUSB_AP_WSC
	bool "WPS support including WPS2.0"
	depends on RTUSB_AP
	default y

config RTUSB_AP_MBSS
	bool "MBSS support"
	depends on RTUSB_AP
	default y

config RTUSB_AP_HS
	bool "HS2.0 support"
	depends on RTUSB_AP
	default y

config RTUSB_AP_NEW_MBSS_MODE
	bool "New MBSS support"
	depends on RTUSB_AP_MBSS

config RTUSB_WDS
	bool "WDS support"
	depends on RTUSB_AP

config RTUSB_APCLI
	bool "APClient support"
	depends on RTUSB_AP

config RTUSB_DFS
	bool "DFS support"
	depends on RTUSB_AP

config RTUSB_CS
	bool "CS support"
	depends on RTUSB_AP

config RTUSB_IGMP_SNOOP
	bool "IGMP snoop support"
	depends on RTUSB_AP

config RTUSB_NETIF_BLOCK
	bool "NETIF block support"
	depends on RTUSB_AP

config RTUSB_DLS
	bool "DLS support"
	depends on RTUSB_AP

config RTUSB_IDS
	bool "IDS support"
	depends on RTUSB_AP

config RTUSB_AP_FLASH_SUPPORT
	bool "FLASH support"
	depends on RTUSB_AP

config RTUSB_AP_80211N_DRAFT3
	bool "802.11n Draft3 support"
	depends on RTUSB_AP
	default y

# Chip related
config RT2870_AP
	bool "RT2870 support"
	depends on RTUSB_AP

config RT3572_AP
	bool "RT3572 support"
	depends on RTUSB_AP

config RT3573_AP
	bool "RT3573 support"
	depends on RTUSB_AP

config RT5572_AP
	bool "RT5572 support"
	depends on RTUSB_AP
	default y

# ATE
config RTUSB_AP_ATE
	bool "ATE support"
	depends on RTUSB_AP

config RT2870_AP_ATE
	bool "RT2870 ATE support"
	depends on RTUSB_AP_ATE && RT2870_AP

config RT3572_AP_ATE
	bool "RT3572 ATE support"
	depends on RTUSB_AP_ATE && RT3572_AP

config RT5572_AP_ATE
	bool "RT5572 ATE support"
	depends on RTUSB_AP_ATE && RT5572_AP
	default y

# QA
config RTUSB_AP_QA
	bool "QA tool support"
	depends on RTUSB_AP_ATE
	default y

config RTUSB_AP_WAPI
	bool "WAPI support"
	depends on RTUSB_AP

# Platform specific
config RT5572_AP_WDS
	bool
	depends on RTUSB_WDS
	default y
```
