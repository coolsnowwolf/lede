## package/libs/cyassl/Config.in
```kconfig
if PACKAGE_libcyassl

config CYASSL_HAS_AES_CCM
	bool "Include AES-CCM support"
	default n

config CYASSL_HAS_AES_GCM
	bool "Include AES-GCM support"
	default n

config CYASSL_HAS_CHACHA
	bool "Include ChaCha cipher suite support"
	default n

config CYASSL_HAS_ECC
	bool "Include ECC (Elliptic Curve Cryptography) support"
	default y

config CYASSL_HAS_DH
	bool "Include DH (Diffie-Hellman) support"
	default n

config CYASSL_HAS_ARC4
	bool "Include ARC4 support"
	default n

config CYASSL_HAS_DES3
	bool "Include DES3 (Tripple-DES) support"
	default n

config CYASSL_HAS_PSK
	bool "Include PKS (Pre Share Key) support"
	default n

config CYASSL_HAS_DTLS
	bool "Include DTLS support"
	default n

config CYASSL_HAS_ECC25519
	bool "Include ECC Curve 22519 support"
	depends on CYASSL_HAS_ECC
	default n

config CYASSL_HAS_POLY_1305
	bool "Include Poly-1305 support"
	default n

endif
```
