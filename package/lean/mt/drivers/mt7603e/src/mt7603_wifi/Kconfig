## package/lean/mt/drivers/mt_wifi/src/mt_wifi/os/linux/Kconfig.ap.soc
```kconfig
config RT2860V2_AP
	tristate "Ralink RT2860 802.11n AP support"
	depends on NET_RADIO 
	
config RT2860V2_AP_V24_DATA_STRUCTURE
	bool
	depends on RT2860V2_AP
	default y
	
config  RT2860V2_AP_LED
	bool "LED Support"
	depends on RT2860V2_AP

config  RT2860V2_AP_WSC
	bool "WSC (WiFi Simple Config)"
	depends on RT2860V2_AP

config RT2860V2_AP_HS
	bool "HS2.0 Support"
	depends on RT2860V2_AP

config  RT2860V2_AP_LLTD
	bool "LLTD (Link Layer Topology Discovery Protocol)"
	depends on RT2860V2_AP

config  RT2860V2_AP_WDS
	bool "WDS"
	depends on RT2860V2_AP

config  RT2860V2_AP_NINTENDO
	bool "Nintendo"
	depends on RT2860V2_AP

config  RT2860V2_AP_WMM_ACM
	bool "WMM ACM"
	depends on RT2860V2_AP

config  RT2860V2_AP_MBSS
	bool "MBSSID"
	depends on RT2860V2_AP

config	NEW_MBSSID_MODE
	bool "New MBSSID MODE"
	depends on RT2860V2_AP
	depends on RT2860V2_AP_MBSS
	depends on RALINK_RT3883 || RALINK_RT3352 || RALINK_RT5350
	default n

config  RT2860V2_AP_APCLI
	bool "AP-CLient Support"
	depends on RT2860V2_AP

config  RT2860V2_AP_IGMP_SNOOP
	bool "IGMP snooping"
	depends on RT2860V2_AP

config  RT2860V2_AP_NETIF_BLOCK
	bool "NETIF Block"
	depends on RT2860V2_AP
	help
	Support Net interface block while Tx-Sw queue full

config  RT2860V2_AP_DFS
	bool "DFS"
	depends on RT2860V2_AP

config  RT2860V2_AP_CARRIER
	bool "Carrier Detect"
	depends on RT2860V2_AP

config  RT2860V2_AP_DLS
	bool "DLS ((Direct-Link Setup) Support"
	depends on RT2860V2_AP

config  RT2860V2_AP_IDS
	bool "IDS (Intrusion Detection System) Support"
	depends on RT2860V2_AP

config  RT2860V2_AP_MESH
	bool "MESH Support"
	depends on RT2860V2_AP

config  RT2860V2_HW_ANTENNA_DIVERSITY
	bool "Antenna Diversity Support"
	depends on RT2860V2_AP
	depends on RALINK_RT5350

config  RT2860V2_RT3XXX_AP_ANTENNA_DIVERSITY
	bool "Antenna Diversity Support"
	depends on RT2860V2_AP

config  RT2860V2_AP_WAPI
	bool "WAPI Support"
	depends on RT2860V2_AP

config  RT2860V2_AP_COC
	bool "CoC Support"
	depends on RT2860V2_AP

config  RT2860V2_AP_MEMORY_OPTIMIZATION
	bool "Memory Optimization"
	depends on RT2860V2_AP

config  RT2860V2_AP_VIDEO_TURBINE
	bool "Video Turbine support"
	depends on RT2860V2_AP

config  RA_CLASSIFIER
	tristate "Ralink Flow Classifier"
	depends on RT2860V2_AP_VIDEO_TURBINE
	default n

config  RT2860V2_80211N_DRAFT3
	bool "802.11n Draft3"
	depends on RT2860V2_AP

config  RT2860V2_AP_INTELLIGENT_RATE_ADAPTION
	bool "Intelligent Rate Adaption"
	depends on RT2860V2_AP

config  RT2860V2_AP_TXBF
	bool "Tx Beam Forming"
	depends on RT2860V2_AP
	depends on RALINK_RT3883

config  RT2860V2_AP_RTMP_INTERNAL_TX_ALC
	bool "TSSI Compensation"
	depends on RT2860V2_AP
	depends on RALINK_RT3350 || RALINK_RT3352 || RALINK_RT5350

#config  RT2860V2_EXT_CHANNEL_LIST
#	bool "Extension Channel List"
#	depends on RT2860V2_AP

#config  RT2860V2_KTHREAD
#	bool "Kernel Thread"
#	depends on RT2860V2_AP

#config  RT2860V2_AUTO_CH_SELECT_ENHANCE
#	bool "Auto Channel Selection Enhancement"
#	depends on RT2860V2_AP

#config  RT2860V2_80211R_FT
#	bool "802.11r Fast BSS Transition"
#	depends on RT2860V2_AP

#config  RT2860V2_80211R_RR
#	bool "802.11k Radio Resource Management"
#	depends on RT2860V2_AP

#config  RT2860V2_SINGLE_SKU
#	bool "Single SKU"
#	depends on RT2860V2_AP

#config  RT2860V2_MCAST_RATE_SPECIFIC
#	bool "User specific tx rate of mcast pkt"
#	depends on RT2860V2_AP

#config  RT2860V2_SNMP
#	bool "Net-SNMP Support"
#	depends on RT2860V2_AP
```

## package/lean/mt/drivers/mt_wifi/src/mt_wifi/os/linux/Kconfig.mt_wifi
```kconfig
config MT_WIFI
	tristate "MT WIFI Driver"
	select WIFI_BASIC_FUNC if MT_WIFI

config MT_WIFI_PATH
		string
		depends on MT_WIFI
		default "mt_wifi"

if MT_WIFI
menu "WiFi Generic Feature Options"
choice
		prompt "EEPROM Type of 1st Card"
		depends on ! FIRST_IF_NONE

		config FIRST_IF_EEPROM_FLASH
		bool "FLASH"

		config FIRST_IF_EEPROM_EFUSE
		bool "EFUSE"
endchoice

config RT_FIRST_CARD_EEPROM
		string
		depends on ! FIRST_IF_NONE
		default "flash" if FIRST_IF_EEPROM_FLASH

choice
		prompt "EEPROM Type of 2nd Card"
		depends on ! SECOND_IF_NONE

		config SECOND_IF_EEPROM_FLASH
		bool "FLASH"

		config SECOND_IF_EEPROM_PROM
		bool "EEPROM"

		config SECOND_IF_EEPROM_EFUSE
		bool "EFUSE"

endchoice

config RT_SECOND_CARD_EEPROM
		string
		depends on ! SECOND_IF_NONE
		default "prom" if SECOND_IF_EEPROM_PROM
		default "efuse" if SECOND_IF_EEPROM_EFUSE
		default "flash" if SECOND_IF_EEPROM_FLASH

choice
		prompt "EEPROM Type of 3th Card"
		depends on ! THIRD_IF_NONE

		config THIRD_IF_EEPROM_FLASH
		bool "FLASH"

		config THIRD_IF_EEPROM_PROM
		bool "EEPROM"

		config THIRD_IF_EEPROM_EFUSE
		bool "EFUSE"

endchoice

config RT_THIRD_CARD_EEPROM
		string
		depends on ! THIRD_IF_NONE
		default "prom" if THIRD_IF_EEPROM_PROM
		default "efuse" if THIRD_IF_EEPROM_EFUSE
		default "flash" if THIRD_IF_EEPROM_FLASH
	
config MULTI_INF_SUPPORT
		bool
		default y if !FIRST_IF_NONE && !SECOND_IF_NONE
		
config WIFI_BASIC_FUNC
	bool "Basic Functions"
	select WIRELESS_EXT
	select WEXT_SPY
	select WEXT_PRIV

config DOT11_N_SUPPORT
	bool "802.11n support"
	default y

config DOT11_VHT_AC
	bool "802.11AC support"
	depends on WIFI_DRIVER
	depends on DOT11_N_SUPPORT
	default y

config G_BAND_256QAM_SUPPORT
    bool "2.4G 256QAM support"
	depends on WIFI_DRIVER
    depends on DOT11_VHT_AC
	default y

config TPC_SUPPORT
	bool "802.11h TPC Support"
	depends on WIFI_DRIVER
	default y

config TXRX_STAT_SUPPORT
	bool "TxRx Stats Support"
	depends on WIFI_DRIVER
	default n

config ICAP_SUPPORT
	bool "ICAP Support"
	depends on WIFI_DRIVER
	depends on MT_AP_SUPPORT
	default y

config SPECTRUM_SUPPORT
	bool "Wifi Spectrum Support"
	depends on WIFI_DRIVER
	depends on MT_AP_SUPPORT
	default y

config BACKGROUND_SCAN_SUPPORT
	bool "Background Scan Support"
	depends on WIFI_DRIVER
	default y
	
config SMART_CARRIER_SENSE_SUPPORT
	bool "Smart Carrier Sense Support"
	depends on WIFI_DRIVER
	default y
	
config MT_DFS_SUPPORT
        bool "Dynamic Frequency Selection Support"	
        depends on WIFI_DRIVER
        default y
config MTK_OFFCHANNEL_SCAN_FEATURE
	bool "Channel Quality Monitor"
	depends on MTK_WIFI_DRIVER
	depends on MTK_MT_AP_SUPPORT
	default n
#config WFA_VHT_R2_PF
#    bool "WFA VHT R2 Plugfest"
#    depends on DOT11_VHT_AC
#    default n

config HDR_TRANS_TX_SUPPORT
    bool "Tx Header Translation"
    depends on CHIP_MT7615E || CHIP_MT7622 || CHIP_MT7663E
    default y

config HDR_TRANS_RX_SUPPORT
    bool "Rx Header Translation"
    depends on CHIP_MT7615E || CHIP_MT7622 || CHIP_MT7663E
    default y

config DBDC_MODE
	bool "dbdc mode support"
	depends on CHIP_MT7615E
	select MULTI_PROFILE_SUPPORT
#	select DEFAULT_5G_PROFILE
	default y

config MULTI_PROFILE_SUPPORT
    bool "Multi Profile Support"
    depends on DBDC_MODE
	default y

config DEFAULT_5G_PROFILE
	bool "5G default profile for DBDC"
	depends on DBDC_MODE
	default n

config WSC_INCLUDED
	bool "WSC (WiFi Simple Config)"
	depends on WIFI_DRIVER
	depends on MT_AP_SUPPORT || MT_STA_SUPPORT
	default y

config WSC_V2_SUPPORT
	bool "WSC V2(WiFi Simple Config Version 2.0)"
	depends on WIFI_DRIVER
	depends on MT_AP_SUPPORT || MT_STA_SUPPORT
	default y

config DOT11W_PMF_SUPPORT
	bool "PMF"
	depends on WIFI_DRIVER
	depends on MT_AP_SUPPORT || MT_STA_SUPPORT
	default y

config TXBF_SUPPORT
        bool "Tx Bean Forming Support"
        depends on WIFI_DRIVER
        default y

config FAST_NAT_SUPPORT
       bool "Fast-NAT support"
       depends on RA_HW_NAT_WIFI
       default n

config WHNAT_SUPPORT
	tristate "Wifi Hardware NAT support"
	depends on CHIP_MT7615E
	depends on WLAN_HOOK
	depends on FAST_NAT_SUPPORT
	default n

#config LLTD_SUPPORT
#	bool "LLTD (Link Layer Topology Discovery Protocol)"
#	depends on WIFI_DRIVER
#	depends on MT_AP_SUPPORT
#	default n

#config QOS_DLS_SUPPORT
#	bool "802.11e DLS ((Direct-Link Setup) Support"
#	depends on WIFI_DRIVER
#	depends on MT_AP_SUPPORT
#	default n

#config WAPI_SUPPORT
#	bool "WAPI Support"
#	depends on WIFI_DRIVER
#	default n

config FTM_SUPPORT
	bool "FTM Support"
	depends on WIFI_DRIVER
	select PASSPOINT_R2
	default n

config MBO_SUPPORT
	bool "MBO Support"
	depends on WIFI_DRIVER
	select INTERWORKING
	select WNM_SUPPORT
	select DOT11K_RRM_SUPPORT
	select DOT11R_FT_SUPPORT
	select DOT11W_PMF_SUPPORT
	default n

#config CARRIER_DETECTION_SUPPORT
#	bool "Carrier Detect"
#	depends on WIFI_DRIVER
#	default n

config IGMP_SNOOP_SUPPORT
	bool "IGMP snooping"
	depends on WIFI_DRIVER
	depends on MT_AP_SUPPORT
	default y

#config BLOCK_NET_IF
#	bool "NETIF Block"
#	depends on WIFI_DRIVER
#	depends on MT_AP_SUPPORT
#	default n
#	help
#	Support Net interface block while Tx-Sw queue full

#config RATE_ADAPTION
#	bool "New Rate Adaptation support"
#	depends on WIFI_DRIVER
#	default y

#config NEW_RATE_ADAPT_SUPPORT
#	bool "Intelligent Rate Adaption"
#	depends on WIFI_DRIVER && RATE_ADAPTION
#	default y

#config AGS_SUPPORT
#	bool "Adaptive Group Switching"
#	depends on WIFI_DRIVER && RATE_ADAPTION
#	depends on MT_AP_SUPPORT || MT_STA_SUPPORT
#	default n

#config RATE_ADAPT_AGBS_SUPPORT
#	bool "Adaptive AGBS Mode"
#	depends on WIFI_DRIVER && RATE_ADAPTION
#	depends on MT_AP_SUPPORT || MT_STA_SUPPORT
#	default y

#config IDS_SUPPORT
#	bool "IDS (Intrusion Detection System) Support"
#	depends on WIFI_DRIVER
#	depends on MT_AP_SUPPORT
#	default n

#config WIFI_WORK_QUEUE
#	bool "Work Queue"
#	depends on WIFI_DRIVER
#	default n

#config WIFI_SKB_RECYCLE
#	bool "SKB Recycle(Linux)"
#	depends on WIFI_DRIVER
#	depends on MT_AP_SUPPORT
#	default n

config RTMP_FLASH_SUPPORT
	bool "Flash Support"
	depends on WIFI_DRIVER
	default y

config PRE_CAL_TRX_SET1_SUPPORT
    bool "Calibration To Flash/BinFile Support"
    depends on WIFI_DRIVER
    default y

config RLM_CAL_CACHE_SUPPORT
	bool "RlmCalibrationCache Support"
	depends on WIFI_DRIVER
	default y

config PRE_CAL_TRX_SET2_SUPPORT
    bool "Pre-calibration to Flash Support"
    depends on WIFI_DRIVER
    default y

config CAL_BIN_FILE_SUPPORT
	bool "Calibration to BinFile Support"
	depends on WIFI_DRIVER
	default y

config RF_LOCKDOWN_SUPPORT
	bool "RF Lockdown Support"
	depends on WIFI_DRIVER
	default n	

config LINK_TEST_SUPPORT
	bool "Link Test Support"
	depends on WIFI_DRIVER
	default y
	
config WIFI_EAP_FEATURE
	bool "EAP Feature Support"
	depends on WIFI_DRIVER
	default y

#config LED_CONTROL_SUPPORT
#	bool "LED Support"
#	depends on WIFI_DRIVER
#	depends on MT_AP_SUPPORT
#	default n

config ATE_SUPPORT
	bool "ATE/QA Support"
	depends on WIFI_DRIVER
	default y	

#config MEMORY_OPTIMIZATION
#	bool "Memory Optimization"
#	depends on WIFI_DRIVER
#	default n

config PASSPOINT_R2
	bool "Passpoint Release-2 Support"
	depends on WIFI_DRIVER
	select DOT11W_PMF_SUPPORT
	depends on MT_AP_SUPPORT
	default n

#config TRACE_TCP_PKT
#       bool "TCP DATA/ACK packets trace log"
#       depends on WIFI_DRIVER
#       default n

config UAPSD
	bool "UAPSD support"
	depends on WIFI_DRIVER
	depends on MT_AP_SUPPORT || MT_STA_SUPPORT
	default y

config TCP_RACK_SUPPORT
	bool "TCP Reduced ACK  support"
	depends on WIFI_DRIVER
	default n

#### PA_LNA_Type choice

config RED_SUPPORT
        bool "RED(Random Early Drop) support"
	depends on WIFI_DRIVER
	depends on MT_AP_SUPPORT || MT_STA_SUPPORT
        default y

config FDB_SUPPORT
       bool "FW Debug Port"
       depends on WIFI_DRIVER
       default n

choice
        prompt "PA LNA Type of 1st Card"
		depends on ! FIRST_IF_NONE
		
		config FIRST_IF_EPAELNA
		bool "ePAeLNA"
		config FIRST_IF_IPAILNA
		bool "iPAiLNA"		
		config FIRST_IF_IPAELNA
		bool "iPAeLNA"
#		config FIRST_IF_EPAILNA
#		bool "ePAiLNA"
endchoice
choice
        prompt "PA LNA Type of 2nd Card"
		depends on ! SECOND_IF_NONE
		
		config SECOND_IF_EPAELNA
		bool "ePAeLNA"
		config SECOND_IF_IPAILNA
		bool "iPAiLNA"		
		config SECOND_IF_IPAELNA
		bool "iPAeLNA"
#		config SECOND_IF_EPAILNA
#		bool "ePAiLNA"
endchoice
choice
        prompt "PA LNA Type of 3rd Card"
		depends on ! THIRD_IF_NONE
		
		config THIRD_IF_EPAELNA
		bool "ePAeLNA"
		config THIRD_IF_IPAILNA
		bool "iPAiLNA"		
		config THIRD_IF_IPAELNA
		bool "iPAeLNA"
#		config THIRD_IF_EPAILNA
#		bool "ePAiLNA"
endchoice
#### PA_LNA_Type choice END 

#
# Section for chip architectures
#
# "RLT MAC Support"
config RLT_MAC
	bool
	depends on WIFI_DRIVER
	default n

config RLT_BBP
	bool

config RLT_RF
	bool

# "RTMP MAC Support"
config RTMP_MAC
	bool
	depends on WIFI_DRIVER
	default n

config RTMP_BBP
    	bool

config RTMP_RF
    	bool

#
# Section for interfaces
#
config RTMP_PCI_SUPPORT
    	bool

config RTMP_USB_SUPPORT
		bool

config RTMP_RBUS_SUPPORT
    	bool

endmenu

menu "WiFi Operation Modes"
	choice
		prompt "Main Mode"
		default WIFI_MODE_AP

		config WIFI_MODE_AP
				tristate "AP"
				select MT_AP_SUPPORT

		config WIFI_MODE_STA
				tristate "STA"
				select MT_STA_SUPPORT

		config WIFI_MODE_BOTH
				tristate "APSTA"
				select MT_AP_SUPPORT
				select MT_STA_SUPPORT
    endchoice

    if WIFI_MODE_AP || WIFI_MODE_BOTH
		source "drivers/net/wireless/mtk/mt7615e/mt_wifi_ap/Kconfig"
    endif

    if WIFI_MODE_STA || WIFI_MODE_BOTH
		source "drivers/net/wireless/mtk/mt7615e/mt_wifi_sta/Kconfig"
    endif
endmenu	

endif

if WIFI_RLT_MAC
	config RLT_MAC
		bool
		default y
endif

if WIFI_RTMP_MAC
	config RTMP_MAC
		bool
		default y
endif

if WIFI_MT_MAC
	config MT_MAC
		bool
		default y

	config CHIP_MT7603E
		bool
		default n

	config CHIP_MT7615E
		bool
		default n

	config CHIP_MT7622
		bool
		default n

	config CHIP_MT7663E
		bool
		default n
endif

if CHIP_MT7615E
	config MT_MAC
		bool
		default y
		select RATE_ADAPTION
		select RATE_ADAPT_AGBS_SUPPORT
		select DOT11_N_SUPPORT
		select DOT11_VHT_AC
		select HDR_TRANS_TX_SUPPORT
		select HDR_TRANS_RX_SUPPORT
endif	
```
