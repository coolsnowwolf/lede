## package/lean/mt/drivers/mt7603e/src/mt7603_wifi/os/linux/Kconfig.rlt_wifi
```kconfig
config WIFI_BASIC_FUNC
	bool "Basic Functions"
	select WIRELESS_EXT
	select WEXT_SPY
	select WEXT_PRIV
        
config WSC_INCLUDED
	bool "WSC (WiFi Simple Config)"
	depends on WIFI_DRIVER
    default y

config WSC_V2_SUPPORT
	bool "WSC V2(WiFi Simple Config Version 2.0)"
	depends on WIFI_DRIVER
    default y

config WSC_NFC_SUPPORT
	bool "WSC out-of-band(NFC)"
        depends on WIFI_DRIVER
    default n

config DOT11N_DRAFT3
	bool "802.11n Draft3"
	depends on WIFI_DRIVER
    default n
    
config DOT11_VHT_AC
	bool "802.11 ac"
	depends on WIFI_DRIVER
    default n
    
config DOT11W_PMF_SUPPORT
	bool "PMF"
	depends on RLT_STA_SUPPORT
    default n

#config WMM_ACM_SUPPORT
#	bool "WMM ACM"
#	depends on WIFI_DRIVER
#   default n
	
config LLTD_SUPPORT
	bool "LLTD (Link Layer Topology Discovery Protocol)"
	depends on WIFI_DRIVER
    default n

config QOS_DLS_SUPPORT
	bool "802.11e DLS ((Direct-Link Setup) Support"
	depends on WIFI_DRIVER
    default n

config WAPI_SUPPORT
	bool "WAPI Support"
	depends on WIFI_DRIVER
    default n

config CARRIER_DETECTION_SUPPORT
	bool "Carrier Detect"
	depends on WIFI_DRIVER
    default n

config IGMP_SNOOP_SUPPORT
	bool "IGMP snooping"
	depends on WIFI_DRIVER
    default n

config BLOCK_NET_IF
	bool "NETIF Block"
	depends on WIFI_DRIVER
    default n
	help
	Support Net interface block while Tx-Sw queue full

config TXBF_SUPPORT
    bool "Tx Bean Forming Support (Only 3883)"
    depends on WIFI_DRIVER
    depends on RALINK_RT2883 || RALINK_RT3883
    default n

#config VIDEO_TURBINE_SUPPORT
#	bool "Video Turbine support"
#	depends on WIFI_DRIVER
#   default n

#config RA_CLASSIFIER
#	tristate "Ralink Flow Classifier"
#	depends on WIFI_DRIVER
#	default n

config RATE_ADAPTION
    bool "New Rate Adaptation support"
    depends on WIFI_DRIVER
    default n

config NEW_RATE_ADAPT_SUPPORT
    bool "Intelligent Rate Adaption"
    depends on WIFI_DRIVER && RATE_ADAPTION
    default y

config AGS_SUPPORT
	bool "Adaptive Group Switching"
	depends on WIFI_DRIVER && RATE_ADAPTION
    default n
    
config IDS_SUPPORT
	bool "IDS (Intrusion Detection System) Support"
	depends on WIFI_DRIVER
    default n

config WIFI_WORK_QUEUE
	bool "Work Queue"
	depends on WIFI_DRIVER
    default n

config WIFI_SKB_RECYCLE
    bool "SKB Recycle(Linux)"
    depends on WIFI_DRIVER
    default n

config RTMP_FLASH_SUPPORT
	bool "Flash Support"
	depends on WIFI_DRIVER
    default n

config LED_CONTROL_SUPPORT
	bool "LED Support"
	depends on WIFI_DRIVER
    default n

config SINGLE_SKU
	bool "Single SKU"
	depends on WIFI_DRIVER
    default n

config SINGLE_SKU_V2
    bool "Single SKU V2"
    depends on SINGLE_SKU && RALINK_RT6352
    default n

config HW_ANTENNA_DIVERSITY
	bool "Antenna Diversity Support"
	depends on RLT_AP_SUPPORT || RLT_STA_SUPPORT
	depends on RALINK_RT5350
    default n

config ATE_SUPPORT
	bool "ATE/QA Support"
	depends on WIFI_DRIVER
    default n

config RT2860V2_AP_V24_DATA_STRUCTURE
	bool
	depends on WIFI_DRIVER
	default y

config  RT2860V2_AP_32B_DESC
	bool "32 Byte Descriptor Support"
	depends on WIFI_DRIVER
	depends on RALINK_RT6352 || RALINK_MT7620
	default n

config MEMORY_OPTIMIZATION
	bool "Memory Optimization"
	depends on WIFI_DRIVER
    default n

config RTMP_INTERNAL_TX_ALC
    bool "TSSI Compensation"
    depends on WIFI_DRIVER
    depends on RALINK_RT3350 || RALINK_RT3352 || RALINK_RT5350 || RALINK_RT6352
	default n
    
config RTMP_TEMPERATURE_CALIBRATION
    bool "Temperature Calibration"
    depends on WIFI_DRIVER
    depends on RALINK_RT6352
    default n

#
# Section for chip architectures
#
# "RLT MAC Support"
config RLT_MAC
	bool
	depends on WIFI_DRIVER
    default n

config RLT_BBP
    bool

config RLT_RF
    bool

# "RTMP MAC Support"
config RTMP_MAC
	bool
	depends on WIFI_DRIVER
    default n

config RTMP_BBP
    bool

config RTMP_RF
    bool

#
# Section for interfaces
#
config RTMP_PCI_SUPPORT
    bool

config RTMP_USB_SUPPORT
    bool

config RTMP_RBUS_SUPPORT
    bool
```

## package/lean/mt/drivers/mt7603e/src/mt7603_wifi/os/linux/Kconfig.rlt_wifi_ap
```kconfig
config RLT_AP_SUPPORT
	tristate "Ralink RT2860 802.11n AP support"
#	depends on NET_RADIO 
	select WIRELESS_EXT
	select WEXT_SPY
	select WEXT_PRIV

config WDS_SUPPORT
	bool "WDS"
	depends on RLT_AP_SUPPORT

config MBSS_SUPPORT
	bool "MBSSID"
	depends on RLT_AP_SUPPORT

config NEW_MBSSID_MODE
	bool "New MBSSID MODE"
	depends on RLT_AP_SUPPORT && MBSS_SUPPORT
	depends on RALINK_RT3883 || RALINK_RT3352 || RALINK_RT5350 || RALINK_RT6352 || RALINK_MT7620
	default n

config ENHANCE_NEW_MBSSID_MODE
    bool "Enhanced MBSSID mode"
    depends on NEW_MBSSID_MODE
    default n

config APCLI_SUPPORT
	bool "AP-Client Support"
	depends on RLT_AP_SUPPORT

config MAC_REPEATER_SUPPORT
	bool "MAC Repeater Support"
	depends on RLT_AP_SUPPORT
	depends on APCLI_SUPPORT
	depends on RALINK_RT6352 || RALINK_MT7620
	default n

#config MESH_SUPPORT
#	bool "MESH Support"
#	depends on RLT_AP_SUPPORT

config DFS_SUPPORT
	bool "DFS"
	depends on RLT_AP_SUPPORT
	select RALINK_TIMER_DFS

#config DOT11R_FT_SUPPORT
#	bool "802.11r Fast BSS Transition"
#	depends on RLT_AP_SUPPORT

#config DOT11K_RRM_SUPPORT
#	bool "802.11k Radio Resource Management"
#	depends on RLT_AP_SUPPORT

config BAND_STEERING_7603
	bool "Band Steering"
	depends on RLT_AP_SUPPORT
	default n

config LLTD_SUPPORT
	bool "LLTD (Link Layer Topology Discovery Protocol)"
	depends on RLT_AP_SUPPORT

config NINTENDO_AP
	bool "Nintendo AP"
	depends on RLT_AP_SUPPORT

config COC_SUPPORT
	bool "CoC Support"
	depends on RLT_AP_SUPPORT
	default n

#config  RT2860V2_SNMP
#	bool "Net-SNMP Support"
#	depends on RLT_AP_SUPPORT

#config MCAST_RATE_SPECIFIC
#	bool "User specific tx rate of mcast pkt"
#	depends on RLT_AP_SUPPORT

#config EXT_BUILD_CHANNEL_LIST
#	bool "Extension Channel List"
#	depends on RLT_AP_SUPPORT

#config AUTO_CH_SELECT_ENHANCE
#	bool "Auto Channel Selection Enhancement"
#	depends on RLT_AP_SUPPORT
```

## package/lean/mt/drivers/mt7603e/src/mt7603_wifi/os/linux/Kconfig.rlt_wifi_sta
```kconfig
config RLT_STA_SUPPORT
	tristate "Ralink RT2860 802.11n STA support"
#	depends on NET_RADIO 
	select WIRELESS_EXT
	select WEXT_SPY
	select WEXT_PRIV

config DOT11Z_TDLS_SUPPORT
    bool "802.11z TDLS support"
    depends on RLT_STA_SUPPORT

#config RT2860V2_EXT_CHANNEL_LIST
#	bool "Extension Channel List"
#	depends on RLT_STA_SUPPORT

#config STA_AUTO_CH_SELECT_ENHANCE
#	bool "Auto Channel Selection Enhancement"
#	depends on RLT_STA_SUPPORT
```

## package/lean/mt/drivers/mt7603e/src/mt7603_wifi/os/linux/Kconfig.sta.soc
```kconfig
config RT2860V2_STA
	tristate "Ralink RT2860 802.11n STA support"
	depends on NET_RADIO 

config  RT2860V2_STA_WPA_SUPPLICANT
	bool "WPA Supplicant"
	depends on RT2860V2_STA

config  RT2860V2_STA_ETH_CONVERT
	bool "Ethernet Convert Support"
	depends on RT2860V2_STA

config  RT2860V2_STA_DPB
	bool
	depends on RT2860V2_STA_ETH_CONVERT
	default y

config  RT2860V2_STA_WMM_ACM
	bool "WMM ACM Support"
	depends on RT2860V2_STA

config  RT2860V2_STA_LED
	bool "LED Support"
	depends on RT2860V2_STA

config  RT2860V2_STA_IDS
	bool "IDS (Intrusion Detection System) Support"
	depends on RT2860V2_STA

config  RT2860V2_STA_WSC
	bool "WSC (WiFi Simple Config)"
	depends on RT2860V2_STA

config RT2860V2_STA_HS
	bool "HS2.0 support"
	depends on RT2860V2_STA

config  RT2860V2_STA_CARRIER
	bool "Carrier Sense Support"
	depends on RT2860V2_STA

config  RT2860V2_STA_DLS
	bool "DLS ((Direct-Link Setup) Support"
	depends on RT2860V2_STA

config  RT2860V2_STA_MESH
	bool "MESH Support"
	depends on RT2860V2_STA

config  RT2860V2_RT3XXX_STA_ANTENNA_DIVERSITY
	bool "Antenna Diversity Support"
	depends on RT2860V2_STA

config  RT2860V2_HW_STA_ANTENNA_DIVERSITY
	bool "Antenna Diversity Support"
	depends on RT2860V2_STA
	depends on RALINK_RT5350

#config  RT2860V2_STA_WAPI
#        bool "WAPI Support"
#        depends on RT2860V2_STA

config  RT2860V2_STA_VIDEO_TURBINE
	bool "Video Turbine support"
	depends on RT2860V2_STA

config  RT2860V2_STA_INTELLIGENT_RATE_ADAPTION
	bool "Intelligent Rate Adaption"
	depends on RT2860V2_STA

config  RT2860V2_STA_TXBF
	bool "Tx Bean Forming Support (Only 3883)"
	depends on RT2860V2_STA
	depends on RALINK_RT3883 

config  RT2860V2_STA_RTMP_INTERNAL_TX_ALC
	bool "TSSI Compensation"
	depends on RT2860V2_STA
	depends on RALINK_RT3350 || RALINK_RT3352 || RALINK_RT5350

config  RT2860V2_STA_80211N_DRAFT3
	bool "802.11n Draft3"
	depends on RT2860V2_STA

#config  RT2860V2_EXT_CHANNEL_LIST
#        bool "Extension Channel List"
#        depends on RT2860V2_STA

#config  RT2860V2_SNMP
#	bool "Net-SNMP Support"
#	depends on RT2860V2_STA
```

## package/lean/mt/drivers/mt7603e/src/mt7603_wifi_ap/Kconfig
```kconfig
config MT7603E_RLT_AP_SUPPORT
	tristate "MT7603 802.11n AP support"
#	depends on NET_RADIO 
	select WIRELESS_EXT
	select WEXT_SPY
	select WEXT_PRIV

#config RLT_AP_SUPPORT
#	bool "7603"
#	depends on MT7603E_RLT_AP_SUPPORT
#	default y
config MT7603E_WDS_SUPPORT
	bool "WDS"
	depends on MT7603E_RLT_AP_SUPPORT

config MT7603E_MBSS_SUPPORT
	bool "MBSSID"
	depends on MT7603E_RLT_AP_SUPPORT

config MT7603E_SNIFFER_SUPPORT
	bool "SNIFFER"
	depends on MT7603E_RLT_AP_SUPPORT
	default n
config MT7603E_CFG80211_SUPPORT
	bool "CFG80211"
	depends on MT7603E_RLT_AP_SUPPORT
	default n

config MT7603E_SNIFFER_MIB_CMD
	bool "SNIFFER_MIB_CMD"
	depends on MT7603E_SNIFFER_SUPPORT
	default n

config MT7603E_ALL_NET_EVENT
	bool "ALL_NET_EVENT"
	depends on MT7603E_RLT_AP_SUPPORT
	default n

config MT7603E_ACL_V2_SUPPORT
	bool "ACL_V2"
	depends on MT7603E_RLT_AP_SUPPORT
	
config MT7603E_NEW_MBSSID_MODE
	bool "New MBSSID MODE"
	depends on MT7603E_RLT_AP_SUPPORT && MT7603E_MBSS_SUPPORT
	depends on RALINK_RT3883 || RALINK_RT3352 || RALINK_RT5350 || MT7603E_RALINK_RT6352 || RALINK_MT7620
	default n

config MT7603E_ENHANCE_NEW_MBSSID_MODE
    bool "Enhanced MBSSID mode"
    depends on MT7603E_NEW_MBSSID_MODE
    default n

config MT7603E_APCLI_SUPPORT
	bool "AP-Client Support"
	depends on MT7603E_RLT_AP_SUPPORT
	default y
	
config ROAMING_ENHANCE_SUPPORT
	bool "Roaming Enhance Support"
	depends on MT7603E_RLT_AP_SUPPORT
	depends on APCLI_SUPPORT
	default n

config MT7603E_MULTI_APCLI_SUPPORT
	bool "MULTI AP-Client Support"
	depends on MT7603E_APCLI_SUPPORT

config MT7603E_MAC_REPEATER_SUPPORT
	bool "MAC Repeater Support"
	depends on MT7603E_RLT_AP_SUPPORT
	depends on MT7603E_APCLI_SUPPORT
	depends on MT7603E_RALINK_RT6352 || RALINK_MT7620 || MT7603E_RALINK_MT7603E || MT7603E_RALINK_MT7603U
	default y

config MT7603E_AIRPLAY_SUPPORT
	bool "AirPlay Support"
	depends on MT7603E_APCLI_SUPPORT

#config MT7603E_MESH_SUPPORT
#	bool "MESH Support"
#	depends on MT7603E_RLT_AP_SUPPORT

config MT7603E_DFS_SUPPORT
	bool "DFS"
	depends on MT7603E_RLT_AP_SUPPORT
	select RALINK_TIMER_DFS

config MT7603E_DOT11R_FT_SUPPORT
	bool "802.11r Fast BSS Transition"
	depends on MT7603E_RLT_AP_SUPPORT

config MT7603E_DOT11K_RRM_SUPPORT
	bool "802.11k Radio Resource Management"
	depends on MT7603E_RLT_AP_SUPPORT
	default n

config MT7603E_WNM_SUPPORT
	bool "802.11v Wireless Network Management Support"
	depends on MT7603E_RLT_AP_SUPPORT
	default n

config MT7603E_INTERWORKING
	bool "802.11u Interworking/Gas Support"
        depends on MT_AP_SUPPORT
        default n

config MT7603E_MAP_SUPPORT
	bool "Multi-AP Support"
	depends on MT_AP_SUPPORT
	#select MBO_SUPPORT
	default n

config MT7603E_BAND_STEERING_7603
	bool "Band Steering"
	depends on MT7603E_RLT_AP_SUPPORT
	default n

config MT7603E_LLTD_SUPPORT
	bool "LLTD (Link Layer Topology Discovery Protocol)"
	depends on MT7603E_RLT_AP_SUPPORT
	default y

config MT7603E_NINTENDO_AP
	bool "Nintendo AP"
	depends on MT7603E_RLT_AP_SUPPORT

config MT7603E_COC_SUPPORT
	bool "CoC Support"
	depends on MT7603E_RLT_AP_SUPPORT
	default n

#config  MT7603E_RT2860V2_SNMP
#	bool "Net-SNMP Support"
#	depends on MT7603E_RLT_AP_SUPPORT

config MT7603E_MCAST_RATE_SPECIFIC
	bool "User specific tx rate of mcast pkt"
	depends on MT7603E_RLT_AP_SUPPORT

config MT7603E_PREVENT_ARP_SPOOFING_SUPPORT
	bool "Detect ARP spoof pkts attack"
	depends on MT7603E_RLT_AP_SUPPORT

#config MT7603E_EXT_BUILD_CHANNEL_LIST
#	bool "Extension Channel List"
#	depends on MT7603E_RLT_AP_SUPPORT

#config MT7603E_AUTO_CH_SELECT_ENHANCE
#	bool "Auto Channel Selection Enhancement"
#	depends on MT7603E_RLT_AP_SUPPORT

config MT7603E_SECURITY_IMPROVEMENT_SUPPORT
	bool "WPA2 security improvement support"
	depends on MT7603E_RLT_AP_SUPPORT
	default n
	---help---
	  WPA2 security improvement support


config MT7603E_WPA3_SUPPORT
	bool "WPA3 support"
	select MT7603E_DOT11W_PMF_SUPPORT
	select MT7603E_SECURITY_IMPROVEMENT_SUPPORT
	depends on MT7603E_RLT_AP_SUPPORT
	default n
	---help---
	  WPA3 support

config MT7603E_OWE_SUPPORT
	bool "Enhanced Open/OWE support"
	select MT7603E_DOT11W_PMF_SUPPORT
	depends on MT7603E_RLT_AP_SUPPORT
	default n
	---help---
	  Enhanced Open/OWE support

config MT7603E_NEW_BW2040_COEXIST_SUPPORT
	bool "New BW20/40 Coexist support"
	depends on MT7603E_RLT_AP_SUPPORT
	default y
	---help---
	  Both Beacon and Radio fallback to BW20 for anti-interference
```

## package/lean/mt/drivers/mt7603e/src/mt7603_wifi_ap/Kconfig.mt_wifi_ap
```kconfig
config MT_AP_SUPPORT
	tristate "UnifyMAC 802.11n AP support"
#	depends on NET_RADIO 
	select WIRELESS_EXT
	select WEXT_SPY
	select WEXT_PRIV

config MT_WDS_SUPPORT
	bool "WDS"
	depends on MT_AP_SUPPORT

config MT_MBSS_SUPPORT
	bool "MBSSID"
	depends on MT_AP_SUPPORT

config MT_NEW_MBSSID_MODE
	bool "New MBSSID MODE"
	depends on MT_AP_SUPPORT && MT_MBSS_SUPPORT
	depends on RALINK_RT3883 || RALINK_RT3352 || RALINK_RT5350 || RALINK_RT6352 || RALINK_MT7620
	default n

config MT_ENHANCE_NEW_MBSSID_MODE
    bool "Enhanced MBSSID mode"
    depends on MT_NEW_MBSSID_MODE
    default n

config MT_APCLI_SUPPORT
	bool "AP-Client Support"
	depends on MT_AP_SUPPORT
	default y

config ROAMING_ENHANCE_SUPPORT
	bool "Roaming Enhance Support"
	depends on MT_AP_SUPPORT
	depends on APCLI_SUPPORT
	default n

config MT_MULTI_APCLI_SUPPORT
	bool "MULTI AP-Client Support"
	depends on MT_APCLI_SUPPORT

config MT_MAC_REPEATER_SUPPORT
	bool "MAC Repeater Support"
	depends on MT_AP_SUPPORT
	depends on MT_APCLI_SUPPORT
	depends on RALINK_RT6352 || RALINK_MT7620 || RALINK_MT7603E
	default y

config MT_AIRPLAY_SUPPORT
	bool "AirPlay Support"
	depends on MT_APCLI_SUPPORT

#config MT_MESH_SUPPORT
#	bool "MESH Support"
#	depends on MT_AP_SUPPORT

config MT_DFS_SUPPORT
	bool "DFS"
	depends on MT_AP_SUPPORT
	select RALINK_TIMER_DFS

config MT_DOT11R_FT_SUPPORT
	bool "802.11r Fast BSS Transition"
	depends on MT_AP_SUPPORT

config MT_DOT11K_RRM_SUPPORT
	bool "802.11k Radio Resource Management"
	depends on MT_AP_SUPPORT
	default n
	
config MT7603E_INTERWORKING
	bool "802.11u Interworking/Gas Support"
        depends on MT_AP_SUPPORT
        default n
config MT7603E_MAP_SUPPORT
	bool "Multi-AP Support"
	depends on MT_AP_SUPPORT
	#select MBO_SUPPORT
	default n
	
config MT_LLTD_SUPPORT
	bool "LLTD (Link Layer Topology Discovery Protocol)"
	depends on MT_AP_SUPPORT
	default y

config MT_NINTENDO_AP
	bool "Nintendo AP"
	depends on MT_AP_SUPPORT

config MT_COC_SUPPORT
	bool "CoC Support"
	depends on MT_AP_SUPPORT
	default n

#config  RT2860V2_SNMP
#	bool "Net-SNMP Support"
#	depends on RLT_AP_SUPPORT

config MT_MCAST_RATE_SPECIFIC
	bool "User specific tx rate of mcast pkt"
	depends on MT_AP_SUPPORT

config MT_PREVENT_ARP_SPOOFING_SUPPORT
	bool "Detect ARP spoof pkts attack"
	depends on MT_AP_SUPPORT

#config MT_EXT_BUILD_CHANNEL_LIST
#	bool "Extension Channel List"
#	depends on MT_AP_SUPPORT

#config MT_AUTO_CH_SELECT_ENHANCE
#	bool "Auto Channel Selection Enhancement"
#	depends on MT_AP_SUPPORT
```
