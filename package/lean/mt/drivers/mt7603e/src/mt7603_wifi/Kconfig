## package/lean/mt/drivers/mt7603e/src/mt7603_wifi/Kconfig
```kconfig
if FIRST_IF_MT7603E || SECOND_IF_MT7603E
config MT7603E_RLT_WIFI
	tristate "RLT 7603 WIFI Driver"
	select MT7603E_WIFI_BASIC_FUNC if MT7603E_RLT_WIFI

config MT7603E_MT_WIFI_PATH
        string
        depends on MT7603E_RLT_WIFI
        default "rlt_wifi"

if MT7603E_RLT_WIFI
menu "WiFi Generic Feature Options"

if FIRST_IF_MT7603E
choice
        prompt "EEPROM Type of 1st Card"
        depends on ! FIRST_IF_NONE

        config MT7603E_FIRST_IF_EEPROM_PROM
        bool "EEPROM"

        config MT7603E_FIRST_IF_EEPROM_EFUSE
        bool "EFUSE"

        config MT7603E_FIRST_IF_EEPROM_FLASH
        bool "FLASH"
endchoice

config MT7603E_RT_FIRST_CARD_EEPROM
        string
        depends on ! FIRST_IF_NONE
        default "prom" if MT7603E_FIRST_IF_EEPROM_PROM
        default "efuse" if MT7603E_FIRST_IF_EEPROM_EFUSE
        default "flash" if MT7603E_FIRST_IF_EEPROM_FLASH
endif
# endif FIRST_IF_MT7603E

if SECOND_IF_MT7603E
choice
        prompt "EEPROM Type of 2nd Card"
        depends on ! SECOND_IF_NONE

        config MT7603E_SECOND_IF_EEPROM_PROM
        bool "EEPROM"

        config MT7603E_SECOND_IF_EEPROM_EFUSE
        bool "EFUSE"

        config MT7603E_SECOND_IF_EEPROM_FLASH
        bool "FLASH"
endchoice

config MT7603E_RT_SECOND_CARD_EEPROM
        string
        depends on ! SECOND_IF_NONE
        default "prom" if MT7603E_SECOND_IF_EEPROM_PROM
        default "efuse" if MT7603E_SECOND_IF_EEPROM_EFUSE
        default "flash" if MT7603E_SECOND_IF_EEPROM_FLASH
endif
#endif SECOND_IF_MT7603E

config MT7603E_MULTI_INF_SUPPORT
        bool
        default y if !FIRST_IF_NONE && !SECOND_IF_NONE

config MT7603E_WIFI_BASIC_FUNC
	bool "Basic Functions"
	select WIRELESS_EXT
	select WEXT_SPY
	select WEXT_PRIV
        
config MT7603E_WSC_INCLUDED
	bool "WSC (WiFi Simple Config)"
	depends on WIFI_DRIVER
    default y

config MT7603E_WSC_V2_SUPPORT
	bool "WSC V2(WiFi Simple Config Version 2.0)"
	depends on WIFI_DRIVER
    default y

config MT7603E_WSC_NFC_SUPPORT
	bool "WSC out-of-band(NFC)"
        depends on WIFI_DRIVER
    	default n

config MT7603E_DOT11N_DRAFT3
	bool "802.11n Draft3"
	depends on WIFI_DRIVER
    default n
    
#config MT7603E_DOT11_VHT_AC
#	bool "802.11 ac"
#	depends on WIFI_DRIVER
#    default n
    
config MT7603E_DOT11W_PMF_SUPPORT
	bool "PMF"
	depends on WIFI_DRIVER
    default y

#config MT7603E_TXBF_SUPPORT
#    bool "Tx Bean Forming Support"
#    depends on WIFI_DRIVER
#    default n

#config MT7603E_WMM_ACM_SUPPORT
#	bool "WMM ACM"
#	depends on WIFI_DRIVER
#   default n
	
config MT7603E_LLTD_SUPPORT
	bool "LLTD (Link Layer Topology Discovery Protocol)"
	depends on WIFI_DRIVER
    default y

config MT7603E_QOS_DLS_SUPPORT
	bool "802.11e DLS ((Direct-Link Setup) Support"
	depends on WIFI_DRIVER
    default n


config MT7603E_WAPI_SUPPORT
	bool "WAPI Support"
	depends on WIFI_DRIVER
    default y

config MT7603E_CARRIER_DETECTION_SUPPORT
	bool "Carrier Detect"
	depends on WIFI_DRIVER
    default n

config MT7603E_IGMP_SNOOP_SUPPORT
	bool "IGMP Snooping"
	depends on WIFI_DRIVER
    default n

config MT7603E_BLOCK_NET_IF
	bool "NETIF Block"
	depends on WIFI_DRIVER
    default n
	help
	Support Net interface block while Tx-Sw queue full

config MT7603E_TXBF_SUPPORT
    bool "Tx Bean Forming Support (Only 3883)"
    depends on WIFI_DRIVER
    depends on RALINK_RT2883 || RALINK_RT3883
    default n
#
# optimize dma cache mapping for internal mips platform
#
config MT7603E_DMA_CACHE_OPTIMIZE
	bool "optimize dma cache mapping for internal mips platform"
	depends on WIFI_DRIVER
	default n

#config MT7603E_VIDEO_TURBINE_SUPPORT
#	bool "Video Turbine support"
#	depends on WIFI_DRIVER
#   default n

#config MT7603E_RA_CLASSIFIER
#	tristate "Ralink Flow Classifier"
#	depends on WIFI_DRIVER
#	default n

config MT7603E_RATE_ADAPTION
    bool "New Rate Adaptation support"
    depends on WIFI_DRIVER
    default y

config MT7603E_NEW_RATE_ADAPT_SUPPORT
    bool "Intelligent Rate Adaption"
    depends on WIFI_DRIVER && MT7603E_RATE_ADAPTION
    default y

config MT7603E_AGS_SUPPORT
	bool "Adaptive Group Switching"
	depends on WIFI_DRIVER && MT7603E_RATE_ADAPTION
    default n
    
config MT7603E_IDS_SUPPORT
	bool "IDS (Intrusion Detection System) Support"
	depends on WIFI_DRIVER
    default n

config MT7603E_WIFI_WORK_QUEUE
	bool "Work Queue"
	depends on WIFI_DRIVER
    default n

config MT7603E_WIFI_SKB_RECYCLE
    bool "SKB Recycle(Linux)"
    depends on WIFI_DRIVER
    default n

config MT7603E_PUSH_SUPPORT
    bool "Config Push Support"
    depends on WIFI_DRIVER
    default n

#config MT7603E_EASY_SETUP_SUPPORT
#    bool "Whole Home Coverage - Easy Setup"
#    depends on WIFI_DRIVER
#    default n

config MT7603E_EVENT_NOTIFIER_SUPPORT
    bool "Whole Home Coverage - Event Notifier"
    depends on WIFI_DRIVER
    default n

config MT7603E_SMART_CARRIER_SENSE_SUPPORT
    bool "Smart Carrier Sense"
    depends on WIFI_DRIVER
    default y
config MT7603E_MBO_SUPPORT
	bool "MBO Support"
	depends on WIFI_DRIVER
	select INTERWORKING
	select WNM_SUPPORT
	select DOT11K_RRM_SUPPORT
	select DOT11R_FT_SUPPORT
	select DOT11W_PMF_SUPPORT
	select PASSPOINT_R2
	default n
config MT7603E_RTMP_FLASH_SUPPORT
	bool "Flash Support"
	depends on WIFI_DRIVER
    default n

config MT7603E_MWDS_SUPPORT
    bool "Mixed WDS(MWDS)"
    default n

config MT7603E_AIR_MONITOR_SUPPORT
	bool "Air Monitor Support"
	depends on WIFI_DRIVER
    default n

config MT7603E_STA_FORCE_ROAM_SUPPORT
	bool "Sta Force Roam Support"
	depends on WIFI_DRIVER
    default n

config MT7603E_ROAMING_ENHANCE_SUPPORT
	bool "Roaming Enhance Support"
	depends on WIFI_DRIVER
    default n

config MT7603E_WIFI_FWD_UPDATED
	bool "Wifi Forwarding Support Update"
	depends on WIFI_DRIVER
    default n

config MT_BTCOEX_CONCURRENT
    bool "Coexisence Event Notify between BT and WiFi"
    depends on WIFI_DRIVER
    default n

config MT7603E_LED_CONTROL_SUPPORT
	bool "LED Support"
	depends on WIFI_DRIVER
    default n

config MT7603E_SINGLE_SKU_V2
    bool "Single SKU V2"
    depends on WIFI_DRIVER
    default n

config MT7603E_HW_ANTENNA_DIVERSITY
	bool "Antenna Diversity Support"
	depends on MT7603E_RLT_AP_SUPPORT || RLT_STA_SUPPORT
	depends on RALINK_RT5350
    default n

config MT7603E_ATE_SUPPORT
	bool "ATE/QA Support"
	depends on WIFI_DRIVER
    default y

config MT7603E_RT2860V2_AP_V24_DATA_STRUCTURE
	bool
	depends on WIFI_DRIVER
	default y

config  MT7603E_RT2860V2_AP_32B_DESC
	bool "32 Byte Descriptor Support"
	depends on WIFI_DRIVER
	depends on MT7603E_RALINK_RT6352 || RALINK_MT7620
	default n

config MT7603E_MEMORY_OPTIMIZATION
	bool "Memory Optimization"
	depends on WIFI_DRIVER
    default n

config MT7603E_RTMP_INTERNAL_TX_ALC
    bool "TSSI Compensation"
    depends on WIFI_DRIVER
    depends on RALINK_RT3350 || RALINK_RT3352 || RALINK_RT5350 || MT7603E_RALINK_RT6352
	default n
    
config MT7603E_RTMP_TEMPERATURE_CALIBRATION
    bool "Temperature Calibration"
    depends on WIFI_DRIVER
    depends on MT7603E_RALINK_RT6352
    default n

config MT7603E_HOTSPOT
	bool "Passpoint-R1"
	depends on WIFI_DRIVER
    default n

config MT7603E_PASSPOINT_R2
	bool "Passpoint Release-2 Support"
	depends on MT7603E_HOTSPOT
	select MT7603E_DOT11W_PMF_SUPPORT
	default n

config MT7603E_UAPSD
	bool "MT7603E_UAPSD support"
	depends on WIFI_DRIVER
	default y

#config MT7603E_EPA_ELNA
#	bool "ePAeLNA"
#	depends on WIFI_DRIVER
#	default n

choice
        prompt "PA,LNA Type"
        depends on MT7603E_RLT_WIFI

        config MT7603E_IPA_ILNA
        bool "iPAiLNA"

        config MT7603E_IPA_ELNA
        bool "iPAeLNA"

        config MT7603E_EPA_ILNA
        bool "ePAiLNA"

        config MT7603E_EPA_ELNA
        bool "ePAeLNA"
endchoice

config MT7603E_PA_LNA
        string
        depends on MT7603E_RLT_WIFI
        default "iPAiLNA" if MT7603E_IPA_ILNA
        default "iPAeLNA" if MT7603E_IPA_ELNA
        default "ePAiLNA" if MT7603E_EPA_ILNA
        default "ePAeLNA" if MT7603E_EPA_ELNA

#
# Section for chip architectures
#
# "RLT MAC Support"
config MT7603E_RLT_MAC
	bool
	depends on WIFI_DRIVER
	default n

config MT7603E_RLT_BBP
	bool

config MT7603E_RLT_RF
	bool

# "RTMP MAC Support"
config MT7603E_RTMP_MAC
	bool
	depends on WIFI_DRIVER
	default n

config MT7603E_RTMP_BBP
    	bool

config MT7603E_RTMP_RF
    	bool

#
# Section for interfaces
#
config MT7603E_RTMP_PCI_SUPPORT
    	bool

config MT7603E_RTMP_USB_SUPPORT
	bool

config MT7603E_RTMP_RBUS_SUPPORT
    	bool

endmenu

menu "WiFi Operation Modes"
    choice
        prompt "Main Mode"
        default MT7603E_WIFI_MODE_AP

        config MT7603E_WIFI_MODE_AP
                bool "AP"

        config MT7603E_WIFI_MODE_STA
                bool "STA"

        config MT7603E_WIFI_MODE_BOTH
                bool "APSTA"
    endchoice

    if MT7603E_WIFI_MODE_AP || MT7603E_WIFI_MODE_BOTH
        source "drivers/net/wireless/mtk/mt7603e/mt7603_wifi_ap/Kconfig"
    endif

    #if MT7603E_WIFI_MODE_STA || MT7603E_WIFI_MODE_BOTH
     #   source "drivers/net/wireless/rlt_wifi_sta/Kconfig"
    #endif
endmenu	

#"RT2860 series"
config MT7603E_RALINK_RT28XX
        bool
        default n
        select MT7603E_RTMP_PCI_SUPPORT

#"RT3092"
config MT7603E_RALINK_RT3092
        bool
        default n
        select MT7603E_RTMP_PCI_SUPPORT

#"RT3572"
config MT7603E_RALINK_RT3572
        bool
        default n
        select MT7603E_RTMP_USB_SUPPORT

#"RT5392"
config MT7603E_RALINK_RT5392
        bool
        default n
        select MT7603E_RTMP_PCI_SUPPORT

#"RT5572"
config MT7603E_RALINK_RT5572
        bool
        default n
        select MT7603E_RTMP_USB_SUPPORT

#"RT5592"
config MT7603E_RALINK_RT5592
        bool
        default n
        select MT7603E_RTMP_PCI_SUPPORT

#"MT7620/RT6352"
config MT7603E_RALINK_RT6352
        bool
        default n
        select MT7603E_RTMP_RBUS_SUPPORT
#        select MT7603E_RTMP_TEMPERATURE_CALIBRATION
#        select MT7603E_RTMP_INTERNAL_TX_ALC

#"MT7610E"
config MT7603E_RALINK_MT7610E
        bool
        default n
        select MT7603E_RTMP_PCI_SUPPORT

#"MT7610U"
config MT7603E_RALINK_MT7610U
        bool
        default n
        select MT7603E_RTMP_USB_SUPPORT

#"RT8592"
config MT7603E_RALINK_RT8592
        bool
        default n
        select MT7603E_RTMP_PCI_SUPPORT

#"MT7612E"
config MT7603E_RALINK_MT7612E
        bool
        default n
        select MT7603E_RTMP_PCI_SUPPORT

#"MT7612U"
config MT7603E_RALINK_MT7612U
        bool
        default n
        select MT7603E_RTMP_USB_SUPPORT

#"MT7603E"
config MT7603E_RALINK_MT7603E
        bool
        default y
        select MT7603E_RTMP_PCI_SUPPORT

#"MT7603U"
config MT7603E_RALINK_MT7603U
        bool
        default n
        select MT7603E_RTMP_USB_SUPPORT

endif

#if MT7603E_RLT_MAC
#	config MT7603E_RLT_MAC
#		bool
#		default y
#endif

#if MT7603E_RTMP_MAC
#	config MT7603E_RTMP_MAC
#		bool
#		default y
#endif

if MT7603E_RALINK_MT7603E
	config MT7603E_MT_MAC
		bool
		default y
endif

if MT7603E_RALINK_MT7603U
	config MT7603E_MT_MAC
		bool
		default y
endif
endif
#endif FIRST_IF_MT7603E || SECOND_IF_MT7603E
```
