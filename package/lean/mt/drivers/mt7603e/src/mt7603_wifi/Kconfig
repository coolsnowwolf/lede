## package/lean/mt/drivers/mt7615d/src/mt_wifi/os/linux/Kconfig.mt_wifi_3_18
```kconfig
#############
# Wireless
#############
menuconfig MTK_WIFI_DRIVER
	bool "Mediatek WiFi Driver Support"
	select WIFI_DRIVER
	
	config WIFI_DRIVER
	bool
	
if WIFI_DRIVER

choice
	prompt "Choose First WiFi Interface"
	config FIRST_IF_NONE
	bool "None"

	config FIRST_IF_RT2860
	bool "RT2860 for rt2860v2 wifi driver"
	select WIFI_RTMP_MAC
	select RALINK_RT2860
	
	config FIRST_IF_MT7620
	bool "MT7620 for rlt_wifi wifi driver"
	select WIFI_RTMP_MAC
	select RALINK_RT6352

	config FIRST_IF_MT7628
	bool "MT7628 for rlt_wifi wifi driver"
	depends on RALINK_MT7628
	select WIFI_MT_MAC

	config FIRST_IF_RT3092
	bool "RT3092"
	select WIFI_RTMP_MAC
	select RALINK_RT3092
    
	config FIRST_IF_RT5392
	bool "RT5392"
	select WIFI_RTMP_MAC
	select RALINK_RT5392
    	
	config FIRST_IF_RT5592
	bool "RT5592"
	select WIFI_RTMP_MAC
	select RALINK_RT5592
	
	config FIRST_IF_RT3593
	bool "RT3593"
	select WIFI_RTMP_MAC
	select RALINK_RT3593
    
	config FIRST_IF_MT7610E
	bool "MT7610E"
	select WIFI_RLT_MAC
	select RALINK_MT7610E
    
	config FIRST_IF_MT7612E
	bool "MT7612E"
	select WIFI_RLT_MAC
	select RALINK_MT7612E

	config FIRST_IF_MT7602E
	bool "MT7602E"
	select WIFI_RLT_MAC
	select RALINK_MT7602E

	config FIRST_IF_MT7603E
	bool "MT7603E"
	select WIFI_MT_MAC
	select CHIP_MT7603E

	config FIRST_IF_MT7615E
	bool "MT7615E"
	select WIFI_MT_MAC
	select MT_MAC
	select CHIP_MT7615E
endchoice

choice
	prompt "Choose Second WiFi Interface"
	config SECOND_IF_NONE
	bool "None"

	config SECOND_IF_RT3092
	bool "RT3092"
	select WIFI_RTMP_MAC
	select RALINK_RT3092
    
	config SECOND_IF_RT5392
	bool "RT5392"
	select WIFI_RTMP_MAC
	select RALINK_RT5392
    	
	config SECOND_IF_RT5592
	bool "RT5592"
	select WIFI_RTMP_MAC
	select RALINK_RT5592
	
	config SECOND_IF_RT3593
	bool "RT3593"
	select WIFI_RTMP_MAC
	select RALINK_RT3593
    
	config SECOND_IF_RT3572
	bool "RT3572"
	select WIFI_RTMP_MAC
	select RALINK_RT3572

	config SECOND_IF_RT5572
	bool "RT5572"
	select WIFI_RTMP_MAC
	select RALINK_RT5572
    
	config SECOND_IF_MT7620
	bool "MT7620"
	select WIFI_RTMP_MAC
	select RALINK_RT6352
    
	config SECOND_IF_MT7610U
	bool "MT7610U"
	select WIFI_RLT_MAC
	select RALINK_MT7610U
    
	config SECOND_IF_MT7610E
	bool "MT7610E"
	select WIFI_RLT_MAC
	select RALINK_MT7610E
    
	config SECOND_IF_RT8592
	bool "RT85592"
	select WIFI_RLT_MAC
	select RALINK_RT8592
	
	config SECOND_IF_MT7612U
	bool "MT7612U"
	select WIFI_RLT_MAC
	select RALINK_MT7612U
    
	config SECOND_IF_MT7612E
	bool "MT7612E"
	select WIFI_RLT_MAC
	select RALINK_MT7612E

	config SECOND_IF_MT7602E
	bool "MT7602E"
	select WIFI_RLT_MAC
	select RALINK_MT7602E

	config SECOND_IF_MT7603E
	bool "MT7603E"
	select WIFI_MT_MAC
	select CHIP_MT7603E

	config SECOND_IF_MT7615E
	bool "MT7615E"
	select WIFI_MT_MAC
	select CHIP_MT7615E
endchoice

config  RT_FIRST_CARD
        int
        depends on ! FIRST_IF_NONE
        default 2860 if FIRST_IF_RT2860
        default 7620 if FIRST_IF_MT7620
        default 7628 if FIRST_IF_MT7628
        default 3090 if FIRST_IF_RT3092
        default 5392 if FIRST_IF_RT5392
        default 5592 if FIRST_IF_RT5592
        default 3593 if FIRST_IF_RT3593
        default 7610 if FIRST_IF_MT7610E
	default 7612 if FIRST_IF_MT7612E
	default 7602 if FIRST_IF_MT7602E
	default 7603 if FIRST_IF_MT7603E
	default 7615 if FIRST_IF_MT7615E
        
config  RT_SECOND_CARD
        int
        depends on ! SECOND_IF_NONE
        default 3090 if SECOND_IF_RT3092
        default 5392 if SECOND_IF_RT5392
        default 5592 if SECOND_IF_RT5592
        default 3593 if SECOND_IF_RT3593
        default 7610 if SECOND_IF_MT7610E
        default 8592 if SECOND_IF_RT8592
        default 3572 if SECOND_IF_RT3572
        default 5572 if SECOND_IF_RT5572
	default 7612 if SECOND_IF_MT7612E || SECOND_IF_MT7612U
	default 7602 if SECOND_IF_MT7602E
	default 7603 if SECOND_IF_MT7603E
        default 7615 if SECOND_IF_MT7615E

config  RT_FIRST_IF_RF_OFFSET
        hex
        depends on ! FIRST_IF_NONE
        default 0x40000

config  RT_SECOND_IF_RF_OFFSET
        hex
        depends on ! SECOND_IF_NONE
        default 0x48000

config  RT2860V2_2850
        bool "Dual Band"
        depends on RALINK_RT2880

choice
        prompt "RF Type"
        depends on RALINK_RT5350 
        default RALINK_RT5350_1T1R

        config  RALINK_RT5350_1T1R
        bool "1T1R"
endchoice

choice
        prompt "RF Type"
        depends on RALINK_RT3052
        default RALINK_RT3052_2T2R

        config  RALINK_RT3050_1T1R
        bool "1T1R"

        config  RALINK_RT3051_1T2R
        bool "1T2R"

        config  RALINK_RT3052_2T2R
        bool "2T2R"
endchoice

choice
        prompt "RF Type"
        depends on  RALINK_RT3352 

        config  RALINK_RT3352_2T2R
        bool "2T2R"
endchoice

choice
	prompt "RF Type"
	depends on RALINK_RT3883

	config  RALINK_RT3662_2T2R
	bool "2T3R (RT3662)"

	config  RALINK_RT3883_3T3R
	bool "3T3R (RT3883)"
endchoice

config RTDEV_MII
    bool
    default y if RT2880v2_INIC_MII || RT305x_INIC_MII || RT305x_INIC_USB || RT3680_iNIC_AP

config RTDEV
	bool
	default y if WIFI_DRIVER && !SECOND_IF_NONE || RTDEV_MII
	default y if RTDEV_PLC




config MT_WIFI
	tristate "MT WIFI Driver"
	select WIFI_BASIC_FUNC if MT_WIFI

config MT_WIFI_PATH
		string
		depends on MT_WIFI
		default "mt_wifi"

if MT_WIFI
menu "WiFi Generic Feature Options"
choice
		prompt "EEPROM Type of 1st Card"
		depends on ! FIRST_IF_NONE

		config FIRST_IF_EEPROM_FLASH
		bool "FLASH"

		config FIRST_IF_EEPROM_EFUSE
		bool "EFUSE"
endchoice

config RT_FIRST_CARD_EEPROM
		string
		depends on ! FIRST_IF_NONE
		default "flash" if FIRST_IF_EEPROM_FLASH

choice
		prompt "EEPROM Type of 2nd Card"
		depends on ! SECOND_IF_NONE

		config SECOND_IF_EEPROM_FLASH
		bool "FLASH"

		config SECOND_IF_EEPROM_PROM
		bool "EEPROM"

		config SECOND_IF_EEPROM_EFUSE
		bool "EFUSE"

endchoice

config RT_SECOND_CARD_EEPROM
		string
		depends on ! SECOND_IF_NONE
		default "prom" if SECOND_IF_EEPROM_PROM
		default "efuse" if SECOND_IF_EEPROM_EFUSE
		default "flash" if SECOND_IF_EEPROM_FLASH

choice
		prompt "EEPROM Type of 3th Card"
		depends on ! THIRD_IF_NONE

		config THIRD_IF_EEPROM_FLASH
		bool "FLASH"

		config THIRD_IF_EEPROM_PROM
		bool "EEPROM"

		config THIRD_IF_EEPROM_EFUSE
		bool "EFUSE"

endchoice

config RT_THIRD_CARD_EEPROM
		string
		depends on ! THIRD_IF_NONE
		default "prom" if THIRD_IF_EEPROM_PROM
		default "efuse" if THIRD_IF_EEPROM_EFUSE
		default "flash" if THIRD_IF_EEPROM_FLASH
	
config MULTI_INF_SUPPORT
		bool
		default y if !FIRST_IF_NONE && !SECOND_IF_NONE
		
config WIFI_BASIC_FUNC
	bool "Basic Functions"
	select WIRELESS_EXT
	select WEXT_SPY
	select WEXT_PRIV

config DOT11_N_SUPPORT
	bool "802.11n support"
	default y

config DOT11_VHT_AC
	bool "802.11AC support"
	depends on WIFI_DRIVER
	depends on DOT11_N_SUPPORT
	default y

config G_BAND_256QAM_SUPPORT
    bool "2.4G 256QAM support"
	depends on WIFI_DRIVER
    depends on DOT11_VHT_AC
	default y

config BRCM_256QAM_SUPPORT
    bool "BRCM 2.4G 256QAM support"
	depends on WIFI_DRIVER
    depends on G_BAND_256QAM_SUPPORT
	default y

config ICAP_SUPPORT
	bool "ICAP Support"
	depends on WIFI_DRIVER
	depends on MT_AP_SUPPORT
	default y

config SPECTRUM_SUPPORT
	bool "Wifi Spectrum Support"
	depends on WIFI_DRIVER
	depends on MT_AP_SUPPORT
	default y

config BACKGROUND_SCAN_SUPPORT
	bool "Background Scan Support"
	depends on WIFI_DRIVER
	default y
	
config SMART_CARRIER_SENSE_SUPPORT
	bool "Smart Carrier Sense Support"
	depends on WIFI_DRIVER
	default y
	
config MT_DFS_SUPPORT
        bool "Dynamic Frequency Selection Support"	
        depends on WIFI_DRIVER
        default y

#config WFA_VHT_R2_PF
#    bool "WFA VHT R2 Plugfest"
#    depends on DOT11_VHT_AC
#    default n

config HDR_TRANS_TX_SUPPORT
    bool "Tx Header Translation"
    depends on CHIP_MT7615E
    default y

config HDR_TRANS_RX_SUPPORT
    bool "Rx Header Translation"
    depends on CHIP_MT7615E
    default y

config DBDC_MODE
	bool "dbdc mode support"
	default y

config SUPPORT_DYNAMIC_TXOP
    bool "dynamic txop support"
	default n
        
config WSC_INCLUDED
	bool "WSC (WiFi Simple Config)"
	depends on WIFI_DRIVER
	depends on MT_AP_SUPPORT || MT_STA_SUPPORT
	default y

config WSC_V2_SUPPORT
	bool "WSC V2(WiFi Simple Config Version 2.0)"
	depends on WIFI_DRIVER
	depends on MT_AP_SUPPORT || MT_STA_SUPPORT
	default y

config DOT11W_PMF_SUPPORT
	bool "PMF"
	depends on WIFI_DRIVER
	depends on MT_AP_SUPPORT
	default y

config TXBF_SUPPORT
        bool "Tx Bean Forming Support"
        depends on WIFI_DRIVER
        default y

config VHT_TXBF_2G_EPIGRAM_IE_SUPPORT
    bool "BRCM 2.4G VHT Sounding support"
        depends on WIFI_DRIVER
        depends on TXBF_SUPPORT
        default n

#config LLTD_SUPPORT
#	bool "LLTD (Link Layer Topology Discovery Protocol)"
#	depends on WIFI_DRIVER
#	depends on MT_AP_SUPPORT
#	default n

#config QOS_DLS_SUPPORT
#	bool "802.11e DLS ((Direct-Link Setup) Support"
#	depends on WIFI_DRIVER
#	depends on MT_AP_SUPPORT
#	default n

#config WAPI_SUPPORT
#	bool "WAPI Support"
#	depends on WIFI_DRIVER
#	default n

#config FTM_SUPPORT
#	bool "FTM Support"
#	depends on WIFI_DRIVER
#	select PASSPOINT_R2
#	default n

#config CARRIER_DETECTION_SUPPORT
#	bool "Carrier Detect"
#	depends on WIFI_DRIVER
#	default n

config IGMP_SNOOP_SUPPORT
	bool "IGMP snooping"
	depends on WIFI_DRIVER
	depends on MT_AP_SUPPORT
	default y

#config BLOCK_NET_IF
#	bool "NETIF Block"
#	depends on WIFI_DRIVER
#	depends on MT_AP_SUPPORT
#	default n
#	help
#	Support Net interface block while Tx-Sw queue full

#config RATE_ADAPTION
#	bool "New Rate Adaptation support"
#	depends on WIFI_DRIVER
#	default y

#config NEW_RATE_ADAPT_SUPPORT
#	bool "Intelligent Rate Adaption"
#	depends on WIFI_DRIVER && RATE_ADAPTION
#	default y

#config AGS_SUPPORT
#	bool "Adaptive Group Switching"
#	depends on WIFI_DRIVER && RATE_ADAPTION
#	depends on MT_AP_SUPPORT || MT_STA_SUPPORT
#	default n

#config RATE_ADAPT_AGBS_SUPPORT
#	bool "Adaptive AGBS Mode"
#	depends on WIFI_DRIVER && RATE_ADAPTION
#	depends on MT_AP_SUPPORT || MT_STA_SUPPORT
#	default y

#config IDS_SUPPORT
#	bool "IDS (Intrusion Detection System) Support"
#	depends on WIFI_DRIVER
#	depends on MT_AP_SUPPORT
#	default n

#config WIFI_WORK_QUEUE
#	bool "Work Queue"
#	depends on WIFI_DRIVER
#	default n

#config WIFI_SKB_RECYCLE
#	bool "SKB Recycle(Linux)"
#	depends on WIFI_DRIVER
#	depends on MT_AP_SUPPORT
#	default n

config RTMP_FLASH_SUPPORT
	bool "Flash Support"
	depends on WIFI_DRIVER
	default y

config PRE_CAL_TRX_SET1_SUPPORT
    bool "CalibrationToFlash Support"
    depends on WIFI_DRIVER
    depends on RTMP_FLASH_SUPPORT
    default n

#config LED_CONTROL_SUPPORT
#	bool "LED Support"
#	depends on WIFI_DRIVER
#	depends on MT_AP_SUPPORT
#	default n

config ATE_SUPPORT
	bool "ATE/QA Support"
	depends on WIFI_DRIVER
	depends on MT_AP_SUPPORT
	default n	

#config MEMORY_OPTIMIZATION
#	bool "Memory Optimization"
#	depends on WIFI_DRIVER
#	default n

#config PASSPOINT_R2
#	bool "Passpoint Release-2 Support"
#	depends on WIFI_DRIVER
#	select DOT11W_PMF_SUPPORT
#	depends on MT_AP_SUPPORT
#	default n

#config TRACE_TCP_PKT
#       bool "TCP DATA/ACK packets trace log"
#       depends on WIFI_DRIVER
#       default n

config UAPSD
	bool "UAPSD support"
	depends on WIFI_DRIVER
	depends on MT_AP_SUPPORT || MT_STA_SUPPORT
	default y

#config TCP_RACK_SUPPORT
#	bool "TCP Reduced ACK  support"
#	depends on WIFI_DRIVER
#	default n

#
# Section for chip architectures
#
# "RLT MAC Support"
config RLT_MAC
	bool
	depends on WIFI_DRIVER
	default n

config RLT_BBP
	bool

config RLT_RF
	bool

# "RTMP MAC Support"
config RTMP_MAC
	bool
	depends on WIFI_DRIVER
	default n

config RTMP_BBP
    	bool

config RTMP_RF
    	bool

#
# Section for interfaces
#
config RTMP_PCI_SUPPORT
    	bool

config RTMP_USB_SUPPORT
		bool

config RTMP_RBUS_SUPPORT
    	bool

endmenu

menu "WiFi Operation Modes"
	choice
		prompt "Main Mode"
		default WIFI_MODE_AP

		config WIFI_MODE_AP
				bool "AP"
				#select MT_AP_SUPPORT

		config WIFI_MODE_STA
				bool "STA"
				select MT_STA_SUPPORT

		config WIFI_MODE_BOTH
				bool "APSTA"
				select MT_AP_SUPPORT
				select MT_STA_SUPPORT
    endchoice

    if WIFI_MODE_AP || WIFI_MODE_BOTH
		source "drivers/net/wireless/mt_wifi_ap/Kconfig"
    endif

    if WIFI_MODE_STA || WIFI_MODE_BOTH
#		source "drivers/net/wireless/mt_wifi_sta/Kconfig"
    endif
endmenu	

endif

if WIFI_RLT_MAC
	config RLT_MAC
		bool
		default y
endif

if WIFI_RTMP_MAC
	config RTMP_MAC
		bool
		default y
endif

if WIFI_MT_MAC
	config MT_MAC
		bool
		default y

	config CHIP_MT7603E
		bool
		default n

	config CHIP_MT7615E
		bool
		default n
endif

if CHIP_MT7615E
	config MT_MAC
		bool
		default y
		select RATE_ADAPTION
		select RATE_ADAPT_AGBS_SUPPORT
		select DOT11_N_SUPPORT
		select DOT11_VHT_AC
		select HDR_TRANS_TX_SUPPORT
		select HDR_TRANS_RX_SUPPORT
endif	

endif #WIFI_DRIVER
```

## package/lean/mt/drivers/mt7615d/src/mt_wifi/os/linux/Kconfig.mt_wifi_sta
```kconfig
config MT_STA_SUPPORT
	tristate "Ralink RT2860 802.11n/ac STA support"
#	depends on NET_RADIO 
	select WIRELESS_EXT
	select WEXT_SPY
	select WEXT_PRIV

config  ETH_CONVERT_SUPPORT
	bool "Ethernet Convert Mode Support"
	depends on MT_STA_SUPPORT
	default y

config COEX_SUPPORT
	bool "Coex Support"
	depends on MT_STA_SUPPORT
	default n

#config MUMIMO_SUPPORT
#        bool "MU-MIMO Support"
#        depends on WIFI_DRIVER
#        default y

#config DOT11R_FT_SUPPORT
#	bool "802.11r Fast BSS Transition"
#	depends on MT_STA_SUPPORT

#config DOT11K_RRM_SUPPORT
#	bool "802.11k Radio Resource Management"
#	depends on MT_STA_SUPPORT

#config SNIFFER_SUPPORT
#	bool "SNIFFER"
#	depends on MT_STA_SUPPORT
#	default n

config CFG80211_SUPPORT
	bool "CFG80211"
	depends on MT_STA_SUPPORT
	depends on CFG80211
	default n

#config CON_WPS_SUPPORT
#	bool "Concurrent WPS Support"
#	depends on MT_STA_SUPPORT
#	depends on APCLI_SUPPORT
#	depends on WSC_INCLUDED
#	depends on WSC_V2_SUPPORT
#	default n
	
#config COC_SUPPORT
#	bool "CoC Support"
#	depends on MT_STA_SUPPORT
#	default n

#config  RT2860V2_SNMP
#	bool "Net-SNMP Support"
#	depends on MT_STA_SUPPORT

#config MCAST_RATE_SPECIFIC
#	bool "User specific tx rate of mcast pkt"
#	depends on MT_STA_SUPPORT

#config EXT_BUILD_CHANNEL_LIST
#	bool "Extension Channel List"
#	depends on MT_STA_SUPPORT

#config AUTO_CH_SELECT_ENHANCE
#	bool "Auto Channel Selection Enhancement"
#	depends on MT_STA_SUPPORT

#config AIRPLAY_SUPPORT
#	bool "AIRPLAY Support"
#	depends on MT_STA_SUPPORT
#	default n
```
