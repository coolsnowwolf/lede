## package/lean/mt/drivers/mt7615d/src/mt_wifi/os/linux/Kconfig.wifi
```kconfig
menu "Ralink Module"

###########
# Debuging
###########
source "drivers/net/rt_rdm/Kconfig"

#############
# Wire
#############

source "drivers/net/raeth/Kconfig"

#############
# Wireless
#############
menuconfig WIFI_DRIVER
	bool "WiFi Driver Support"

if WIFI_DRIVER

choice
	prompt "Choose First WiFi Interface"
	config FIRST_IF_NONE
	bool "None"

	config FIRST_IF_RT2860
	bool "RT2860"
	select RTMP_MAC
	select RALINK_RT2860
	
	config FIRST_IF_MT7620
	bool "MT7620"
	select RTMP_MAC
	select RALINK_RT6352

endchoice

choice 
	prompt "EEPROM Type of 1st Card"
	depends on ! FIRST_IF_NONE

	config FIRST_IF_EEPROM_PROM
	bool "EEPROM"
	        
	config FIRST_IF_EEPROM_EFUSE
	bool "EFUSE"
	        
	config FIRST_IF_EEPROM_FLASH
	bool "FLASH"
endchoice
	
choice
	prompt "Choose Second WiFi Interface"
	config SECOND_IF_NONE
	bool "None"

	config SECOND_IF_RT3092
	bool "RT3092"
	select RTMP_MAC
	select RALINK_RT3092
    
	config SECOND_IF_RT5392
	bool "RT5392"
	select RTMP_MAC
	select RALINK_RT5392
    	
	config SECOND_IF_RT5592
	bool "RT5592"
	select RTMP_MAC
	select RALINK_RT5592
	
	config SECOND_IF_RT3593
	bool "RT3593"
	select RTMP_MAC
	select RALINK_RT5392
    
	config SECOND_IF_RT3572
	bool "RT3572"
	select RTMP_MAC
	select RALINK_RT3572

	config SECOND_IF_RT5572
	bool "RT5572"
	select RTMP_MAC
	select RALINK_RT5572
    
	config SECOND_IF_MT7620
	bool "MT7620"
	select RTMP_MAC
	select RALINK_RT6352
    
	config SECOND_IF_MT7610U
	bool "MT7610U"
	select RLT_MAC
	select RALINK_MT7610U
    
	config SECOND_IF_MT7610E
	bool "MT7610E"
	select RLT_MAC
	select RALINK_MT7610E
    
	config SECOND_IF_RT8592
	bool "RT85592"
	select RLT_MAC
	select RALINK_RT8592
	
	config SECOND_IF_MT7612U
	bool "MT7612U"
	select RLT_MAC
	select RALINK_MT7612U
    
	config SECOND_IF_MT7612E
	bool "MT7612E"
	select RLT_MAC
	select RALINK_MT7612E

endchoice

choice 
	prompt "EEPROM Type of 2nd Card"
	depends on ! SECOND_IF_NONE

	config SECOND_IF_EEPROM_PROM
	bool "EEPROM"
	        
	config SECOND_IF_EEPROM_EFUSE
	bool "EFUSE"
	        
	config SECOND_IF_EEPROM_FLASH
	bool "FLASH"
endchoice


config  RT_FIRST_CARD
        int
        depends on ! FIRST_IF_NONE
        default 2860 if FIRST_IF_RT2860
        default 7620 if FIRST_IF_MT7620
        
config  RT_SECOND_CARD
        int
        depends on ! SECOND_IF_NONE
        default 3090 if SECOND_IF_RT3092
        default 5392 if SECOND_IF_RT5392
        default 5592 if SECOND_IF_RT5592
        default 3593 if SECOND_IF_RT3593
        default 7610 if SECOND_IF_MT7610E
        default 8592 if SECOND_IF_RT8592
        default 3572 if SECOND_IF_RT3572
        default 5572 if SECOND_IF_RT5572
		default 7612e if SECOND_IF_MT7612E
		default 7612u if SECOND_IF_MT7612U
		
        
config  RT_FIRST_IF_RF_OFFSET
        hex
        depends on ! FIRST_IF_NONE
        default 0x40000

config  RT_SECOND_IF_RF_OFFSET
        hex
        depends on ! SECOND_IF_NONE
        default 0x48000

config RT_FIRST_CARD_EEPROM
        string
        depends on ! FIRST_IF_NONE
        default "prom" if FIRST_IF_EEPROM_PROM
        default "efuse" if FIRST_IF_EEPROM_EFUSE
        default "flash" if FIRST_IF_EEPROM_FLASH

config RT_SECOND_CARD_EEPROM
        string
        depends on ! SECOND_IF_NONE
        default "prom" if SECOND_IF_EEPROM_PROM
        default "efuse" if SECOND_IF_EEPROM_EFUSE
        default "flash" if SECOND_IF_EERPROM_FLASH

config MULTI_INF_SUPPORT
        bool
        default y if !FIRST_IF_NONE && !SECOND_IF_NONE

config PCI_SUPPORT
        bool

config  RT2860V2_2850
        bool "Dual Band"
        depends on RALINK_RT2880

choice
        prompt "RF Type"
        depends on RALINK_RT5350 
        default RALINK_RT5350_1T1R

        config  RALINK_RT5350_1T1R
        bool "1T1R"
endchoice

choice
        prompt "RF Type"
        depends on RALINK_RT3052
        default RALINK_RT3052_2T2R

        config  RALINK_RT3050_1T1R
        bool "1T1R"

        config  RALINK_RT3051_1T2R
        bool "1T2R"

        config  RALINK_RT3052_2T2R
        bool "2T2R"
endchoice

choice
        prompt "RF Type"
        depends on  RALINK_RT3352 

        config  RALINK_RT3352_2T2R
        bool "2T2R"
endchoice

choice
	prompt "RF Type"
	depends on RALINK_RT3883

	config  RALINK_RT3662_2T2R
	bool "2T3R (RT3662)"

	config  RALINK_RT3883_3T3R
	bool "3T3R (RT3883)"
endchoice

config  RA_CLASSIFIER
	tristate "Ralink Flow Classifier"
	depends on RT2860V2_AP_VIDEO_TURBINE || RT2860V2_STA_VIDEO_TURBINE
	default n

config RTDEV_MII
    bool
    default y if RT2880v2_INIC_MII || RT305x_INIC_MII || RT305x_INIC_USB || RT3680_iNIC_AP

#config  UNIQUE_WPS
#	bool "Unique WPS for Concurrent AP"
#        depends on RT2860V2_AP_WSC 
#        depends on RT3090_AP_WSC || RT3572_AP_WSC || RT5392_AP_WSC || RT5572_AP_WSC || RT5592_AP_WSC
#	default n

    
choice
    prompt "Configuration Method Selection"
    default CONFIG_METHOD_OLD

    config CONFIG_METHOD_OLD
    bool "Legay"

    config CONFIG_METHOD_NEW
    bool "New"
    select WIFI_BASIC_FUNC
endchoice

if CONFIG_METHOD_OLD
    source "drivers/net/wireless/rt2860v2_ap/Kconfig"
    #source "drivers/net/wireless/rt2860v2_sta/Kconfig"
    #source "drivers/net/wireless/RTPCI_ap/Kconfig"
    #source "drivers/net/wireless/RT3090_ap/Kconfig"
    #source "drivers/net/wireless/RT5392_ap/Kconfig"
    #source "drivers/net/wireless/RT5592_ap/Kconfig"
    #source "drivers/net/wireless/RT3593_ap/Kconfig"
    #source "drivers/net/wireless/RT3572_ap/Kconfig"
    #source "drivers/net/wireless/RT5572_ap/Kconfig"
    #source "drivers/net/wireless/iNIC/Kconfig"
    #source "drivers/net/wireless/iNIC_RT305x/Kconfig"
    #source "drivers/net/wireless/RT3680_ap/Kconfig"
    #source "drivers/net/wireless/MT7610_ap/Kconfig"
endif

if CONFIG_METHOD_NEW
    menu "WiFi Generic Feature Options"
        source "drivers/net/wireless/rlt_wifi/Kconfig"
    endmenu

    menu "WiFi Operation Modes"
        choice
            prompt "Main Mode"
            default WIFI_MODE_AP

            config WIFI_MODE_AP
	        bool "AP"

            config WIFI_MODE_STA
	        bool "STA"
	        
	        config WIFI_MODE_BOTH
	        bool "APSTA"
        endchoice

        if WIFI_MODE_AP || WIFI_MODE_BOTH
        source "drivers/net/wireless/rlt_wifi_ap/Kconfig"
        endif

        if WIFI_MODE_STA || WIFI_MODE_BOTH
        source "drivers/net/wireless/rlt_wifi_sta/Kconfig"
        endif
    endmenu
    
#    menu "WiFi Chips"

#"RT2860 series"
config RALINK_RT28XX
        bool
        default n
        select RTMP_PCI_SUPPORT

#"RT3092"
config RALINK_RT3092
        bool
        default n
        select RTMP_PCI_SUPPORT

#"RT3572"
config RALINK_RT3572
        bool
        default n
        select RTMP_USB_SUPPORT

#"RT5392"
config RALINK_RT5392
        bool
        default n
        select RTMP_PCI_SUPPORT

#"RT5572"
config RALINK_RT5572
        bool
        default n
        select RTMP_USB_SUPPORT

#"RT5592"
config RALINK_RT5592
        bool
        default n
        select RTMP_PCI_SUPPORT

#"MT7620/RT6352"
config RALINK_RT6352
        bool
        default n
        select RTMP_RBUS_SUPPORT
#        select RTMP_TEMPERATURE_CALIBRATION
#        select RTMP_INTERNAL_TX_ALC

#"MT7610E"
config RALINK_MT7610E
        bool
        default n
        select RTMP_PCI_SUPPORT

#"MT7610U"
config RALINK_MT7610U
        bool
        default n
        select RTMP_USB_SUPPORT

#"RT8592"
config RALINK_RT8592
        bool
        default n
        select RTMP_PCI_SUPPORT

#"MT7612E"
config RALINK_MT7612E
        bool
        default n
        select RTMP_PCI_SUPPORT

#"MT7612U"
config RALINK_MT7612U
        bool
        default n
        select RTMP_USB_SUPPORT

#    endmenu
endif

endif # WIFI_DRIVER


config RTDEV
	bool
	default y if WIFI_DRIVER && !SECOND_IF_NONE || RTDEV_MII
	default y if RTDEV_PLC

#######
# USB
#######
source "drivers/usb/dwc_otg/Kconfig"

#######
# NAT
#######
choice
prompt "Ralink NAT Type"
	
config  RA_NAT_NONE
bool "None"
config  RA_NAT_HW
bool "Hardware"
depends on !RALINK_RT5350
endchoice

source "net/nat/hw_nat/Kconfig"


endmenu
```

## package/lean/mt/drivers/mt7615d/src/mt_wifi_ap/Kconfig
```kconfig
config MT_AP_SUPPORT
	tristate "MTK AP support"
#	depends on NET_RADIO
	select WIRELESS_EXT
	select WEXT_SPY
	select WEXT_PRIV

config WDS_SUPPORT
	bool "WDS"
	depends on MT_AP_SUPPORT
	default y

config WIFI_EAP_FEATURE
	bool "EAP Feature"
    depends on WIFI_DRIVER
	default y

config MBSS_SUPPORT
	bool "MBSSID"
	depends on MT_AP_SUPPORT
	default y

#config NEW_MBSSID_MODE
#	bool "New MBSSID MODE"
#	depends on MT_AP_SUPPORT && MBSS_SUPPORT
#	depends on RALINK_RT3883 || RALINK_RT3352 || RALINK_RT5350 || RALINK_RT6352 || RALINK_MT7620
#	default y

#config ENHANCE_NEW_MBSSID_MODE
#	bool "Enhanced MBSSID mode"
#	depends on NEW_MBSSID_MODE
#	default y

config APCLI_SUPPORT
	bool "AP-Client Support"
	depends on MT_AP_SUPPORT
	default y

config APCLI_CERT_SUPPORT
        bool "AP-Client TGn Cert Support"
	depends on MT_AP_SUPPORT
        depends on APCLI_SUPPORT
        default n

config MAC_REPEATER_SUPPORT
	bool "MAC Repeater Support"
	depends on MT_AP_SUPPORT
	depends on APCLI_SUPPORT
	depends on RALINK_RT6352 || RALINK_MT7620 || RALINK_MT7603E || MT_AP_SUPPORT
	default y

config MWDS
    bool "Mixed WDS(MWDS)"
    depends on MT_AP_SUPPORT
    select APCLI_SUPPORT
    default n

config MUMIMO_SUPPORT
        bool "MU-MIMO Support"
        depends on WIFI_DRIVER
        select MU_RA_SUPPORT
        default y

config MU_RA_SUPPORT
  	bool "MU-RGA Support"
  	depends on MUMIMO_SUPPORT

config DOT11R_FT_SUPPORT
	bool "802.11r Fast BSS Transition"
	depends on MT_AP_SUPPORT
	default n

config DOT11K_RRM_SUPPORT
	bool "802.11k Radio Resource Management"
	depends on MT_AP_SUPPORT
	default n

config INTERWORKING
	bool "802.11u Interworking/Gas Support"
        depends on MT_AP_SUPPORT
        default n

config MAP_SUPPORT
	bool "Multi-AP Support"
	depends on MT_AP_SUPPORT
	select MBO_SUPPORT
	default n
config OFFCHANNEL_SCAN_FEATURE
        bool "Channel Quality Monitor"
        depends on MT_AP_SUPPORT
        default n

config SNIFFER_SUPPORT
	bool "SNIFFER"
	depends on MT_AP_SUPPORT
	default n

config ENTERPRISE_AP_SUPPORT
	bool "Enterprise AP Support"
	depends on MT_AP_SUPPORT
	default n

config VLAN_SUPPORT
	bool "VLAN Support"
	depends on MT_AP_SUPPORT
	depends on ENTERPRISE_AP_SUPPORT
	default n

config DYNAMIC_VLAN_SUPPORT
	bool "Dynamic VLAN Support"
	depends on MT_AP_SUPPORT
	depends on ENTERPRISE_AP_SUPPORT
	default n

config CFG80211_SUPPORT
	bool "CFG80211"
	depends on MT_AP_SUPPORT
	default n

#CUSTOMISED HOSTAPD
config CUSTOMISED_HOSTAPD_SUPPORT
	bool "Customised Hostapd Support"
	depends on MT_AP_SUPPORT
	depends on CFG80211_SUPPORT
	default n

#APCLI STA
config APCLI_STA_SUPPORT
	bool "APCLI STA Support"
	depends on APCLI_SUPPORT
	depends on CFG80211_SUPPORT
	default n

#WDS STA
config WDS_STA_SUPPORT
	bool "WDS STA Support"
	depends on APCLI_SUPPORT
	depends on CFG80211_SUPPORT
	default n

#WDS AP
config MBSS_AS_WDS_AP_SUPPORT
	bool "MBSS AS WDS AP Support"
	depends on MT_AP_SUPPORT
	depends on MBSS_SUPPORT
	default n

config DSCP_QOS_MAP_SUPPORT
	bool "Dscp Qos Mapping Support"
	depends on MT_AP_SUPPORT
	default n

config DSCP_PRI_SUPPORT
	bool "Dscp Priority Mapping Support"
	depends on MT_AP_SUPPORT
	default n

#HOSTAPD_MAP_SUPPORT
config HOSTAPD_MAP_SUPPORT
	bool "MAP with Hostapd Support"
	depends on MT_AP_SUPPORT
	depends on CFG80211_SUPPORT
	depends on MAP_SUPPORT
	default n

config MIN_PHY_RATE_SUPPORT
        bool "Minimum PHY rate support"
        depends on MT_AP_SUPPORT
        default n

config FAST_UP_RATE_SUPPORT
        bool "Fast UP rate support"
        depends on MT_AP_SUPPORT
        default n

config RADIUS_MAC_AUTH_SUPPORT
        bool "RADIUS MAC Auth Support"
        depends on ENTERPRISE_AP_SUPPORT
        depends on CFG80211_SUPPORT
        default n

config CON_WPS_SUPPORT
	bool "Concurrent WPS Support"
	depends on MT_AP_SUPPORT
	depends on APCLI_SUPPORT
	depends on WSC_INCLUDED
	depends on WSC_V2_SUPPORT
#	depends on MULTI_INF_SUPPORT
	default n

#config LLTD_SUPPORT
#	bool "LLTD (Link Layer Topology Discovery Protocol)"
#	depends on MT_AP_SUPPORT

#config COC_SUPPORT
#	bool "CoC Support"
#	depends on MT_AP_SUPPORT
#	default n

config MCAST_RATE_SPECIFIC
	bool "User specific tx rate of mcast pkt"
	depends on MT_AP_SUPPORT
	default y

#config EXT_BUILD_CHANNEL_LIST
#	bool "Extension Channel List"
#	depends on MT_AP_SUPPORT

#config AUTO_CH_SELECT_ENHANCE
#	bool "Auto Channel Selection Enhancement"
#	depends on MT_AP_SUPPORT

config VOW_SUPPORT
	bool "MediaAir(VOW) support"
	depends on MT_AP_SUPPORT
	default y

#config AIRPLAY_SUPPORT
#	bool "AIRPLAY Support"
#	depends on MT_AP_SUPPORT
#	default n

config BAND_STEERING
	bool "Band Steering"
	depends on MT_AP_SUPPORT
	default y

config LED_CONTROL_SUPPORT
        bool "LED Control Support"
        default n

config WLAN_HOOK
       bool "WLAN hook Support"
       depends on WIFI_DRIVER
       default n

config RADIUS_ACCOUNTING_SUPPORT
	bool "Radius Accounting Support"
	depends on MT_AP_SUPPORT
	default n

config GREENAP_SUPPORT
	bool "GreenAP Support"
	depends on MT_AP_SUPPORT
	default y

config TXRX_STAT_SUPPORT
	bool "TxRx Stats Support"
	depends on WIFI_DRIVER
	default n

config PCIE_ASPM_DYM_CTRL_SUPPORT
	bool "Pcie Aspm Dynamic Control Support"
	depends on MT_AP_SUPPORT
	default y

config COEX_SUPPORT
	bool "Coex Support"
	depends on MT_AP_SUPPORT
	default n

config EASY_SETUP_SUPPORT
	bool "Whole Home Coverage - Easy Setup"
	depends on MT_AP_SUPPORT
	default n

config EVENT_NOTIFIER_SUPPORT
	bool "Whole Home Coverage - Event Notifier"
	depends on MT_AP_SUPPORT
	default n

config AIR_MONITOR
        bool "Air Monitor"
        depends on MT_AP_SUPPORT
        default n

config WNM_SUPPORT
        bool "802.11v WNM Support"
        depends on MT_AP_SUPPORT
        default n

config WIFI_MSI_SUPPORT
        bool "MSI support"
        depends on PCI_MSI
        depends on CHIP_MT7615E
        default n


#config ROAMING_ENHANCE_SUPPORT
#	bool "Roaming Enhance Support"
#	depends on MT_AP_SUPPORT
#	depends on APCLI_SUPPORT
#	default n

#config WIFI_FWD_SUPPORT
#        bool "WiFi Forwarding Support"
#        default n

config WPA3_SUPPORT
	bool "WPA3 support"
	depends on MT_AP_SUPPORT
	default y

config OWE_SUPPORT
	bool "Enhance OPEN(OWE) support"
	depends on MT_AP_SUPPORT
	depends on WPA3_SUPPORT
	default y

config VENDOR_FEATURE10_SUPPORT
        bool "Vendor10 Feature Enable"
        depends on WIFI_DRIVER
        depends on MT_AP_SUPPORT
        default n

config VENDOR_FEATURE11_SUPPORT
        bool "Vendor11 Feature Enable"
        depends on WIFI_DRIVER
        depends on MT_AP_SUPPORT
        default n

config RCSA_SUPPORT
	bool "Reverse-CSA"
	depends on WIFI_DRIVER
	depends on MT_DFS_SUPPORT
	depends on APCLI_SUPPORT
	default n
```

## package/lean/mt/drivers/mt_wifi/config.in
```kconfig
menu "MT_WIFI Configuration"
	depends on PACKAGE_mt_wifi

config MTK_CHIP_MT7603E_MT7612E
	bool "MTK_CHIP_MT7603E_MT7612E"
	default y if PACKAGE_kmod-mt7603e && PACKAGE_kmod-mt76x2e
	default n

config MTK_CHIP_MT7603E_MT7615E
	bool "MTK_CHIP_MT7603E_MT7615E"
	default y if PACKAGE_kmod-mt7603e && PACKAGE_kmod-mt7615d
	default n

config MTK_CHIP_MT7615E
	bool "MTK_CHIP_MT7615E"
	default y if PACKAGE_kmod-mt7615d && !PACKAGE_kmod-mt7603e
	default n

config MTK_CHIP_MT7615E_DBDC
	bool "MTK_CHIP_MT7615E_DBDC"
	depends on MTK_CHIP_MT7615E
	default y if TARGET_ramips_mt7621_DEVICE_jcg_y2
	default y if TARGET_ramips_mt7621_DEVICE_phicomm_k2p
	default n

endmenu
```
