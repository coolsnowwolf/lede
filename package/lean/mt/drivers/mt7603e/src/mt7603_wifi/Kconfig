## package/lean/mt/drivers/mt_wifi/src/mt_wifi_ap/Kconfig
```kconfig
config MT_AP_SUPPORT
	tristate "MTK AP support"
#	depends on NET_RADIO
	select WIRELESS_EXT
	select WEXT_SPY
	select WEXT_PRIV

config WDS_SUPPORT
	bool "WDS"
	depends on MT_AP_SUPPORT
	default y

config MBSS_SUPPORT
	bool "MBSSID"
	depends on MT_AP_SUPPORT
	default y

#config NEW_MBSSID_MODE
#	bool "New MBSSID MODE"
#	depends on MT_AP_SUPPORT && MBSS_SUPPORT
#	depends on RALINK_RT3883 || RALINK_RT3352 || RALINK_RT5350 || RALINK_RT6352 || RALINK_MT7620
#	default y

#config ENHANCE_NEW_MBSSID_MODE
#	bool "Enhanced MBSSID mode"
#	depends on NEW_MBSSID_MODE
#	default y

config APCLI_SUPPORT
	bool "AP-Client Support"
	depends on MT_AP_SUPPORT
	default y

config APCLI_CERT_SUPPORT
        bool "AP-Client TGn Cert Support"
	depends on MT_AP_SUPPORT
        depends on APCLI_SUPPORT
        default n

config MAC_REPEATER_SUPPORT
	bool "MAC Repeater Support"
	depends on MT_AP_SUPPORT
	depends on APCLI_SUPPORT
	depends on RALINK_RT6352 || RALINK_MT7620 || RALINK_MT7603E || MT_AP_SUPPORT
	default y

config MWDS
    bool "Mixed WDS(MWDS)"
    depends on MT_AP_SUPPORT
    select APCLI_SUPPORT
    default n

config MUMIMO_SUPPORT
        bool "MU-MIMO Support"
        depends on WIFI_DRIVER
        select MU_RA_SUPPORT
        default y

config MU_RA_SUPPORT
  	bool "MU-RGA Support"
  	depends on MUMIMO_SUPPORT

config DOT11R_FT_SUPPORT
	bool "802.11r Fast BSS Transition"
	depends on MT_AP_SUPPORT
	default n

config DOT11K_RRM_SUPPORT
	bool "802.11k Radio Resource Management"
	depends on MT_AP_SUPPORT
	default n

config MAP_SUPPORT
	bool "Multi-AP Support"
	depends on MT_AP_SUPPORT
	select MBO_SUPPORT
	default n

#config SNIFFER_SUPPORT
#	bool "SNIFFER"
#	depends on MT_AP_SUPPORT
#	default n

config CFG80211_SUPPORT
	bool "CFG80211"
	depends on MT_AP_SUPPORT
	default n

#config DSCP_PRI_SUPPORT
#	"Dscp Priority Mapping Support"
#	depends on MT_AP_SUPPORT
#	default n

config DSCP_PRI_SUPPORT
	bool "Dscp Priority Mapping Support"
	depends on MT_AP_SUPPORT
	default n

config CON_WPS_SUPPORT
	bool "Concurrent WPS Support"
	depends on MT_AP_SUPPORT
	depends on APCLI_SUPPORT
	depends on WSC_INCLUDED
	depends on WSC_V2_SUPPORT
#	depends on MULTI_INF_SUPPORT
	default n

#config LLTD_SUPPORT
#	bool "LLTD (Link Layer Topology Discovery Protocol)"
#	depends on MT_AP_SUPPORT

#config COC_SUPPORT
#	bool "CoC Support"
#	depends on MT_AP_SUPPORT
#	default n

config MCAST_RATE_SPECIFIC
	bool "User specific tx rate of mcast pkt"
	depends on MT_AP_SUPPORT
	default y

#config EXT_BUILD_CHANNEL_LIST
#	bool "Extension Channel List"
#	depends on MT_AP_SUPPORT

#config AUTO_CH_SELECT_ENHANCE
#	bool "Auto Channel Selection Enhancement"
#	depends on MT_AP_SUPPORT

config VOW_SUPPORT
	bool "MediaAir(VOW) support"
	depends on MT_AP_SUPPORT
	default y

#config AIRPLAY_SUPPORT
#	bool "AIRPLAY Support"
#	depends on MT_AP_SUPPORT
#	default n

config BAND_STEERING
	bool "Band Steering"
	depends on MT_AP_SUPPORT
	default y

config LED_CONTROL_SUPPORT
        bool "LED Control Support"
        default n

config WLAN_HOOK
       bool "WLAN hook Support"
       depends on WIFI_DRIVER
       default n

config RADIUS_ACCOUNTING_SUPPORT
	bool "Radius Accounting Support"
	depends on MT_AP_SUPPORT
	default n

config GREENAP_SUPPORT
	bool "GreenAP Support"
	depends on MT_AP_SUPPORT
	default y

config PCIE_ASPM_DYM_CTRL_SUPPORT
	bool "Pcie Aspm Dynamic Control Support"
	depends on MT_AP_SUPPORT
	default y

config COEX_SUPPORT
	bool "Coex Support"
	depends on MT_AP_SUPPORT
	default n

config EASY_SETUP_SUPPORT
	bool "Whole Home Coverage - Easy Setup"
	depends on MT_AP_SUPPORT
	default n

config EVENT_NOTIFIER_SUPPORT
	bool "Whole Home Coverage - Event Notifier"
	depends on MT_AP_SUPPORT
	default n

config AIR_MONITOR
        bool "Air Monitor"
        depends on MT_AP_SUPPORT
        default n

config WNM_SUPPORT
        bool "802.11v WNM Support"
        depends on MT_AP_SUPPORT
        default n

config WIFI_MSI_SUPPORT
        bool "MSI support"
        depends on PCI_MSI
        depends on CHIP_MT7615E
        default n


#config ROAMING_ENHANCE_SUPPORT
#	bool "Roaming Enhance Support"
#	depends on MT_AP_SUPPORT
#	depends on APCLI_SUPPORT
#	default n

#config WIFI_FWD_SUPPORT
#        bool "WiFi Forwarding Support"
#        default n
```

## package/lean/oscam/Config.in
```kconfig
menu "OSCam build options"
	depends on PACKAGE_oscam


config OSCAM_USE_LIBCRYPTO
	bool "Build with OpenSSL libcrypto"
	help
		"Use OpenSSL libcrypto instead of OSCam internal crypto functions"
	default n

config OSCAM_USE_LIBUSB
	bool "Build with libusb"
	default n


	menu "Protocols"
	depends on PACKAGE_oscam

	config OSCAM_MODULE_CAMD33
		bool "camd 3.3"
		default n

	config OSCAM_MODULE_CAMD35
		bool "camd 3.5 UDP"
		default n

	config OSCAM_MODULE_CAMD35_TCP
		bool "camd 3.5 TCP"
		default n

	config OSCAM_MODULE_NEWCAMD
		bool "newcamd"
		default n

	config OSCAM_MODULE_CCCAM
		bool "CCcam"
		default n

	config OSCAM_MODULE_CCCSHARE
		bool "CCcam share"
		default n

	config OSCAM_MODULE_GBOX
		bool "gbox"
		default n

	config OSCAM_MODULE_RADEGAST
		bool "radegast"
		default n

	config OSCAM_MODULE_SERIAL
		bool "Serial"
		default n

	config OSCAM_MODULE_CONSTCW
		bool "constant CW"
		default n

	config OSCAM_MODULE_PANDORA
		bool "Pandora"
		default n

	config OSCAM_MODULE_GHTTP
		bool "Ghttp"
		default n

	config OSCAM_MODULE_SCAM
		bool "scam"
		default n

	endmenu

	menu "Readers"
	depends on PACKAGE_oscam

	config OSCAM_READER_NAGRA
		bool "Nagravision"
		default n

	config OSCAM_READER_IRDETO
		bool "Irdeto"
		default n

	config OSCAM_READER_CONAX
		bool "Conax"
		default n

	config OSCAM_READER_CRYPTOWORKS
		bool "Cryptoworks"
		default n

	config OSCAM_READER_SECA
		bool "Seca"
		default n

	config OSCAM_READER_VIACCESS
		bool "Viaccess"
		default n

	config OSCAM_READER_VIDEOGUARD
		bool "NDS Videoguard"
		default n

	config OSCAM_READER_DRE
		bool "DRE Crypt"
		default n

	config OSCAM_READER_TONGFANG
		bool "Tongfang"
		default n

	config OSCAM_READER_BULCRYPT
		bool "Bulcrypt"
		default n

	config OSCAM_READER_GRIFFIN
		bool "Griffin"
		default n

	config OSCAM_READER_DGCRYPT
		bool "DGCrypt"
		default n

	endmenu

	menu "Card readers"
	depends on PACKAGE_oscam

	config OSCAM_USE_PCSC
		bool "PCSC"
		select OSCAM_USE_LIBUSB
		default n

	config OSCAM_CARDREADER_PHOENIX
		bool "Phoenix/mouse"
		select OSCAM_USE_LIBUSB
		default n

	config OSCAM_CARDREADER_SC8IN1
		bool "SC8in1"
		select OSCAM_USE_LIBUSB
		default n

	config OSCAM_CARDREADER_MP35
		bool "AD-Teknik MP 3.6/USB Phoenix"
		select OSCAM_USE_LIBUSB
		default n

	config OSCAM_CARDREADER_SMARGO
		bool "Argolis Smargo Smartreader"
		select OSCAM_USE_LIBUSB
		default n

	config OSCAM_CARDREADER_STINGER
		bool "STINGER"
		select OSCAM_USE_LIBUSB
		default n

	endmenu

comment "Addons"
config OSCAM_HAVE_DVBAPI
	bool "DVB API"
	default y

config OSCAM_READ_SDT_CHARSETS
	bool "DVB API read-sdt charsets"
	default y

config OSCAM_IRDETO_GUESSING
	bool "Irdeto guessing"
	default n

config OSCAM_CS_ANTICASC
	bool "Anti cascading"
	default y

config OSCAM_WITH_DEBUG
	bool "Debug messages"
	default n

config OSCAM_MODULE_MONITOR
	bool "Monitor"
	default n

config OSCAM_WITH_LB
	bool "Loadbalancing"
	default y

config OSCAM_S_CACHEEX
	bool "Cache exchange"
	default y

config OSCAM_CW_CYCLE_CHECK
	bool "CW Cycle Check"
	default y

config OSCAM_LCDSUPPORT
	bool "LCD support"
	default n

config OSCAM_LEDSUPPORT
	bool "LED support"
	default n

config OSCAM_CLOCKFIX
	bool "Clockfix (disable on old systems!)"
	default y

config OSCAM_IPV6SUPPORT
	bool "IPv6 support (experimental)"
	default n


config OSCAM_WEBIF
	bool "Web Interface"
	default n

	config OSCAM_WEBIF_LIVELOG
		bool "LiveLog"
		depends on OSCAM_WEBIF
		default n

	config OSCAM_WEBIF_JQUERY
		bool "Jquery onboard (if disabled webload)"
		depends on OSCAM_WEBIF
		default n

	config OSCAM_TOUCH
		bool "Touch Web Interface"
		depends on OSCAM_WEBIF
		default n

	config OSCAM_WITH_SSL
		bool "SSL support"
		depends on OSCAM_WEBIF
		select OSCAM_USE_LIBCRYPTO
		default n

endmenu
```

## package/lean/samba4/Config.in
```kconfig
config SAMBA4_SERVER_NETBIOS
	bool "NetBIOS support"
	depends on PACKAGE_samba4-server
	help
		installs: nmbd (daemon)

		Announce Samba resources via NetBIOS using the nmbd daemon
		WSD (Web Services for Devices) replaces the functionality of NetBIOS and is provided by the wsdd2 package (selected by default).
		Note: As of Windows 10 Fall Creators Update (1709) NetBIOS isn't supported unless the old SMB1 feature is reinstalled (not recommended).
		Network shares can be directly accessed via network paths '\\hostname\sharename' and mounted via 'map network drive' without NetBIOS or WSD.
	default y

config SAMBA4_SERVER_AVAHI
	bool "Avahi support"
	depends on PACKAGE_samba4-server
	select SAMBA4_SERVER_VFS
	help
		Announce Samba resources via DNS/DNS-SD using the Avahi daemon, for Linux/Mac clients.
	default y

config SAMBA4_SERVER_VFS
	bool "Common VFS modules"
	depends on PACKAGE_samba4-server
	help
		installs:
			modules: (vfs_btrfs) vfs_fruit vfs_shadow_copy2 vfs_recycle vfs_fake_perms vfs_readonly vfs_cap vfs_offline vfs_crossrename vfs_catia vfs_streams_xattr vfs_default_quota

		Commonly used VFS modules, vfs_btrfs requires kmod-fs-btrfs to be selected separately
	default y

config SAMBA4_SERVER_VFSX
	bool "Extended VFS modules"
	depends on PACKAGE_samba4-server
	help
		installs:
			modules: vfs_virusfilter vfs_shell_snap vfs_commit vfs_worm vfs_xattr_tdb vfs_aio_fork vfs_aio_pthread (vfs_linux_xfs_sgid) vfs_netatalk vfs_dirsort vfs_fileid

		Additional VFS modules that aren't commonly used, vfs_linux_xfs_sgid requires kmod-fs-xfs to be selected separately
	default n

config SAMBA4_SERVER_AD_DC
	bool "Active Directory Domain Controller support (EXPERIMENTAL)"
	depends on PACKAGE_samba4-server
	select SAMBA4_SERVER_VFS
	help
		installs: samba (meta-daemon) PyCryptodome ntlm_auth
			scripts: samba-tool

		Run as a Active Directory Domain Controller
		see: https://wiki.samba.org/index.php/Setting_up_Samba_as_an_Active_Directory_Domain_Controller
		HINT: see section (# Using the Domain Controller as a File Server)
		NOTE: Extroot is recommend for this setup, as it is not optimized to run completely from RAM/tempfs!
	default n
```

## package/lean/v2ray/Config.in
```kconfig
menu "V2Ray Configuration"
	depends on PACKAGE_v2ray

choice
	prompt "JSON Config Support"
	default V2RAY_JSON_INTERNAL

	config V2RAY_JSON_INTERNAL
		bool "Load JSON Internally"

	config V2RAY_JSON_V2CTL
		bool "Load JSON from V2Ctl"

	config V2RAY_JSON_NONE
		bool "None"

endchoice

config V2RAY_COMPRESS_GOPROXY
	bool "Compiling with GOPROXY proxy"
	default y

config V2RAY_EXCLUDE_V2CTL
	bool "Exclude V2Ctl"
	depends on V2RAY_JSON_INTERNAL || V2RAY_JSON_NONE
	default y

config V2RAY_EXCLUDE_ASSETS
	bool "Exclude geoip.dat & geosite.dat"
	default y

config V2RAY_COMPRESS_UPX
	bool "Compress executable files with UPX"
	default y

config V2RAY_CUSTOM_FEATURES
	bool "Custom Features"
	default n

menu "Features Configuration"
	depends on V2RAY_CUSTOM_FEATURES

config V2RAY_WITHOUT_DNS
	bool "Without Internal DNS Support"
	default n

config V2RAY_WITHOUT_LOG
	bool "Without Log Support"
	default n

config V2RAY_WITHOUT_TLS
	bool "Without TLS Support"
	default n

config V2RAY_WITHOUT_UDP
	bool "Without UDP Support"
	default n

config V2RAY_WITHOUT_POLICY
	bool "Without Local Policy Support"
	default n

config V2RAY_WITHOUT_REVERSE
	bool "Without Reverse Proxy Support"
	default n

config V2RAY_WITHOUT_ROUTING
	bool "Without Internal Routing Support"
	default n

config V2RAY_WITHOUT_STATISTICS
	bool "Without Statistics Support"
	default n

config V2RAY_WITHOUT_BLACKHOLE_PROTO
	bool "Without Blackhole Protocol"
	default n

config V2RAY_WITHOUT_DNS_PROXY
	bool "Without DNS Proxy"
	default n

config V2RAY_WITHOUT_DOKODEMO_PROTO
	bool "Without Dokodemo-door Protocol"
	default n

config V2RAY_WITHOUT_FREEDOM_PROTO
	bool "Without Freedom Protocol"
	default n

config V2RAY_WITHOUT_MTPROTO_PROXY
	bool "Without MTProto Proxy"
	default n

config V2RAY_WITHOUT_HTTP_PROTO
	bool "Without HTTP Protocol"
	default n

config V2RAY_WITHOUT_SHADOWSOCKS_PROTO
	bool "Without Shadowsocks Protocol"
	default n

config V2RAY_WITHOUT_SOCKS_PROTO
	bool "Without Socks Protocol"
	default n

config V2RAY_WITHOUT_VMESS_PROTO
	bool "Without VMess Protocol"
	default n

config V2RAY_WITHOUT_TCP_TRANS
	bool "Without TCP Transport"
	default n

config V2RAY_WITHOUT_MKCP_TRANS
	bool "Without mKCP Transport"
	default n

config V2RAY_WITHOUT_WEBSOCKET_TRANS
	bool "Without WebSocket Transport"
	default n

config V2RAY_WITHOUT_HTTP2_TRANS
	bool "Without HTTP/2 Transport"
	default n

config V2RAY_WITHOUT_DOMAIN_SOCKET_TRANS
	bool "Without Domain Socket Transport"
	default n

config V2RAY_WITHOUT_QUIC_TRANS
	bool "Without QUIC Transport"
	default n

endmenu
endmenu
```

## package/lean/xray/Config.in
```kconfig
menu "Xray Configuration"
	depends on PACKAGE_xray

choice
	prompt "JSON Config Support"
	default XRAY_JSON_INTERNAL

	config XRAY_JSON_INTERNAL
		bool "Load JSON Internally"

	config XRAY_JSON_NONE
		bool "None"

endchoice

config XRAY_COMPRESS_GOPROXY
	bool "Compiling with GOPROXY proxy"
	default n

config XRAY_EXCLUDE_ASSETS
	bool "Exclude geoip.dat & geosite.dat"
	default y

config XRAY_COMPRESS_UPX
	bool "Compress executable files with UPX"
	default y

config XRAY_CUSTOM_FEATURES
	bool "Custom Features"
	default n

menu "Features Configuration"
	depends on XRAY_CUSTOM_FEATURES

config XRAY_WITHOUT_DNS
	bool "Without Internal DNS Support"
	default n

config XRAY_WITHOUT_LOG
	bool "Without Log Support"
	default n

config XRAY_WITHOUT_TLS
	bool "Without TLS Support"
	default n

config XRAY_WITHOUT_UDP
	bool "Without UDP Support"
	default n

config XRAY_WITHOUT_POLICY
	bool "Without Local Policy Support"
	default n

config XRAY_WITHOUT_REVERSE
	bool "Without Reverse Proxy Support"
	default n

config XRAY_WITHOUT_ROUTING
	bool "Without Internal Routing Support"
	default n

config XRAY_WITHOUT_STATISTICS
	bool "Without Statistics Support"
	default n

config XRAY_WITHOUT_BLACKHOLE_PROTO
	bool "Without Blackhole Protocol"
	default n

config XRAY_WITHOUT_DNS_PROXY
	bool "Without DNS Proxy"
	default n

config XRAY_WITHOUT_DOKODEMO_PROTO
	bool "Without Dokodemo-door Protocol"
	default n

config XRAY_WITHOUT_FREEDOM_PROTO
	bool "Without Freedom Protocol"
	default n

config XRAY_WITHOUT_MTPROTO_PROXY
	bool "Without MTProto Proxy"
	default n

config XRAY_WITHOUT_HTTP_PROTO
	bool "Without HTTP Protocol"
	default n

config XRAY_WITHOUT_SHADOWSOCKS_PROTO
	bool "Without Shadowsocks Protocol"
	default n

config XRAY_WITHOUT_SOCKS_PROTO
	bool "Without Socks Protocol"
	default n

config XRAY_WITHOUT_VMESS_PROTO
	bool "Without VMess Protocol"
	default n

config XRAY_WITHOUT_TCP_TRANS
	bool "Without TCP Transport"
	default n

config XRAY_WITHOUT_MKCP_TRANS
	bool "Without mKCP Transport"
	default n

config XRAY_WITHOUT_WEBSOCKET_TRANS
	bool "Without WebSocket Transport"
	default n

config XRAY_WITHOUT_HTTP2_TRANS
	bool "Without HTTP/2 Transport"
	default n

config XRAY_WITHOUT_DOMAIN_SOCKET_TRANS
	bool "Without Domain Socket Transport"
	default n

config XRAY_WITHOUT_QUIC_TRANS
	bool "Without QUIC Transport"
	default n

endmenu
endmenu
```
