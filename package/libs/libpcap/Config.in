## package/network/services/hostapd/Config.in
```kconfig
# wpa_supplicant config
config WPA_RFKILL_SUPPORT
	bool "Add rfkill support"
	depends on PACKAGE_hostapd-common
	default n

config WPA_MSG_MIN_PRIORITY
	int "Minimum debug message priority"
	depends on PACKAGE_hostapd-common
	default 3
	help
	  Useful values are:
	    0 = all messages
		1 = raw message dumps
		2 = most debugging messages
		3 = info messages
		4 = warnings
		5 = errors

config WPA_WOLFSSL
	bool
	default PACKAGE_wpa-supplicant-wolfssl ||\
	        PACKAGE_wpad-wolfssl ||\
	        PACKAGE_wpad-basic-wolfssl || \
	        PACKAGE_wpad-mesh-wolfssl ||\
	        PACKAGE_eapol-test-wolfssl
	select WOLFSSL_HAS_AES_CCM
	select WOLFSSL_HAS_ARC4
	select WOLFSSL_HAS_DH
	select WOLFSSL_HAS_OCSP
	select WOLFSSL_HAS_SESSION_TICKET
	select WOLFSSL_HAS_WPAS

config DRIVER_11AC_SUPPORT
	bool
	default n

config DRIVER_11AX_SUPPORT
	bool
	default n
	select WPA_MBO_SUPPORT

config DRIVER_11BE_SUPPORT
	bool
	default n

config WPA_ENABLE_WEP
	bool "Enable support for unsecure and obsolete WEP"
	depends on PACKAGE_hostapd-common
	help
	  Wired equivalent privacy (WEP) is an obsolete cryptographic data
	  confidentiality algorithm that is not considered secure. It should not be used
	  for anything anymore. The functionality needed to use WEP is available in the
	  current hostapd release under this optional build parameter and completely
	  removed in a future release.

config WPA_MBO_SUPPORT
	bool "Multi Band Operation (Agile Multiband)"
	depends on PACKAGE_hostapd-common
	default y
	help
	  Multi Band Operation aka (Agile Multiband) enables features
	  that facilitate efficient use of multiple frequency bands.
	  Enabling MBO on an AP using RSN requires 802.11w to be enabled.
	  Hostapd will refuse to start if MBO and RSN are enabled without 11w.
```

## package/network/services/lldpd/Config.in
```kconfig
menu "Configuration"
	depends on PACKAGE_lldpd

config LLDPD_WITH_PRIVSEP
	bool
	default y
	prompt "Enable privilege separation (run lldpd with a chrooted 'lldp' user)"

config LLDPD_WITH_CDP
	bool
	default y
	prompt "Enable support for the Cisco Discovery Protocol (CDP) version 1 and 2"

config LLDPD_WITH_FDP
	bool
	default y
	prompt "Enable support for the Foundry Discovery Protocol (FDP)"

config LLDPD_WITH_EDP
	bool
	default y
	prompt "Enable support for the Extreme Discovery Protocol (EDP)"

config LLDPD_WITH_SONMP
	bool
	default y
	prompt "Enable support for the SynOptics Network Management Protocol"

config LLDPD_WITH_LLDPMED
	bool
	prompt "Enable LLDP-MED extension"
	default y

config LLDPD_WITH_DOT1
	bool
	prompt "Enable Dot1 extension (VLAN stuff)"
	default y

config LLDPD_WITH_DOT3
	bool
	prompt "Enable Dot3 extension (PHY stuff)"
	default y

config LLDPD_WITH_CUSTOM
	bool
	prompt "Enable Custom TLVs"
	default y

config LLDPD_WITH_JSON
	bool
	prompt "Enable JSON output for the LLDP Command-Line Interface"
	default n

config LLDPD_WITH_SNMP
	bool
	default n
	prompt "Enable the use of SNMP"
endmenu
```

## package/qat/firmware/quickassist-c2xxx/Config.in
```kconfig
menu "Configuration"
	depends on PACKAGE_kmod-crypto-qat-c2xxx

config CRYPTO_QAT_DEBUG
	bool
	default n
	prompt "Build with debugging support enabled"

endmenu
```

## package/qat/firmware/quickassist-c3xxx/Config.in
```kconfig
menu "Configuration"
	depends on PACKAGE_quickassist-c3xxx

	config QAT_C3XXX_KERNEL_OPTIONS
		bool
		default n
		prompt "Required kernel options for Quickassist"
		select KERNEL_ASN1
		select KERNEL_CRYPTO_AKCIPHER
		select KERNEL_CRYPTO_AKCIPHER2
		select KERNEL_CRYPTO_DH
		select KERNEL_CRYPTO_HW
		select KERNEL_CRYPTO_KPP
		select KERNEL_CRYPTO_KPP2
		select KERNEL_CRYPTO_RSA
		select KERNEL_UIO
		select KERNEL_PCI_IOV
		select KERNEL_HUGETLBFS
		select KERNEL_HUGETLB_PAGE
		help
		These kernel options are required for successful compilation and runtime functionality.

	config QAT_DEBUG
		bool
		default n
		prompt "Build with debugging support enabled"

	config QAT_DISABLE_STATS
		bool
		default n
		prompt "Disable statistics collection"
		help
		Disable for performance optimization

	config QAT_LOG_SYSLOG
		bool
		default y
		prompt "Debug to syslog instead of stdout"

	config QAT_PARAM_CHECK
		bool
		default y
		prompt "Enable parameter checking in the top-level APIs"
		help
		Disable for performance optimization

	config QAT_NONBLOCKING_PARTIALS
		bool
		default y
		prompt "Partial operation results are non-blocking"
		help
		Disable for performance optimization

	config QAT_DC_ONLY
		bool
		default n
		prompt "Build acceleration only for compression"
		help
		Optimize for size if using only compression

	config QAT_DC_SYM_ONLY
		bool
		default n
		prompt "Build acceleration only for compression and symmetric ciphers"
		help
		Optimize for size if using only compression and symmetric ciphers

	config QAT_DC_COUNTER_ERROR
		bool
		default n
		prompt "Update counters when encountering an error"
		help
		Enables updates of consumed/produced results in case
		of error during compression or decompression operations

	config QAT_DISABLE_INLINE
		bool
		default n
		prompt "Disable functioning inlining for functions that cannot be inlined by the compiler"
		help
		Use where kernel does not support CONFIG_ARCH_SUPPORTS_OPTIMIZED_INLINING to allow building

	config QAT_HB_FAIL
		bool
		default n
		prompt "Enable heartbeat failure simulation"

	config QAT_COEXIST
		bool
		default n
		prompt "Enable legacy and upstream driver coexistence"

	config QAT_LKCF
		bool
		default y
		prompt "Enable QAT registration with Linux Kernel Crypto Framework"

	config QAT_DISABLE_STRICT
		bool
		default n
		prompt "Disable strict mode for data compression"

endmenu
```

## package/qat/libs/eudev/Config.in
```kconfig
# udev package config

menu "Configuration"
	depends on PACKAGE_eudev

config EUDEV_EXTRA_ata_id
	bool "Install eudev ata_id callout"
	default y
	help
	  ata_id - udev callout to read product/serial number
	  from ATA drives

config EUDEV_EXTRA_blkid
	bool "Use blkid to identify block devices"
	default y
	help
	  blkid - make use of libblkid to identify block devices

config EUDEV_EXTRA_cdrom_id
	bool "Install eudev cdrom_id callout"
	default y
	help
	  cdrom_id - udev callout to determine the capabilities
	  of optical drives and media

config EUDEV_EXTRA_collect
	bool "Install eudev collect"
	default n
	help
	  Adds ID to the list governed by <checkpoint>

config EUDEV_EXTRA_input_id
	bool "Install input_id callout"
	default y
	help
	 input_id - udev callout to classify input devices

config EUDEV_EXTRA_kmod
	bool "Use kmod for loading kernel modules"
	default n
	help
	  kmod - make use of kmod to load kernel modules on demand

config EUDEV_EXTRA_mtd_probe
	bool "Install mtd_probe callout"
	default y
	help
	  mtd_probe - udev callout to probe mtd devices

config EUDEV_EXTRA_rule_generator
	bool "Install (legacy) eudev rule_generator"
	default n
	help
	   Install (legacy) eudev rule_generator

config EUDEV_EXTRA_scsi_id
	bool "Install eudev scsi_id callout"
	default y
	help
	  scsi_id - retrieve and generate a unique SCSI identifier

config EUDEV_EXTRA_v4l_id
	bool "Install eudev v4l_id callout"
	default y
	help
	  v4l_id - udev callout to identify Video4Linux devices


endmenu
```

## package/qat/libs/openssl-qat/Config.in
```kconfig
menu "Configuration"
	depends on TARGET_x86_64

	choice 
		prompt "Platform"
		default QAT_NONE
		config QAT_NONE
			bool "None (Default)"
		config QAT_C2XXX
			bool "c2xxx - Rangeley"
			depends on LINUX_4_14
			select PACKAGE_quickassist-c2xxx
			select PACKAGE_kmod-crypto-qat-c2xxx
			select PACKAGE_kmod-crypto-qat-c2xxx-usdm
		config QAT_C3XXX
			bool "c3xxx - Denverton"
			select PACKAGE_quickassist-c3xxx 
			select PACKAGE_kmod-crypto-qat-c3xxx
			select PACKAGE_kmod-crypto-qat-common
			select PACKAGE_kmod-crypto-qat-usdm

	endchoice

	config QAT_ENGINE_DISABLE_RSA
		bool
		default n
		prompt "Disable QAT RSA offload"

	config QAT_ENGINE_DISABLE_DSA
		bool
		default n
		prompt "Disable QAT DSA offload"

	config QAT_ENGINE_DISABLE_DH
		bool
		default n
		prompt "Disable QAT DH offload"

	config QAT_ENGINE_DISABLE_EDSA
		bool
		default n
		prompt "Disable QAT ECDSA offload"

	config QAT_ENGINE_DISABLE_CIPHERS
		bool
		default y
		prompt "Disable QAT chained cipher offload"
		help
		Offload of chained ciphers performs significantly worse than CPU
		based chained ciphers. Strongly recommended to keep this disabled

	config QAT_ENGINE_DISABLE_HKDF
		bool
		default y
		prompt "Disable QAT HKDF offload"
		help
		Disable QAT HKDF offload

	config QAT_ENGINE_ENABLE_GCM_CIPHERS
		bool
		default n
		prompt "Enable QAT GCM offload"
		help
		Enable QAT GCM offload

	config QAT_ENGINE_ENABLE_SMALL_PACKET
		bool
		default n
		prompt "Enable offload of small packet cipher operations"
		help
		This is generally a bad idea from a performance point of view since
		there is a penalty for transfer of the data across the pci bus to the
		accelerator that makes it faster for small packet operations using
		only cpu resources and not QAT offloading (generally < 4k bufsize)

	config QAT_ENGINE_ENABLE_WARNINGS
		bool
		default n
		prompt "Enable warnings to aid in debugging"
		help
		WARNING: never leave on in a production environment as it may output
		private key informtion to the logs and it may introduce side-channel
		timing attack vulnerabilities

	config QAT_ENGINE_ENABLE_DEBUG
		bool
		default n
		prompt "Enable debug output"
		help
		WARNING: never leave on in a production environment as it may output
		private key informtion to the logs and it may introduce side-channel
		timing attack vulnerabilities

	config QAT_ENGINE_ENABLE_QAT_MEM_WARNINGS
		bool
		default n
		prompt "Enable warnings from the userspace memory management code"
		help
		WARNING: This option should never be left on in a production
		environment as it may introduce side channel timing attack
		vulnerabilities

	config QAT_ENGINE_ENABLE_MEM_DEBUG
		bool
		default n
		prompt "Enable debug output from userspace memory management (very verbose)"
		help
		This will also enable the QAT_MEM warning messages. This option
		produces quite verbose output hence why it is separate to the
		standard debug.

		WARNING: This option should never be enabled in a production environment
		as it may output private key information to the console/logs and may
		also introduce side channel timing attack vulnerabilities

	config QAT_ENGINE_ENABLE_MULTITHREAD
		bool
		default n
		prompt "Optimize for multi-threaded use"
		help
		This alternative method will give improved performance in a
		multi-threaded environment by making the slab pools thread
		local to avoid locking between threads. Although this can
		give better performance there are several drawbacks such as
		the memory slabs will be utilized less efficiently, and you
		cannot allocate in one thread and free in another thread.
		Running in this mode DOES NOT support processes that fork

	config QAT_ENGINE_DISABLE_LENSTRA
		bool
		default n
		prompt "Disable protection against Lenstra attack (CVE-2017-5681)"
		help
		The RSA-CRT implementation in the Intel(R) QAT OpenSSL* Engine for
		OpenSSL* versions prior to v0.5.19 may allow remote attackers to
		obtain private RSA keys by conducting a Lenstra side-channel attack.
		From version v0.5.19 onward, protection against this form of attack
		is effected by performing a Verify/Encrypt operation after the Sign/Decrypt
		operation, and if a failure is detected then re-running the Sign/Decrypt
		operation using the CPU.  However, future releases of Intel(R) QAT
		driver code or firmware may effect this protection instead, in which
		case the Intel(R) QAT OpenSSL* Engine code-based protection would no
		longer be required and this configuration option should then be selected.

	config QAT_ENGINE_DISABLE_AUTOINIT_ONFORK
		bool
		default y
		prompt "Disable auto engine init on fork"
		help
		Disable the engine from being initialized automatically following a
		fork operation. This is useful in a situation where you want to tightly
		control how many instances are being used for processes. For instance if an
		application forks to start a process that does not utilize QAT currently
		the default behaviour is for the engine to still automatically get started
		in the child using up an engine instance. After using this flag either the
		engine needs to be initialized manually using the engine message:
		INIT_ENGINE or will automatically get initialized on the first QAT crypto
		operation.

endmenu
```

## package/qca/nss/qca-nss-sfe/src/Kconfig
```kconfig
#
# Shortcut forwarding engine
#

config QCA_NSS_SFE
	tristate "Shortcut Forwarding Engine"
	depends on NF_CONNTRACK
	---help---
	  Shortcut is a fast in-kernel packet forwarding engine.

	  To compile this code as a module, choose M here: the module will be
	  called shortcut-fe.

	  If unsure, say N.
```
