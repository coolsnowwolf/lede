## package/libs/pcre/Config.in
```kconfig
config PCRE_JIT_ENABLED
	bool
	depends on PACKAGE_libpcre && (arm || i386 || i686 || x86_64 || mips || mipsel || powerpc || sparc)
	default y if (arm || i686 || x86_64)
	prompt "Enable JIT compiler support"
	help
		Enable JIT (Just-In-Time) compiler support.

		Enabling this option can give an about 10x performance increase on JIT operations. It can be desireable for e.g. high performance Apache mod_rewrite or HA-Proxy reqrep operations.

		However, JIT should _only_ be enabled on architectures that are supported. Enabling JIT on unsupported platforms will result in a compilation failure. A list of supported architectures can be found here: https://pcre.org/original/doc/html/pcrejit.html#SEC3 .
```

## package/libs/wolfssl/Config.in
```kconfig
if PACKAGE_libwolfssl

config WOLFSSL_HAS_AES_CCM
	bool "Include AES-CCM support"
	default y

config WOLFSSL_HAS_CHACHA_POLY
	bool "Include ChaCha20-Poly1305 cipher suite support"
	default y

config WOLFSSL_HAS_DH
	bool "Include DH (Diffie-Hellman) support"
	default y

config WOLFSSL_HAS_ARC4
	bool "Include ARC4 support"
	default y

config WOLFSSL_HAS_CERTGEN
	bool "Include certificate generation support"
	default y

config WOLFSSL_HAS_TLSV10
	bool "Include TLS 1.0 support"
	default y

config WOLFSSL_HAS_TLSV13
	bool "Include TLS 1.3 support"
	default y

config WOLFSSL_HAS_SESSION_TICKET
	bool "Include session ticket support"
	default y

config WOLFSSL_HAS_DTLS
	bool "Include DTLS support"
	default n

config WOLFSSL_HAS_OCSP
	bool "Include OSCP stapling support"
	default y

config WOLFSSL_HAS_WPAS
	bool "Include wpa_supplicant support"
	select WOLFSSL_HAS_ARC4
	select WOLFSSL_HAS_OCSP
	select WOLFSSL_HAS_SESSION_TICKET
	default y

config WOLFSSL_HAS_ECC25519
	bool "Include ECC Curve 25519 support"
	default y

config WOLFSSL_HAS_OPENVPN
	bool "Include OpenVPN support"
	default n

config WOLFSSL_ALT_NAMES
	bool "Include SAN (Subject Alternative Name) support"
	default y

config WOLFSSL_HAS_DEVCRYPTO
	bool

choice
	prompt "Hardware Acceleration"
	default WOLFSSL_HAS_NO_HW

	config WOLFSSL_HAS_NO_HW
		bool "None"

	config WOLFSSL_HAS_AFALG
		bool "AF_ALG"

	config WOLFSSL_HAS_DEVCRYPTO_CBC
		bool "/dev/crytpo - AES-CBC-only"
		select WOLFSSL_HAS_DEVCRYPTO

	config WOLFSSL_HAS_DEVCRYPTO_AES
		bool "/dev/crypto - AES-only (all supported modes)"
		select WOLFSSL_HAS_DEVCRYPTO

	config WOLFSSL_HAS_DEVCRYPTO_FULL
		bool "/dev/crypto - full"
		select WOLFSSL_HAS_DEVCRYPTO
endchoice

endif
```

## package/libs/zlib/Config.in
```kconfig
menu "Configuration"
	depends on PACKAGE_zlib

config ZLIB_OPTIMIZE_SPEED
	bool "Optimize for speed"
	default y
	help
		This enables additional optimization and 
		increases performance considerably at 
		the expense of binary size.

endmenu
```

## package/mtk/applications/mtk-nvram/config.in
```kconfig
menu "nvram Features"
	depends on PACKAGE_nvram
config NVRAM_MTD_NAME
	string "mtd name for nvram"
	default "Config"
endmenu
```

## package/mtk/drivers/wifi_forward/config.in
```kconfig
if PACKAGE_kmod-wifi_forward

menu "WiFi Operation Modes"
config MT_WIFI_PKT_FWD
	bool "WiFi package forward"
	default y

config MT_WIFI_PKT_FWD_V1
	depends on MT_WIFI_PKT_FWD
	bool "WiFi package forward V1"
	default n

endmenu

endif
```

## package/my/oscam/Config.in
```kconfig
menu "OSCam build options"
	depends on PACKAGE_oscam

config OSCAM_USE_LIBCRYPTO
	bool "Build with OpenSSL libcrypto"
	help
		"Use OpenSSL libcrypto instead of OSCam internal crypto functions"
	default y

config OSCAM_USE_LIBUSB
	bool
	default y

	menu "Protocols"
	depends on PACKAGE_oscam

	config OSCAM_MODULE_CAMD33
		bool "camd 3.3"
		default n

	config OSCAM_MODULE_CAMD35
		bool "camd 3.5 UDP"
		default y

	config OSCAM_MODULE_CAMD35_TCP
		bool "camd 3.5 TCP"
		default y

	config OSCAM_MODULE_NEWCAMD
		bool "newcamd"
		default y

	config OSCAM_MODULE_CCCAM
		bool "CCcam"
		default y

	config OSCAM_MODULE_CCCSHARE
		bool "CCcam share"
		default y

	config OSCAM_MODULE_GBOX
		bool "gbox"
		default y

	config OSCAM_MODULE_RADEGAST
		bool "radegast"
		default y

	config OSCAM_MODULE_SERIAL
		bool "Serial"
		default y

	config OSCAM_MODULE_CONSTCW
		bool "constant CW"
		default y

	config OSCAM_MODULE_PANDORA
		bool "Pandora"
		default y

	config OSCAM_MODULE_GHTTP
		bool "Ghttp"
		default y

	config OSCAM_MODULE_SCAM
		bool "scam"
		default y

	endmenu

	menu "Readers"
	depends on PACKAGE_oscam

	config OSCAM_READER_NAGRA
		bool "Nagravision"
		default y

	config OSCAM_READER_IRDETO
		bool "Irdeto"
		default y

	config OSCAM_READER_CONAX
		bool "Conax"
		default y

	config OSCAM_READER_CRYPTOWORKS
		bool "Cryptoworks"
		default y

	config OSCAM_READER_SECA
		bool "Seca"
		default y

	config OSCAM_READER_VIACCESS
		bool "Viaccess"
		default y

	config OSCAM_READER_VIDEOGUARD
		bool "NDS Videoguard"
		default y

	config OSCAM_READER_DRE
		bool "DRE Crypt"
		default y

	config OSCAM_READER_TONGFANG
		bool "Tongfang"
		default y

	config OSCAM_READER_BULCRYPT
		bool "Bulcrypt"
		default y

	config OSCAM_READER_GRIFFIN
		bool "Griffin"
		default y

	config OSCAM_READER_DGCRYPT
		bool "DGCrypt"
		default y

	endmenu

	menu "Card readers"
	depends on PACKAGE_oscam

	config OSCAM_USE_PCSC
		bool "PCSC compatible readers"
		select OSCAM_USE_LIBUSB
		default y

	config OSCAM_CARDREADER_PHOENIX
		bool "Phoenix/mouse USB readers"
		select OSCAM_USE_LIBUSB
		default y

	config OSCAM_CARDREADER_INTERNAL
		bool "CARDREADER_INTERNAL"
		select OSCAM_USE_LIBUSB
		default y

		config OSCAM_CARDREADER_SC8IN1
		bool "SC8in1"
		select OSCAM_USE_LIBUSB
		default y

	config OSCAM_CARDREADER_MP35
		bool "AD-Teknik MP 3.6/USB Phoenix"
		select OSCAM_USE_LIBUSB
		default y

	config OSCAM_CARDREADER_SMARGO
		bool "Argolis Smargo Smartreader"
		select OSCAM_USE_LIBUSB
		default y

	config OSCAM_CARDREADER_DB2COM
		bool "Stinger USB Dual DB2COM"
		select OSCAM_USE_LIBUSB
		default y

	config OSCAM_CARDREADER_STAPI
		bool "CARDREADER_STAPI"
		select OSCAM_USE_LIBUSB
		default y

	config OSCAM_CARDREADER_STAPI5
		bool "CARDREADER_STAPI5"
		select OSCAM_USE_LIBUSB
		default n

	config OSCAM_CARDREADER_STINGER
		bool "Stinger USB Dual Smartcard Reader"
		select OSCAM_USE_LIBUSB
		default y

	config OSCAM_CARDREADER_DRECAS
		bool "DRECAS reader"
		default y

	endmenu

comment "Addons"
config OSCAM_HAVE_DVBAPI
	bool "DVB API"
	default y

config OSCAM_WITH_NEUTRINO
	bool "Neutrino suppor"
	default n

config OSCAM_READ_SDT_CHARSETS
	bool "DVB API read-sdt charsets"
	default y

config OSCAM_IRDETO_GUESSING
	bool "Irdeto guessing"
	default y

config OSCAM_CS_ANTICASC
	bool "Anti cascading"
	default y

config OSCAM_WITH_DEBUG
	bool "Debug messages"
	default y

config OSCAM_MODULE_MONITOR
	bool "Monitor"
	default y

config OSCAM_WITH_LB
	bool "Loadbalancing"
	default y

config OSCAM_S_CACHEEX
	bool "Cache exchange"
	default y

config OSCAM_CW_CYCLE_CHECK
	bool "CW Cycle Check"
	default y

config OSCAM_LCDSUPPORT
	bool "LCD support"
	default n

config OSCAM_LEDSUPPORT
	bool "LED support"
	default n

config OSCAM_CLOCKFIX
	bool "Clockfix (disable on old systems!)"
	default y

config OSCAM_IPV6SUPPORT
	bool "IPv6 support (experimental)"
	default y

config OSCAM_WEBIF
	bool "Web Interface"
	default y

	config OSCAM_WEBIF_LIVELOG
		bool "LiveLog"
		depends on OSCAM_WEBIF
		default y

	config OSCAM_WEBIF_JQUERY
		bool "Jquery onboard (if disabled webload)"
		depends on OSCAM_WEBIF
		default y

	config OSCAM_TOUCH
		bool "Touch Web Interface"
		depends on OSCAM_WEBIF
		default y

	config OSCAM_WITH_SSL
		bool "SSL support"
		depends on OSCAM_WEBIF
		select OSCAM_USE_LIBCRYPTO
		default y

endmenu
```

## package/network/config/wifi-scripts/Config.in
```kconfig
config WIFI_SCRIPTS_UCODE
	bool "Use new ucode based scripts"
	default y

config WIFI_SCRIPTS_WPS_BUTTON_DISABLED
	bool
	prompt "Disable WPS button handling"
	default n
	help
		If set, the WPS button handling logic in /etc/rc.button/wps is disabled.
```
