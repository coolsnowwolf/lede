## package/qca/qca-nss-drv/Config.in
```kconfig
menu "Configuration"
   depends on PACKAGE_kmod-qca-nss-drv

comment "Build Options"

config NSS_DRV_BRIDGE_ENABLE
	bool
	default n
	prompt "Enable BRIDGE"
config NSS_DRV_C2C_ENABLE
	bool
	default n
	prompt "Enable C2C"
config NSS_DRV_CLMAP_ENABLE
	bool
	default n
	prompt "Enable CLMAP"
config NSS_DRV_CRYPTO_ENABLE
	bool
	default y
	prompt "Enable CRYPTO"
config NSS_DRV_DTLS_ENABLE
	bool
	default n
	prompt "Enable DTLS"
config NSS_DRV_EDMA_ENABLE
	bool
	default n
	prompt "Enable EDMA"
config NSS_DRV_GRE_ENABLE
	bool
	default n
	prompt "Enable GRE"
config NSS_DRV_GRE_REDIR_ENABLE
	bool
	default n
	depends on NSS_DRV_GRE_ENABLE
	prompt "Enable GRE_REDIR"
config NSS_DRV_GRE_TUNNEL_ENABLE
	bool
	default n
	depends on NSS_DRV_GRE_ENABLE
	prompt "Enable GRE_TUNNEL"
config NSS_DRV_IGS_ENABLE
	bool
	default n
	prompt "Enable IGS"
config NSS_DRV_IPSEC_ENABLE
	bool
	default n
	prompt "Enable IPSEC"
config NSS_DRV_IPV4_REASM_ENABLE
	bool
	default n
	prompt "Enable IPV4_REASM"
config NSS_DRV_IPV6_ENABLE
	bool
	default n
	prompt "Enable IPV6"
config NSS_DRV_IPV6_REASM_ENABLE
	bool
	default n
	depends on NSS_DRV_IPV6_ENABLE
	prompt "Enable IPV6_REASM"
config NSS_DRV_L2TP_ENABLE
	bool
	default n
	prompt "Enable L2TP"
config NSS_DRV_LAG_ENABLE
	bool
	default n
	prompt "Enable LAG"
config NSS_DRV_MAPT_ENABLE
	bool
	default n
	prompt "Enable MAPT"
config NSS_DRV_MATCH_ENABLE
	bool
	default n
	prompt "Enable MATCH"
config NSS_DRV_MIRROR_ENABLE
	bool
	default n
	prompt "Enable MIRROR"
config NSS_DRV_OAM_ENABLE
	bool
	default n
	prompt "Enable OAM"
config NSS_DRV_PORTID_ENABLE
	bool
	default n
	prompt "Enable PORTID"
config NSS_DRV_PPE_ENABLE
	bool
	default n
	prompt "Enable PPE"
config NSS_DRV_PPPOE_ENABLE
	bool
	default n
	prompt "Enable PPPOE"
config NSS_DRV_PPTP_ENABLE
	bool
	default y
	prompt "Enable PPTP"
config NSS_DRV_PVXLAN_ENABLE
	bool
	default n
	prompt "Enable PVXLAN"
config NSS_DRV_QRFS_ENABLE
	bool
	default n
	prompt "Enable QRFS"
config NSS_DRV_QVPN_ENABLE
	bool
	default n
	prompt "Enable QVPN"
config NSS_DRV_OVPN_ENABLE
	bool
	default n
	prompt "Enable OVPN"
config NSS_DRV_RMNET_ENABLE
	bool
	default n
	prompt "Enable RMNET"
config NSS_DRV_SHAPER_ENABLE
	bool
	default n
	prompt "Enable SHAPER"
config NSS_DRV_SJACK_ENABLE
	bool
	default n
	prompt "Enable SJACK"
config NSS_DRV_TLS_ENABLE
	bool
	default n
	prompt "Enable TLS"
config NSS_DRV_TRUSTSEC_ENABLE
	bool
	default n
	prompt "Enable TRUSTSEC"
config NSS_DRV_TRUSTSEC_RX_ENABLE
	bool
	default n
	prompt "Enable TRUSTSEC_RX"
	depends on NSS_DRV_TRUSTSEC_ENABLE
config NSS_DRV_TSTAMP_ENABLE
	bool
	default n
	prompt "Enable TSTAMP"
config NSS_DRV_TUN6RD_ENABLE
	bool
	default n
	prompt "Enable TUN6RD"
config NSS_DRV_TUNIPIP6_ENABLE
	bool
	default n
	prompt "Enable TUNIPIP6"
config NSS_DRV_VIRT_IF_ENABLE
	bool
	default y
	prompt "Enable VIRT_IF"
config NSS_DRV_VLAN_ENABLE
	bool
	default n
	prompt "Enable VLAN"
config NSS_DRV_VXLAN_ENABLE
	bool
	default n
	prompt "Enable VXLAN"
config NSS_DRV_WIFI_ENABLE
	bool
	default n
	prompt "Enable WIFI"
config NSS_DRV_WIFI_EXT_VDEV_ENABLE
	bool
	default n
	depends on NSS_DRV_WIFI_ENABLE
	prompt "Enable WIFI EXT VDEV"
config NSS_DRV_WIFI_MESH_ENABLE
	bool
	default n
	depends on NSS_DRV_WIFI_ENABLE
	prompt "Enable WIFI MESH"
endmenu
```

## package/utils/busybox/Config.in
```kconfig
if PACKAGE_busybox || PACKAGE_busybox-selinux

config BUSYBOX_CUSTOM
	bool "Customize busybox options"
	default n
        help
          Enabling this allows full customization of busybox settings.
          Note that there are many options here that can result in a build
          that doesn't work properly.  Enabling customization will mark your
          build as "tainted" for the purpose of bug reports.
          See the variables written to /etc/openwrt_release

          Unless you know what you are doing, you should leave this as 'n'

	source "Config-defaults.in"

	if BUSYBOX_CUSTOM
	source "config/Config.in"
	endif

endif
```
