## package/kernel/phytium-d3000m/src/dc_driver/Documentation/devicetree/bindings/display/phytium/ftd330-dc.txt
```
device-tree bindings for Phytium Display Controller

Display controller is used to transfers the image data from a video memory
buffer to output interface.

Required properties:
- compatible: value should be "phytium,dcFTD330"/"phytium,dc9x00".

- reg: host interface and display physical base address and length.

- interrupts: interrupt which controller used.

- clocks: must include clock specifiers corresponding to entries in the
		clock-names property.

- clock-names: Must contain
		core_clk: core clock.
		pix_clk: pixel clock for output stream.
		axi_clk: axi clock for data fetch.

- iommus: iommu node

- port: A port node with endpoint definitions as defined in
  Documentation/devicetree/bindings/media/video-interfaces.txt.

Example 1:

dcFTD330@0xf6f00000 {
	compatible = "phytium,dcFTD330";
	reg = <0xf6f00000 0x100>, <0xf6f00800 0x2000>, <0xf7010000 0x1000>;
	interrupts = <22>;
	clocks = <&vout_clk>, <&disp_clk>, <&axi_clk>;
	clock-names = "core_clk", "pix_clk", "axi_clk";
	iommus = <&dcmmu>;

	port {
		#address-cells = <1>;
		#size-cells = <0>;
		dc_out_dpi0: endpoint@0 {
			reg = <0>;
			remote-endpoint = <&hdmi_input>;
		};
		dc_out_dpi1: endpoint@1 {
			reg = <1>;
			remote-endpoint = <&vd_input>;
		};
	};
};

Example 2:

dc9400@90c0000 {
	compatible = "phytium,dc9x00";
	reg = <0x0 0x90c0000 0x0 0x200000>;
	interrupts = <0x0 0x0b 0x4>;
	interrupt-names = "dc9400_irq";
	clocks = <&vout_clk>, <&disp_clk>, <&axi_clk>;
	clock-names = "core_clk", "pix_clk", "axi_clk";
	ports {
		#address-cells = <1>;
		#size-cells = <0>;
		dc_out_0: port@0 {
			reg = <0>;
		};
		dc_out_1: port@1 {
			reg = <1>;
		};
		dc_out_2: port@2 {
			reg = <2>;
		};
		dc_out_3: port@3 {
			reg = <3>;
		};
		dc_out_4: port@4 {
			reg = <4>;
		};
	};
};
```

## package/kernel/phytium-d3000m/src/dc_driver/Documentation/devicetree/bindings/display/phytium/ftd330-drm.txt
```
Device-Tree bindings for Phytium DRM master device

Phytium DRM master device is a virtual device needed to list all
display controller or other display interface nodes that comprise the
graphics subsystem.

Required properties:
- compatible: value should be "phytium,display-subsystem".

- ports: Should contain a list of phandles pointing to display interface ports
  of display controller devices

Example 1:

display-subsystem: display-subsystem-dcFTD330 {
	compatible = "phytium,display-subsystem";
	ports = <&dc_out_dpi0 &dc_out_dpi1>;
};

Example 2:

display_subsystem: display-subsystem-dc9400 {
	compatible = "phytium,display-subsystem";
	ports = <&dc_out_0 &dc_out_1 &dc_out_2 &dc_out_3 &dc_out_4>;
};
```

## package/kernel/phytium-d3000m/src/dc_driver/Documentation/devicetree/bindings/display/phytium/ftd330_simple_encoder.txt
```
Device-Tree bindings for Phytium simple encoder

Simple encoder driver only has basic functionality

Required properties:
- compatible: should be one of the following:
		"phytium,hdmi-encoder"
		"phytium,dp-encoder"
		"phytium,dsi-encoder"

- ports: contain a port nodes with endpoint definitions as defined in
	 Documentation/devicetree/bindings/media/video-interfaces.txt.

Optional properties:
- phytium,dss-syscon: contains a phandle to a syscon device. When this
	one is used, the options below is mandatory.
	Reference to Documentation/devicetree/bindings/mfd/syscon.txt.

- phytium,mux-mask: mask array to access register, the index id should be
	corresponded to active crtc as defined in port@0.
- phytium,mux-val: val array to write to register, the index id should be
	corresponded to active crtc as defined in port@0.

Example1:

dssctrl: dssctrl@9000000 {
	compatible = "phytium,dss-ctrl", "syscon";
	reg = <0 0x9000000 0 0x90>;
};

hdmi_output: hdmi-output {
	compatible = "phytium,hdmi-encoder";
	phytium,dss-syscon = <&dssctrl>;
	phytium,mux-mask = <0x70 0x380>;
	phytium,mux-val = <0x40 0x280>;
	ports {
		#address-cells = <1>;
		#size-cells = <0>;
		/* input */
		port@0 {
			#address-cells = <1>;
			#size-cells = <0>;
			reg = <0>;
			hdmi_input0:endpoint@0 {
				reg = <0>;
				remote-endpoint = <&dc0_out_dpi0>;
			};
			hdmi_input1:endpoint@1 {
				reg = <1>;
				remote-endpoint = <&dc1_out_dpi0>;
			};
		};
		/* output */
		port@1 {
			reg = <1>;
			hdmi_out:endpoint {
				remote-endpoint = <&adv7511_input>;
			};
		};
	};
};

Example2:

hdmi_output: hdmi-output {
	compatible = "phytium,hdmi-encoder";

	ports {
		#address-cells = <1>;
		#size-cells = <0>;
		/* input */
		port@0 {
			#address-cells = <1>;
			#size-cells = <0>;
			reg = <0>;
			hdmi_input0:endpoint@0 {
				reg = <0>;
				remote-endpoint = <&dc0_out_dpi0>;
			};
		};
		/* output */
		port@1 {
			reg = <1>;
			hdmi_out:endpoint {
				remote-endpoint = <&adv7511_input>;
			};
		};
	};
};
```

## package/kernel/phytium-d3000m/src/dc_driver/phytium/Kconfig
```kconfig
# SPDX-License-Identifier: GPL-2.0

config DRM_PHYTIUM
	tristate "DRM Support for Phytium"
	depends on DRM
	select DRM_KMS_HELPER
	select DRM_DISPLAY_HELPER
	help
	  Choose this option if you have a Phytium soc chipset.
	  This driver provides Phytium kernel mode
	  setting and buffer management. It does not
	  provide 2D or 3D acceleration.

config PHYTIUM_REGMAP
	bool "Use the REGMAP in Verisilicon DRM driver"
	depends on REGMAP
	default y
	help
	  Choose this option to enable the use of the REGMAP functionality
	  within the Verisilicon DRM driver. REGMAP provides a
	  convenient interface for managing register maps,
	  allowing for more efficient and organized handling of hardware registers

config PHYTIUM_CHIP_FTD330
	bool "Phytium display controller of FTD330"
	depends on DRM_PHYTIUM
	default y
	help
	  Choose this option if you have a Phytium display controller of
	  FTD330 series, This option enables support for the specific hardware features
	  and optimizations available in the FTD330 series display controllers.
	  If you are unsure, or if your system does not include a
	  Phytium FTD330 series controller, it is safe to leave this option disabled.

config PHYTIUM_NCC
        bool "NCC support FOR Phytium display controller"
        depends on DRM_PHYTIUM
        default n
        help
          This is the ncc support option. It allows you to set the start address
		  of video memory, which can be useful for specific memory management
		  and optimization scenarios. Enable this option if your application
		  requires direct control over video memory addressing.

config PHYTIUM_WRITEBACK
	bool "Writeback connector support for Phytium display controller"
	depends on DRM_PHYTIUM
	help
	  This option enables the writeback connector feature for the Phytium display controller.
	  It is primarily a debug feature that captures the content output
	  from the display controller and writes it back to a framebuffer.
	  This can be useful for debugging and testing purposes. By default,
	  this feature is disabled to avoid unnecessary overhead.

config PHYTIUM_MMU
	bool "MMU support for Phytium display controller"
	depends on DRM_PHYTIUM
	default n
	help
	  This is a memory management function which translate virtual address
	  to physical address. DPU MMU only do address translate, doesn't
	  support shareable.

config PHYTIUM_DEC
	bool "DEC support for Phytium display controller"
	depends on DRM_PHYTIUM
	default n
	help
	  This is a decompression function which reads compressed pixels from
	  external memory (DDR or SRAM) under DPU's control, then it decompress
	  comprssed pixels before returing these pixels to DPU.

config PHYTIUM_POWER_OPERATION
        bool "enable power operation or not"
        depends on DRM_PHYTIUM
        default n
        help
          This option allows you to enable or disable power operations
		  and hotplug support for the Phytium display controller.
		  Enabling this option can help manage power consumption
		  and support dynamic connection changes,
		  such as plugging and unplugging displays.
		  If power management is a concern for your application,
		  consider enabling this option.


config PHYTIUM_VIRTUAL_DISPLAY
        bool "display content output to debugfs file"
        depends on DRM_PHYTIUM
        select DEBUG_FS
	default n
        help
          This is a debug feature which capture video content output
          from display controller. Output path is debugfs/dri/connector/.
          The content format is ARGB which Alpha is 0 for 8bits.
          Disabled in default.

config PHYTIUM_PVRIC
	bool "PVRIC support for Phytium display controller"
	depends on DRM_PHYTIUM
	default n
	help
	  This option enables PVRIC (PowerVR Image Compression) support
	  for the Phytium display controller.
	  PVRIC is a decompression function integrated into the controller,
	  which can improve performance and reduce memory bandwidth usage by
	  handling compressed images. Enable this option if your application
	  benefits from image compression.

config PHYTIUM_VIRTUAL_DISPLAY
	bool "VIRTUAL DISPLAY support for Phytium display controller"
	depends on DRM_PHYTIUM
	default n
	help
	  This option enables virtual display support for the Phytium display controller.
	  It is a debug feature that outputs a virtual display to the screen,
	  primarily used for internal debugging purposes within Phytium.
	  This feature is typically not needed for standard operation and is disabled by default.

config PHYTIUM_FBDEV_ON
        bool "enable fbdev for Phytium display controller"
        depends on DRM_PHYTIUM
        default n
        help
          This option enables the framebuffer device (fbdev)
		  interface for the Phytium display controller.
		  When enabled, it creates a device node at /dev/fb0,
		  allowing applications to interact with the framebuffer directly.
		  This can be useful for legacy applications that rely on the fbdev interface.



config PHYTIUM_CHANGE_PIXCLK
        bool "enable change pixel clock for Phytium display controller"
        depends on DRM_PHYTIUM
        default n
        help
          This option allows you to enable dynamic pixel clock changes for
		  the Phytium display controller.
		  If your application requires adjusting the pixel clock
		  based on the display mode, enable this option to allow
		  for flexible clock management. This can help optimize display
		  performance and compatibility with various display modes.

config PHYTIUM_LANE_TRAIN
        bool "enable lane train for Phytium display controller"
        depends on DRM_PHYTIUM
        default n
        help
          If using a real monitor, choose Y. This option enables lane training for
		  the Phytium display controller, which is necessary for proper signal
		  integrity and communication with the display.
		  If you are using a virtual display or do not require lane training, choose N.

config PHYTIUM_PCIE
	bool "PCIE driver support for Phytium display controller"
	depends on DRM_PHYTIUM && PCI
	help
	  Choose this option if you want to register a PCIe driver for
	  the Phytium display controller. This allows the display controller to
	  interface with the system via PCIe. By default, a platform driver is used,
	  but selecting this option enables PCIe support.

config PHYTIUM_EDP_BL
	bool "eDP backlight control support for Phytium display controller"
	depends on DRM_PHYTIUM
	default n
	help
		Choose this option if you want to use PWM (Pulse Width Modulation) to
		control the eDP (Embedded DisplayPort) backlight brightness level.
		This feature allows for finer control over the display's backlight,
		improving power efficiency and user experience.

config PHYTIUM_PSR
		bool "enable Panel Self Refresh for Phytium Embedded DisplayPort"
		depends on DRM_PHYTIUM
		default n
		help
		This option enables Panel Self Refresh (PSR) for the Phytium Embedded DisplayPort.
		PSR allows the display to refresh itself without constant input from the GPU,
		reducing power consumption. Enable this feature
		if you want to take advantage of power savings.

config PHYTIUM_PSR_SF_UPDATE
		bool "enable Panel Self Refresh Single-frame Update for Phytium Embedded DisplayPort"
		depends on PHYTIUM_PSR
		default n
		help
		This option enables Single-frame Update for Panel Self Refresh (PSR)
		on the Phytium Embedded DisplayPort.
		It allows for updates to be made to a single frame without refreshing the entire display,
		further enhancing power efficiency. Enable this feature if you require single-frame updates.

config PHYTIUM_LOW_FPS
		bool "enable Lower Refresh Rate for Phytium Embedded DisplayPort"
		depends on DRM_PHYTIUM
		default n
		help
		This option enables a lower refresh rate for the Phytium Embedded DisplayPort.
		Lowering the refresh rate can reduce power consumption and is useful in scenarios
		where high refresh rates are not necessary. Enable this feature if you
		want to optimize for power efficiency over performance.
```

## package/kernel/phytium-d3000m/src/npu_driver/phytium-npu/Kconfig
```kconfig
# SPDX-License-Identifier: GPL-2.0
config PHYTIUM_NPU
        tristate "Phytium neural network processing unit"
	    help
	      Say Y here if your want support for Phytium NPU controller framework.
	      This is common support for devices that embed the Phytium NPU IP.

	      To compile this driver as a module, choose M here: the module will be
	      called phytium_npu.

if PHYTIUM_NPU
config PHYTIUM_NPU_PLATFORM
		tristate "Phytium NPU platform support"
		depends on ARCH_PHYTIUM && (ACPI || OF)
		depends on PHYTIUM_NPU
	    help
	      Say Y here if you want to support for IO Mapped Phytium NPU controller.
	      This support is for devices that have the Phytium NPU controller IP.

	      To compile this driver as a module, choose M here: the module will be
	      called phytium_npu_platform.

config PHYTIUM_NPU_PCI
		tristate "Phytium NPU PCI support"
		depends on PCI
		depends on PHYTIUM_NPU
	    help
	      Say Y here if you want to support for Phytium NPU controller connected
	      to the PCI bus. This support is for devices that have the Phytium NPU
	      controller IP embedded into a PCI device.

	      To compile this driver as a module, choose M here: the module will be
	      called phytium_npu_pci.
endif
```

## package/libs/ncurses/Config.in
```kconfig
# libncurses advanced configuration

menu "Configuration"
        depends on PACKAGE_libncurses

config LIBNCURSES_TERMINFO
        string "extra terminfo files"
	help
	  Whitespace separated list of terminfo files to install
	  beyond the default terminfo files.

endmenu
```
