## target/linux/phytium/files-6.18/Documentation/devicetree/bindings/remoteproc/homo-rproc.txt
```
homogeneous remoteproc driver
==========================================

This driver implements communication between remote processors under a homogeneous CPU architecture(SMP).

Homogeneous RemoteProc Device Node:
=================================
A homo_remoteproc device node is used to represent the remote core instance within SoC.

The parent node defines up to two child nodes, each representing a remote processor.

Required properties:
--------------------
 - compatible : the parent node should be "homo,rproc", and the child node can be "homo,rproc-core"
 - remote-processor: remote processor's linux cpu logical number
 - inter-processor-interrupt: IPI/SGI interrupt number
 - memory-region: reserved memory which will be used by remote processor
 - firmware-name: the name of openamp image

Example:
--------

    reserved-memory {
        #address-cells = <0x2>;
        #size-cells = <0x2>;
        ranges;
        rproc0: rproc0@b0100000 {
            no-map;
            reg = <0x0 0xb0100000 0x0 0x19900000>;
        };
        rproc1: rpro1c@d0100000 {
            no-map;
            reg = <0x0 0xd0100000 0x0 0x19900000>;
        };
    };

    homo_rproc: homo_rproc@0 {
        compatible = "homo,rproc";
        status = "disabled";
        homo_core0: homo_core0@b0100000 {
            compatible = "homo,rproc-core";
            remote-processor = <3>;
            inter-processor-interrupt = <9>;
            memory-region = <&rproc0>;
            firmware-name = "openamp_core0.elf";
        };
        homo_core1: homo_core1@d0100000 {
            compatible = "homo,rproc-core";
            remote-processor = <2>;
            inter-processor-interrupt = <10>;
            memory-region = <&rproc1>;
            firmware-name = "openamp_core1.elf";
        };
    };
```

## target/linux/phytium/files-6.18/drivers/net/ethernet/phytium/Kconfig
```kconfig
# SPDX-License-Identifier: GPL-2.0-only
#
# Phytium device configuration
#

config NET_VENDOR_PHYTIUM
	bool "Phytium devices"
	depends on ARM64
	depends on HAS_IOMEM
	default y
	help
	  If you have a network (Ethernet) card belonging to this class, say Y.

	  Note that the answer to this question doesn't directly affect the
	  kernel: saying N will just cause the configurator to skip all the
	  remaining Cadence network card questions. If you say Y, you will be
	  asked for your specific card in the following questions.

if NET_VENDOR_PHYTIUM

config PHYTMAC
	tristate "Phytium GMAC support"
	depends on HAS_DMA
	select PHYLINK
	select CRC32
	help
	  If you have a network (Ethernet) controller of this type, say Y
	  or M here.

	  To compile this driver as a module, choose M here: the module
	  will be phytmac.

config PHYTMAC_ENABLE_PTP
	bool "Enable IEEE 1588 hwstamp"
	depends on PHYTMAC
	depends on PTP_1588_CLOCK
	default y
	help
	  Enable IEEE 1588 PTP support for PHYTMAC.

config PHYTMAC_PLATFORM
	tristate "Phytmac Platform support"
	depends on PHYTMAC
	help
	  This is Platform driver.

	  To compile this driver as a module, choose M here: the module
	  will be called phytmac_platform.

config PHYTMAC_PCI
	tristate "Phytmac PCI support"
	depends on PHYTMAC && PCI
	help
	  This is PCI driver.

	  To compile this driver as a module, choose M here: the module
	  will be called phytmac_pci.

endif # NET_VENDOR_PHYTIUM
```

## target/linux/phytium/files-6.18/drivers/usb/phytium/Kconfig
```kconfig
config USB_PHYTIUM
	tristate "PHYTIUM USB Support"
	depends on USB
	depends on USB_GADGET && ARCH_PHYTIUM
	help
	  Say Y or M here if your system has a OTG USB Controller based on PHYTIUM SOC.

	  If you choose to build this driver is a dynamically linked modules, the module will
          be called phytium-usb.ko

config USB_PHYTIUM_PCI
	tristate "PHYTIUM PCI USB Support"
	default n
	depends on USB
	depends on USB_GADGET && ARCH_PHYTIUM
	help
	  Say Y or M here if your system has a OTG USB Controller based on PHYTIUM SOC.

	  If you choose to build this driver is a dynamically linked modules, the module will
          be called phytium-usb-pci.ko
```

## target/linux/phytium/files-6.18/sound/soc/phytium/Kconfig
```kconfig
# SPDX-License-Identifier: GPL-2.0
comment "Phytium I2S Driver and Phytium I2S V2 Driver are generally not used together"
	depends on SND_SOC_PHYTIUM_I2S && SND_SOC_PHYTIUM_I2S_V2

config SND_SOC_PHYTIUM_I2S
	tristate "Phytium I2S Device Driver"
	depends on ARCH_PHYTIUM
	help
	 Say Y or M if you want to add support for I2S driver for
	 Phytium I2S device . The device supports 2 channels each
	 for play and record.

config SND_PMDK_ES8388
	tristate "Phytium machine support with ES8388"
	depends on I2C && SND_SOC_PHYTIUM_I2S
	select SND_SOC_ES8388
	help
	 Say Y if you want to add Phytium machine support for
	 ES8388 codecs.

config SND_PMDK_ES8336
	tristate "Phytium machine support with ES8336"
	depends on I2C && SND_SOC_PHYTIUM_I2S
	select SND_SOC_ES8336
	help
	 Say Y if you want to add Phytium machine support for
	 ES8336 codecs.

config SND_PMDK_MA1026
	tristate "Phytium machine support with MA1026"
	depends on I2C && SND_SOC_PHYTIUM_I2S
	select SND_SOC_MA1026
	help
	 Say Y if you want to add Phytium machine support for
	 MA1026 codecs.

config SND_SOC_PHYTIUM_I2S_V2
        tristate "Phytium I2S V2 Device Driver"
	depends on ARCH_PHYTIUM
        help
         Say Y or M if you want to add support for I2S v2 driver for
         Phytium I2S device . The device supports 2 channels each
         for play and record.

config SND_SOC_PHYTIUM_MACHINE_V2
        tristate "Phytium Machine V2 Driver"
        depends on SND_SOC_PHYTIUM_I2S_V2
        help
         Say Y or M if you want to add Phytium machine v2 support for
         codecs.

config SND_PMDK_DP
	tristate "Phytium machine support with DP"
	depends on SND_SOC_PHYTIUM_I2S || SND_SOC_PHYTIUM_I2S_V2
	select SND_SOC_HDMI_CODEC
	help
	 Say Y if you want to add Phytium machine support for
	 Displayport.
```

## target/linux/qcom/image/Config.in
```kconfig
config GRUB_BOOTOPTS
	default "" if TARGET_qcom

config GRUB_TIMEOUT
	default "3" if TARGET_qcom
```

## target/linux/zte/image/Config.in
```kconfig
if TARGET_zte

config KERNEL_DEVTMPFS
	default y

config KERNEL_DEVTMPFS_MOUNT
	default y

endif
```
