## package/kernel/lantiq/ltq-vmmc/Config.in
```kconfig
choice
	prompt "device selection"
	depends on PACKAGE_kmod-ltq-vmmc
	default VOICE_CPE_VMMC_WITH_DEVICE_DANUBE
	help
		Select the target device.

	config VOICE_CPE_VMMC_WITH_DEVICE_DANUBE
		bool "Danube, Twinpass, Vinax"
		depends on TARGET_lantiq_xway

#	config VOICE_CPE_VMMC_WITH_DEVICE_AR9
#		bool "AR9 family"
#		depends on TARGET_lantiq_ar9

	config VOICE_CPE_VMMC_WITH_DEVICE_VR9
		bool "VR9 family"
		depends on TARGET_lantiq_xrx200
	
	config VOICE_VMMC_WITH_DEVICE_FALCON
		bool "FALC-ON"
		depends on (TARGET_lantiq_falcon||TARGET_lantiq_falcon_stable)

endchoice

choice
	depends on (PACKAGE_kmod-ltq-vmmc && VOICE_VMMC_WITH_DEVICE_FALCON)
	prompt "FXS coefficients"
	default LTQ_VOICE_CPE_VMMC_COEF_FALCON_ETSI
	help
		Select country specific FXS coefficient file.

	config LTQ_VOICE_CPE_VMMC_COEF_FALCON_ETSI
		bool "ETSI_T3R10: Vl:40V, Ic:25mA, Vid:25V, Vri:45Vrms, f:25Hz"	
		help
		  These coefficents contains a parameter set with line impedance Zr according to ETSI.

		  T:   gain in transmit direction (attenuation 3dBr) [dBr]
		  R:   gain in receive direction (attenuation 10dBr) [dBr]
		  Vl:  on-hook voltage limit [V]
		  Ic:  off-hook loop current [mA]
		  Vid: low-power-standby voltage [V]
		  Vri: ring voltage [v]
		  f:   ring frequency [V]

	config LTQ_VOICE_CPE_VMMC_COEF_FALCON_US600R
		bool "USA_600R_T3R10: Vl:40V, Ic:25mA, Vid:25V, Vri:45V, f:20Hz"
		help
		  These coefficents contains a parameter set with line impedance e.g. for USA.
 
		  T:   gain in transmit direction (attenuation 3dBr) [dBr]
		  R:   gain in receive direction (attenuation 10dBr) [dBr]
		  Vl:  on-hook voltage limit [V]
		  Ic:  off-hook loop current [mA]
		  Vid: low-power-standby voltage [V]
		  Vri: ring voltage [v]
		  f:   ring frequency [V]

	config LTQ_VOICE_CPE_VMMC_COEF_FALCON_USE_CUSTOM_FILE
		bool "Select own FXS coefficient file"
endchoice

config VOICE_CPE_VMMC_PMC
	depends on BROKEN
	depends on (VOICE_CPE_VMMC_WITH_DEVICE_AR9 || VOICE_CPE_VMMC_WITH_DEVICE_VR9)
	bool "Power Management Control support"
	default n
	help
		Option to enable Power Management Control on AR9, VR9. Not supported for Danube.

config VOICE_CPE_VMMC_DISABLE_DECT_NIBBLE_SWAP
	bool "Disable DECT nibble swap"
	depends on PACKAGE_kmod-ltq-vmmc
	default n
	help
		Option to disable DECT nibble swap for COSIC modem (for backward compatibility only).

config VOICE_CPE_VMMC_EVENT_LOGGER
	depends on BROKEN
	bool "Event logger support"
	depends on PACKAGE_kmod-ltq-vmmc
	default n
	help
		Option to enable details traces between drv_vmmc and the voice FW
		- for debugging only
		- requires package ifx-evtlog

config VOICE_CPE_VMMC_MPS_HISTORY_SIZE
	int "MPS history buffer in words (0<=size<=512)"
	depends on PACKAGE_kmod-ltq-vmmc
	default "128"
	help
		MPS history buffer (default=128 words, maximum=512 words, 0=disable)
		To opimize the memory footprint in RAM, you might want to set the
		buffer size to 0.
```

## package/kernel/leds-apu2/src/Kconfig
```kconfig
config LEDS_APU2
        tristate "PC Engines APU2/APU3 LED support"
        depends on LEDS_CLASS
        depends on LEDS_GPIO
        depends on GPIOLIB
        help
          Say yes here to enable support for the CPU GPIO pins on the PC Engines
          APU2/APU3 board, which enables the front LEDs and Reset Button.
```

## package/kernel/mtk-eip93/Config.in
```kconfig
if PACKAGE_kmod-crypto-hw-eip93

config MTK_EIP93_GENERIC_SW_MAX_LEN
	int "Max skcipher software fallback length"
	default 256
	help
		Max length of crypt request which
		will fallback to software crypt of skcipher *except* AES-128.

config MTK_EIP93_AES_128_SW_MAX_LEN
	int "Max AES-128 skcipher software fallback length"
	default 512
	help
		Max length of crypt request which
		will fallback to software crypt of AES-128 skcipher.

endif
```

## package/kernel/rotary-gpio-custom/src/Kconfig
```kconfig
config ROTARY_GPIO_CUSTOM
	tristate "Custom GPIO-based rotary driver"
	depends on GENERIC_GPIO
	help
	  This is a driver to register 1 to 4 custom rotary encoder using
	  GPIO lines.

	  This support is also available as a module.  If so, the module
	  will be called rotary-gpio-custom.
```

## package/kernel/shortcut-fe/src/Kconfig
```kconfig
#
# Shortcut forwarding engine
#

config SHORTCUT_FE
	tristate "Shortcut Forwarding Engine"
	depends on NF_CONNTRACK
	---help---
	  Shortcut is a fast in-kernel packet forwarding engine.

	  To compile this code as a module, choose M here: the module will be
	  called shortcut-fe.

	  If unsure, say N.
```

## package/kernel/spi-gpio-custom/src/Kconfig
```kconfig
config SPI_GPIO_CUSTOM
	tristate "Custom GPIO-based SPI driver"
	depends on GENERIC_GPIO
	select SPI_GPIO
	help
	  This is an SPI driver to register 1 to 4 custom SPI buses using
	  GPIO lines. Each bus can have up to 8 slaves.
	  The devices will be exposed to userspace as /dev/spidevX.X
	  
	  This module is maily intended to interface microcontrollers
	  and other SPI devices without a specific kernel driver.

	  This support is also available as a module.  If so, the module
	  will be called spi-gpio-custom.
```

## package/kernel/w1-gpio-custom/src/Kconfig
```kconfig
config W1_MASTER_GPIO_CUSTOM
	tristate "Custom GPIO-based W1 driver"
	depends on GENERIC_GPIO
	select W1_GPIO
```

## package/kernel/wrt55agv2-spidevs/src/Kconfig
```kconfig
config WRT55AGV2_SPIDEVS
	tristate "SPI device support for the WRT55AG v2 board"
	depends on SPI && MIPS_ATHEROS
```

## package/lean/dvb/tvheadend/Config.in
```kconfig
config TVHEADEND_NDMS_CWC_SUPPORT
	bool "NewCamd support"
	default y

config TVHEADEND_NDMS_LINUXDVB_SUPPORT
	bool "Linux DVB support"
	default y

config TVHEADEND_NDMS_DVBSCAN_SUPPORT
	bool "Fetch DVB-scan data"
	depends on TVHEADEND_NDMS_LINUXDVB_SUPPORT
	default TVHEADEND_NDMS_LINUXDVB_SUPPORT

config TVHEADEND_NDMS_AVAHI_SUPPORT
	bool "Avahi client support"
	select PACKAGE_libavahi-client
	default n
```

## package/lean/luci-app-qbittorrent/Config.in
```kconfig
choice
		prompt "qBittorrent Version"
		default CONFIG_qBittorrent_Static

config qBittorrent_Static
	bool "qBittorrent Static Version"
	depends on HAS_FPU
	default y if x86_64||arm||aarch64
	
config qBittorrent_Nox
	bool "qBittorrent Nox Version"
	default y if !(x86_64||arm||aarch64)
endchoice
```

## package/lean/luci-app-unblockmusic/Config.in
```kconfig
config UnblockNeteaseMusic_Go
	bool "UnblockNeteaseMusic Golang Version"
	default y if i386||x86_64||arm||aarch64

config UnblockNeteaseMusic_NodeJS
	bool "UnblockNeteaseMusic NodeJS Version"
	depends on HAS_FPU || KERNEL_MIPS_FPU_EMULATOR
	default n
```
