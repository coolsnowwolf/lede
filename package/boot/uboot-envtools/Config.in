## package/lean/mt/drivers/mt7603e/config.in
```kconfig
if PACKAGE_kmod-mt7603e

#if FIRST_IF_MT7603E || SECOND_IF_MT7603E
config MT7603E_FIRST_IF_MT7603E
	bool
	default y
	depends on PACKAGE_kmod-mt7603e

config MT7603E_RLT_WIFI
	tristate "MT WIFI Driver"
	default y

config MT7603E_MT_WIFI_PATH
	string
	depends on MT7603E_RLT_WIFI
	default "rlt_wifi"

if MT7603E_RLT_WIFI
menu "WiFi Generic Feature Options"

if MT7603E_FIRST_IF_MT7603E
choice
	prompt "EEPROM Type of 1st Card"
	default MT7603E_FIRST_IF_EEPROM_FLASH
	#depends on ! FIRST_IF_NONE

	config MT7603E_FIRST_IF_EEPROM_FLASH
		bool "FLASH"

	config MT7603E_FIRST_IF_EEPROM_PROM
		bool "EEPROM"

	config MT7603E_FIRST_IF_EEPROM_EFUSE
		bool "EFUSE"
endchoice

config MT7603E_RT_FIRST_CARD_EEPROM
	string
	#depends on ! FIRST_IF_NONE
	default "prom" if MT7603E_FIRST_IF_EEPROM_PROM
	default "efuse" if MT7603E_FIRST_IF_EEPROM_EFUSE
	default "flash" if MT7603E_FIRST_IF_EEPROM_FLASH
endif

config MT7603E_MULTI_INF_SUPPORT
	bool
	#default y if !FIRST_IF_NONE && !SECOND_IF_NONE
	default y

#config MT7603E_WIFI_BASIC_FUNC
#    bool "Basic Functions"
#    select WIRELESS_EXT
#    select WEXT_SPY
#    select WEXT_PRIV

config MT7603E_WSC_INCLUDED
	bool "WSC (WiFi Simple Config)"
#    depends on WIFI_DRIVER
	default y

config MT7603E_WSC_V2_SUPPORT
	bool "WSC V2(WiFi Simple Config Version 2.0)"
	depends on MT7603E_MMT_WSC_INCLUDED
	default y
config MT7603E_WSC_NFC_SUPPORT
	bool "WSC out-of-band(NFC)"
#       depends on WIFI_DRIVER
		default n
config MT7603E_DOT11N_DRAFT3
	bool "802.11n Draft3"
#    depends on WIFI_DRIVER
	default y

#config MT7603E_DOT11_VHT_AC
#    bool "802.11 ac"
#    depends on WIFI_DRIVER
#    default n

config MT7603E_DOT11W_PMF_SUPPORT
	bool "PMF Support"
#    depends on WIFI_DRIVER
	default y

config MT7603E_TXBF_SUPPORT
	bool "Tx Bean Forming Support"
#    depends on WIFI_DRIVER
	default n

#config MT7603E_WMM_ACM_SUPPORT
#    bool "WMM ACM"
#    depends on WIFI_DRIVER
#   default n

config MT7603E_LLTD_SUPPORT
	bool "LLTD (Link Layer Topology Discovery Protocol)"
#    depends on WIFI_DRIVER
	default y

config MT7603E_QOS_DLS_SUPPORT
	bool "802.11e DLS ((Direct-Link Setup) Support"
#    depends on WIFI_DRIVER
	default n

config MT7603E_WAPI_SUPPORT
	bool "WAPI Support"
#    depends on WIFI_DRIVER
	default n

config MT7603E_CARRIER_DETECTION_SUPPORT
	bool "Carrier Detect"
#    depends on WIFI_DRIVER
	default n

config MT7603E_IGMP_SNOOP_SUPPORT
	bool "IGMP Snooping"
#    depends on WIFI_DRIVER
	default n

config MT7603E_BLOCK_NET_IF
	bool "NETIF Block"
#    depends on WIFI_DRIVER
	default n
	help
	Support Net interface block while Tx-Sw queue full

#config MT7603E_MT_TXBF_SUPPORT
#    bool "Tx Bean Forming Support (Only 3883)"
#    depends on WIFI_DRIVER
#    depends on RALINK_RT2883 || RALINK_RT3883
#    default n

#config MT7603E_MT_VIDEO_TURBINE_SUPPORT
#    bool "Video Turbine support"
#    depends on WIFI_DRIVER
#   default n

#config MT7603E_RATE_ADAPTION
#    tristate "Ralink Flow Classifier"
#    depends on WIFI_DRIVER
#    default n

config MT7603E_NEW_RATE_ADAPT_SUPPORT
	bool "New Rate Adaptation support"
#    depends on WIFI_DRIVER
	default y

config MT7603E_MT_NEW_RATE_ADAPT_SUPPORT
	bool "Intelligent Rate Adaption"
#    depends on WIFI_DRIVER && MT_RATE_ADAPTION
	default y

config MT7603E_AGS_SUPPORT
	bool "Adaptive Group Switching"
	depends on MT7603E_MT_RATE_ADAPTION
	default n

config MT7603E_IDS_SUPPORT
	bool "IDS (Intrusion Detection System) Support"
#    depends on WIFI_DRIVER
	default n

config MT7603E_WIFI_WORK_QUEUE
	bool "Work Queue"
#    depends on WIFI_DRIVER
	default n

config MT7603E_WIFI_SKB_RECYCLE
	bool "SKB Recycle(Linux)"
#    depends on WIFI_DRIVER
	default n

config MT7603E_RTMP_FLASH_SUPPORT
	bool "Flash Support"
#    depends on WIFI_DRIVER
	default y

config MT7603E_LED_CONTROL_SUPPORT
	bool "LED Support"
#    depends on WIFI_DRIVER
	default n

config MT7603E_SINGLE_SKU
	bool "Single SKU"
#    depends on WIFI_DRIVER
	default n

config MT7603E_SINGLE_SKU_V2
	bool "Single SKU V2"
	depends on MT7603E_SINGLE_SKU && RALINK_RT6352
	default n

config MT7603E_HW_ANTENNA_DIVERSITY
	bool "Antenna Diversity Support"
	depends on MT7603E_RLT_AP_SUPPORT || MT7603E_RLT_STA_SUPPORT
	depends on RALINK_RT5350
	default n

config MT7603E_ATE_SUPPORT
	bool "ATE/QA Support"
#    depends on WIFI_DRIVER
	default y

config MT7603E_RT2860V2_AP_V24_DATA_STRUCTURE
	bool
#    depends on WIFI_DRIVER
	default y

config MT7603E_RT2860V2_AP_32B_DESC
	bool "32 Byte Descriptor Support"
#    depends on WIFI_DRIVER
	depends on RALINK_RT6352 || RALINK_MT7620
	default n

config MT7603E_MEMORY_OPTIMIZATION
	bool "Memory Optimization"
#    depends on WIFI_DRIVER
	default n

#config MT7603E_RTMP_INTERNAL_TX_ALC
#    bool "TSSI Compensation"
#    depends on WIFI_DRIVER
#    depends on RALINK_RT3350 || RALINK_RT3352 || RALINK_RT5350 || RALINK_RT6352
#    default n

#config MT7603E_RTMP_TEMPERATURE_CALIBRATION
#    bool "Temperature Calibration"
#    depends on WIFI_DRIVER
#    depends on RALINK_RT6352
#    default n

config MT7603E_HOTSPOT
	bool "Passpoint-R1"
#    depends on WIFI_DRIVER
	default n

config MT7603E_MT_HOTSPOT_R2
	bool "Passpoint Release-2 Support"
	depends on HOTSPOT
	select MT7603E_MT_DOT11W_PMF_SUPPORT
	default n

config MT7603E_MT_RTMP_TEMPERATURE_TX_ALC
	bool "Temperature Tx Power Compensation"
#        depends on WIFI_DRIVER
		default n

config MT7603E_UAPSD
	bool "UAPSD support"
#    depends on WIFI_DRIVER
	default y


#
# Section for chip architectures
#
# "RLT MAC Support"
config MT7603E_RLT_MAC
	bool
#	depends on WIFI_DRIVER
	default n

config MT7603E_RLT_BBP
	bool

config MT7603E_RLT_RF
	bool

# "RTMP MAC Support"
config MT7603E_RTMP_MAC
	bool
	depends on WIFI_DRIVER
	default n

config MT7603E_RTMP_BBP
	bool

config MT7603E_RTMP_RF
	bool

#config MT7603E_MT_EPA_ELNA
#    bool "ePAeLNA"
#    depends on WIFI_DRIVER
#    default n
#choice
#       prompt "PA,LNA Type"
#        depends on MT7603E_MT_WIFI
#
#       config MT7603E_MT_IPA_ILNA
#       bool "iPAiLNA"
#
#        config MT7603E_MT_IPA_ELNA
#        bool "iPAeLNA"
#
#        config MT7603E_MT_EPA_ILNA
#        bool "ePAiLNA"
#
#        config MT7603E_MT_EPA_ELNA
#        bool "ePAeLNA"
#endchoice
#
#config MT7603E_MT_PA_LNA
#        string
#        depends on MT7603E_MT_WIFI
#        default "iPAiLNA" if MT7603E_MT_IPA_ILNA
#        default "iPAeLNA" if MT7603E_MT_IPA_ELNA
#        default "ePAiLNA" if MT7603E_MT_EPA_ILNA
#        default "ePAeLNA" if MT7603E_MT_EPA_ELNA
#
#
# Section for chip architectures
#
# "RLT MAC Support"
#config MT7603E_RLT_MAC
#    bool
#    depends on WIFI_DRIVER
#    default n

#config MT7603E_RLT_BBP
#    bool

#config MT7603E_RLT_RF
#    bool

# "RTMP MAC Support"
#config MT7603E_RTMP_MAC
#    bool
#    depends on WIFI_DRIVER
#    default n

#config MT7603E_RTMP_BBP
#        bool

#config MT7603E_RTMP_RF
#        bool

#
# Section for interfaces
#
config MT7603E_RTMP_PCI_SUPPORT
	bool

config MT7603E_RTMP_USB_SUPPORT
	bool

config MT7603E_RTMP_RBUS_SUPPORT
	bool

endmenu

menu "WiFi Operation Modes"
	choice
		prompt "Main Mode"
		default MT7603E_MT_WIFI_MODE_AP

		config MT7603E_MT_WIFI_MODE_AP
			bool "AP"

		config MT7603E_MT_WIFI_MODE_STA
			bool "STA"

		config MT7603E_MT_WIFI_MODE_BOTH
			bool "APSTA"
	endchoice

	if MT7603E_MT_WIFI_MODE_AP || MT7603E_MT_WIFI_MODE_BOTH

config MT7603E_RLT_AP_SUPPORT
	tristate "UnifyMAC 802.11n AP support"
	default y
#    depends on NET_RADIO
	select WIRELESS_EXT
	select WEXT_SPY
	select WEXT_PRIV

config MT7603E_WDS_SUPPORT
	bool "WDS"
	depends on MT7603E_RLT_AP_SUPPORT
	default n

config MT7603E_MBSS_SUPPORT
	bool "MBSSID"
	depends on MT7603E_RLT_AP_SUPPORT
	default y

config MT7603E_NEW_MBSSID_MODE
	bool "New MBSSID MODE"
	depends on MT7603E_RLT_AP_SUPPORT && MT7603E_MBSS_SUPPORT
	# depends on RALINK_RT3883 || RALINK_RT3352 || RALINK_RT5350 || RALINK_RT6352 || RALINK_MT7620 || RALINK_MT7621
	default n

config MT7603E_ENHANCE_NEW_MBSSID_MODE
	bool "Enhanced MBSSID mode"
	depends on MT7603E_NEW_MBSSID_MODE
	default n
config MT7603E_CFG80211_SUPPORT
	bool "CFG80211"
	depends on MT7603E_RLT_AP_SUPPORT
	default n

config MT7603E_SNIFFER_MIB_CMD
	bool "SNIFFER_MIB_CMD"
	depends on MT7603E_SNIFFER_SUPPORT
	default n

config MT7603E_ALL_NET_EVENT
	bool "ALL_NET_EVENT"
	depends on MT7603E_RLT_AP_SUPPORT
	default n

config MT7603E_ACL_V2_SUPPORT
	bool "ACL_V2"
	depends on MT7603E_RLT_AP_SUPPORT


config MT7603E_APCLI_SUPPORT
	bool "AP-Client Support"
	depends on MT7603E_RLT_AP_SUPPORT
	default y
config MT7603E_MULTI_APCLI_SUPPORT
	bool "MULTI AP-Client Support"
	depends on MT7603E_APCLI_SUPPORT
	default y
config MT7603E_MAC_REPEATER_SUPPORT
	bool "MAC Repeater Support"
	depends on MT7603E_RLT_AP_SUPPORT
	depends on MT7603E_APCLI_SUPPORT
	depends on RALINK_RT6352 || RALINK_MT7620 || MT7603E_RALINK_MT7603E
	default y
config MT7603E_AIRPLAY_SUPPORT
	bool "AirPlay Support"
	depends on MT7603E_APCLI_SUPPORT

#config MT7603E_MT_MESH_SUPPORT
#    bool "MESH Support"
#    depends on MT7603E_RLT_AP_SUPPORT

config MT7603E_DFS_SUPPORT
	bool "DFS"
	depends on MT7603E_RLT_AP_SUPPORT
	select RALINK_TIMER_DFS

#config MT7603E_DOT11R_FT_SUPPORT
#    bool "802.11r Fast BSS Transition"
#    depends on MT7603E_RLT_AP_SUPPORT

#config MT7603E_DOT11K_RRM_SUPPORT
#    bool "802.11k Radio Resource Management"
#    depends on MT7603E_RLT_AP_SUPPORT

config MT7603E_LLTD_SUPPORT
	bool "LLTD (Link Layer Topology Discovery Protocol)"
	depends on MT7603E_RLT_AP_SUPPORT
	default y

config MT7603E_NINTENDO_AP
	bool "Nintendo AP"
	depends on MT7603E_RLT_AP_SUPPORT

config MT7603E_COC_SUPPORT
	bool "CoC Support"
	depends on MT7603E_RLT_AP_SUPPORT
	default n

#config MT7603E_ RT2860V2_SNMP
#    bool "Net-SNMP Support"
#    depends on MT7603E_RLT_AP_SUPPORT

config MT7603E_MCAST_RATE_SPECIFIC
	bool "User specific tx rate of mcast pkt"
	depends on MT7603E_RLT_AP_SUPPORT
config MT7603E_PREVENT_ARP_SPOOFING_SUPPORT
	bool "Detect ARP spoof pkts attack"
	depends on MT7603E_RLT_AP_SUPPORT

#config MT7603E_EXT_BUILD_CHANNEL_LIST
#    bool "Extension Channel List"
#   depends on MT7603E_RLT_AP_SUPPORT

#config MT7603E_AUTO_CH_SELECT_ENHANCE
#    bool "Auto Channel Selection Enhancement"
#    depends on MT7603E_RLT_AP_SUPPORT

config MT7603E_MULTI_CORE_SUPPORT
	bool "multi core support"
	depends on TARGET_ramips_mt7621
	default n

	endif

	source "./src/mt7603_wifi_ap/Kconfig"

endmenu

#"MT7603E"
config MT7603E_RALINK_MT7603E
	bool
	default y
	select MT7603E_RTMP_PCI_SUPPORT

endif

#if MT7603E_RLT_MAC
#    config MT7603E_RLT_MAC
#        bool
#        default y
#endif

#if MT7603E_RTMP_MAC
#    config MT7603E_RTMP_MAC
#        bool
#        default y
#endif

#if MT7603E_MT_MAC
if MT7603E_RALINK_MT7603E
	config MT7603E_MT_MAC
		bool
		default y
endif
#endif MT7603E_MT_WIFI
#endif
#endif FIRST_IF_MT7603E || SECOND_IF_MT7603E
endif
```
