## package/wwan/driver/quectel_SRPD_PCIE/src/pcie/Kconfig
```kconfig
config SPRD_PCIE_EP_DEVICE
	tristate "SPRD PCIE EP device"
	default n
	depends on PCI
	help
	  SPRD pcie ep device driver in host side for Spreadtrum.
```

## package/wwan/driver/quectel_SRPD_PCIE/src/sipa/Kconfig
```kconfig
menu "SIPA modules"

config SPRD_SIPA
    bool "sipa ipa"
    default n
    help
      sipa is a module for spreadtrum ip packet accelator driver.

endmenu
```

## package/wwan/driver/quectel_SRPD_PCIE/src/sipc/Kconfig
```kconfig
menu "SIPC modules"

config SPRD_SIPC
	bool "Sprd IPC"
	default n
	select GENERIC_ALLOCATOR
	help
	  SIPC is a module for spreadtrum AP/CP communicaiton system.

config SPRD_SIPC_SPIPE
	bool "SPRD pipe driver based on SBUF"
	default n
	depends on SPRD_SIPC
	help
	  This driver is a pipe driver base on SBUF, which create
	  general pipes between AP & CP.

config SPRD_SIPC_SPOOL
	bool "SPRD pool driver based on SBLOCK"
	default n
	depends on SPRD_SIPC
	help
	  This driver is a pool driver base on SBLOCK, which create
	  general pools between AP & CP.

endmenu
```

## target/Config.in
```kconfig
source "tmp/.config-target.in"

# Kernel/Hardware features

config HAS_TESTING_KERNEL
	bool

config HAS_SPE_FPU
	depends on powerpc
	select HAS_FPU
	bool

config HAS_FPU
	bool

config HAS_DT_OVERLAY_SUPPORT
	bool

config AUDIO_SUPPORT
	bool

config GPIO_SUPPORT
	bool

config PCI_SUPPORT
	select AUDIO_SUPPORT
	bool

config PCIE_SUPPORT
	bool

config PCMCIA_SUPPORT
	bool

config PWM_SUPPORT
	bool

config USB_SUPPORT
	select AUDIO_SUPPORT
	bool

config USB_GADGET_SUPPORT
	bool

config RTC_SUPPORT
	bool

config BIG_ENDIAN
	bool

config USES_DEVICETREE
	bool

config USES_INITRAMFS
	bool

config USES_SEPARATE_INITRAMFS
	bool

config USES_SQUASHFS
	bool

config USES_JFFS2
	bool

config USES_JFFS2_NAND
	bool

config USES_EXT4
	bool

config USES_TARGZ
	bool

config USES_CPIOGZ
	bool

config USES_MINOR
	bool

config USES_UBIFS
	bool
	select NAND_SUPPORT

config LOW_MEMORY_FOOTPRINT
	bool

config SMALL_FLASH
	bool

config NOMMU
	bool

config HAS_MIPS16
	depends on (mips || mipsel || mips64 || mips64el)
	bool

config RFKILL_SUPPORT
	bool

config EMMC_SUPPORT
	bool

config NAND_SUPPORT
	bool

config LEGACY_SDCARD_SUPPORT
	bool

config ARCH_64BIT
	bool

config VIRTIO_SUPPORT
	bool

config USES_ROOTFS_PART
	bool

config USES_BOOT_PART
	bool

# Architecture selection

config aarch64
	select ARCH_64BIT
	bool

config aarch64_be
	select ARCH_64BIT
	select BIG_ENDIAN
	bool

config arc
	bool

config arceb
	select BIG_ENDIAN
	bool

config arm
	bool

config armeb
	select BIG_ENDIAN
	bool

config arm_v6
	bool

config arm_v7
	bool

config i386
	bool

config i686
	bool 

config m68k
	bool

config mips
	select BIG_ENDIAN
	bool

config mipsel
	bool

config mips64
	select BIG_ENDIAN
	select ARCH_64BIT
	bool

config mips64el
	select ARCH_64BIT
	bool

config powerpc
	select BIG_ENDIAN
	bool

config powerpc64
	select BIG_ENDIAN
	select ARCH_64BIT
	bool

config sh3
	bool

config sh3eb
	select BIG_ENDIAN
	bool

config sh4
	bool

config sh4eb
	select BIG_ENDIAN
	bool

config sparc
	select BIG_ENDIAN
	bool

config x86_64
	select ARCH_64BIT
	bool

config ARCH
	string
	default "aarch64"   if aarch64
	default "aarch64_be" if aarch64_be
	default "arc"       if arc
	default "arceb"     if arceb
	default "arm"       if arm
	default "armeb"     if armeb
	default "i386"      if i386
	default "i686"      if i686
	default "m68k"      if m68k
	default "mips"      if mips
	default "mipsel"    if mipsel
	default "mips64"    if mips64
	default "mips64el"  if mips64el
	default "powerpc"   if powerpc
	default "powerpc64" if powerpc64
	default "sh3"       if sh3
	default "sh3eb"     if sh3eb
	default "sh4"       if sh4
	default "sh4eb"     if sh4eb
	default "sparc"     if sparc
	default "x86_64"    if x86_64
```

## target/imagebuilder/Config.in
```kconfig
config IB
	bool "Build the OpenWrt Image Builder"
	depends on !EXTERNAL_TOOLCHAIN
	default BUILDBOT
	help
	  This is essentially a stripped-down version of the buildroot
	  with precompiled packages, kernel image and image building tools.
	  You can use it to generate custom images without compiling anything

config IB_STANDALONE
	bool "Include package repositories"
	default y if !BUILDBOT
	depends on IB
	help
	  Disabling this option will cause the ImageBuilder to embed only
	  toolchain and kmod packages while all other ipk archives will be
	  fetched from online repositories.
```

## target/linux/adm5120/files-3.18/arch/mips/adm5120/Kconfig
```kconfig
if ADM5120

menu "ADM5120 Board selection"

config ADM5120_MACH_CAS_771
	bool "Cellvision CAS-771/771W support"
	depends on CPU_LITTLE_ENDIAN
	select ADM5120_SOC_BGA
	select ADM5120_OEM_CELLVISION
	default y

config ADM5120_MACH_NFS_101
	bool "Cellvision NFS-101U/101WU support"
	depends on CPU_LITTLE_ENDIAN
	select ADM5120_SOC_BGA
	select ADM5120_OEM_CELLVISION
	default y

config ADM5120_MACH_NP27G
	bool "Compex NP27G support"
	depends on CPU_LITTLE_ENDIAN
	select ADM5120_SOC_BGA
	select ADM5120_OEM_COMPEX
	default y

config ADM5120_MACH_NP28G
	bool "Compex NP28G support"
	depends on CPU_LITTLE_ENDIAN
	select ADM5120_SOC_BGA
	select ADM5120_OEM_COMPEX
	default y

config ADM5120_MACH_WP54
	bool "Compex WP54 family support"
	depends on CPU_LITTLE_ENDIAN
	select ADM5120_SOC_BGA
	select ADM5120_OEM_COMPEX
	default y

config ADM5120_MACH_EB_214A
	bool "EB-214A support"
	depends on CPU_LITTLE_ENDIAN
	select ADM5120_SOC_BGA
	select ADM5120_OEM_GENERIC
	default y

config ADM5120_MACH_BR_6104K
	bool "Edimax BR-6104K support"
	depends on CPU_LITTLE_ENDIAN
	select ADM5120_OEM_EDIMAX
	default y

config ADM5120_MACH_BR_6104KP
	bool "Edimax BR-6104KP support"
	depends on CPU_LITTLE_ENDIAN
	select ADM5120_OEM_EDIMAX
	default y

config ADM5120_MACH_BR_61X4WG
	bool "Edimax BR-6104WG/6114WG support"
	depends on CPU_LITTLE_ENDIAN
	select ADM5120_SOC_BGA
	select ADM5120_OEM_EDIMAX
	default y

config ADM5120_MACH_EASY5120_RT
	bool "Infineon EASY 5120-RT Reference Board support"
	depends on CPU_LITTLE_ENDIAN
	select ADM5120_SOC_BGA
	select ADM5120_OEM_INFINEON
	default y

config ADM5120_MACH_EASY5120_WVOIP
	bool "Infineon EASY 5120-WVoIP Reference Board support"
	depends on CPU_LITTLE_ENDIAN
	select ADM5120_SOC_BGA
	select ADM5120_OEM_INFINEON
	default y

config ADM5120_MACH_EASY5120P_ATA
	bool "Infineon EASY 5120P-ATA Reference Board support"
	depends on CPU_LITTLE_ENDIAN
	select ADM5120_OEM_INFINEON
	default y

config ADM5120_MACH_EASY83000
	bool "Infineon EASY 83000 Reference Board support"
	depends on CPU_LITTLE_ENDIAN
	select ADM5120_OEM_INFINEON
	default y

config ADM5120_MACH_RB_11X
	bool "MikroTik RouterBOARD 111/112 support"
	depends on CPU_LITTLE_ENDIAN
	select ADM5120_SOC_BGA
	select ADM5120_OEM_MIKROTIK
	default y

config ADM5120_MACH_RB_133
	bool "MikroTik RouterBOARD 133 support"
	depends on CPU_LITTLE_ENDIAN
	select ADM5120_SOC_BGA
	select ADM5120_OEM_MIKROTIK
	default y

config ADM5120_MACH_RB_133C
	bool "MikroTik RouterBOARD 133C support"
	depends on CPU_LITTLE_ENDIAN
	select ADM5120_SOC_BGA
	select ADM5120_OEM_MIKROTIK
	default y

config ADM5120_MACH_RB_150
	bool "MikroTik RouterBOARD 150 support"
	depends on CPU_LITTLE_ENDIAN
	select ADM5120_OEM_MIKROTIK
	default y

config ADM5120_MACH_RB_153
	bool "MikroTik RouterBOARD 153 support"
	depends on CPU_LITTLE_ENDIAN
	select ADM5120_SOC_BGA
	select ADM5120_OEM_MIKROTIK
	default y

config ADM5120_MACH_RB_192
	bool "MikroTik RouterBOARD 192 support"
	depends on CPU_LITTLE_ENDIAN
	select ADM5120_SOC_BGA
	select ADM5120_OEM_MIKROTIK
	default y

config ADM5120_MACH_PMUGW
	bool "Motorola Powerline MU Gateway"
	depends on CPU_LITTLE_ENDIAN
	select ADM5120_SOC_BGA
	select ADM5120_OEM_MOTOROLA
	default y

config ADM5120_MACH_5GXI
	bool "OSBRiDGE 5GXi/5XLi support"
	depends on CPU_LITTLE_ENDIAN
	select ADM5120_SOC_BGA
	select ADM5120_OEM_OSBRIDGE
	default y

config ADM5120_MACH_P_334WT
	bool "ZyXEL Prestige 334WT"
	depends on CPU_BIG_ENDIAN
	select ADM5120_SOC_BGA
	select ADM5120_OEM_ZYXEL
	default y

config ADM5120_MACH_P_335
	bool "ZyXEL Prestige 335/335WT"
	depends on CPU_BIG_ENDIAN
	select ADM5120_SOC_BGA
	select ADM5120_OEM_ZYXEL
	default y

endmenu

config ADM5120_SOC_BGA
	select HW_HAS_PCI
	def_bool n

config ADM5120_OEM_CELLVISION
	def_bool n

config ADM5120_OEM_COMPEX
	def_bool n

config ADM5120_OEM_EDIMAX
	def_bool n

config ADM5120_OEM_GENERIC
	def_bool n

config ADM5120_OEM_INFINEON
	def_bool n

config ADM5120_OEM_MIKROTIK
	def_bool n

config ADM5120_OEM_MOTOROLA
	def_bool n

config ADM5120_OEM_OSBRIDGE
	def_bool n

config ADM5120_OEM_ZYXEL
	def_bool n

config ARM_AMBA
	def_bool y

endif
```

## target/linux/allwinner/image/Config.in
```kconfig
config D1_SD_BOOT_PARTSIZE
	int "Boot (SD Card) filesystem partition size (in MB)"
	depends on TARGET_allwinner
	default 32
```

## target/linux/ar71xx/files-4.9/drivers/net/ethernet/atheros/ag71xx/Kconfig
```kconfig
config AG71XX
	tristate "Atheros AR7XXX/AR9XXX built-in ethernet mac support"
	depends on ATH79
	select PHYLIB
	help
	  If you wish to compile a kernel for AR7XXX/91XXX and enable
	  ethernet support, then you should always answer Y to this.

if AG71XX

config AG71XX_DEBUG
	bool "Atheros AR71xx built-in ethernet driver debugging"
	default n
	help
	  Atheros AR71xx built-in ethernet driver debugging messages.

config AG71XX_DEBUG_FS
	bool "Atheros AR71xx built-in ethernet driver debugfs support"
	depends on DEBUG_FS
	default n
	help
	  Say Y, if you need access to various statistics provided by
	  the ag71xx driver.

config AG71XX_AR8216_SUPPORT
	bool "special support for the Atheros AR8216 switch"
	default n
	default y if ATH79_MACH_WNR2000 || ATH79_MACH_MZK_W04NU
	help
	  Say 'y' here if you want to enable special support for the
	  Atheros AR8216 switch found on some boards.

endif
```

## target/linux/arc770/image/Config.in
```kconfig
config AXS10X_SD_BOOT_PARTSIZE
	int "Boot (SD Card) filesystem partition size (in MB)"
	depends on TARGET_arc770
	default 20
```

## target/linux/archs38/image/Config.in
```kconfig
config AXS10X_SD_BOOT_PARTSIZE
	int "Boot (SD Card) filesystem partition size (in MB)"
	depends on TARGET_archs38
	default 20
```

## target/linux/at91/image/Config.in
```kconfig
config AT91_DFBOOT
	bool "Build dataflashboot loader"
	depends on TARGET_at91
	default n

config FLEXIBITY_ROOT
	bool "Build Flexibity RootFS (with embedded kernel)"
	depends on TARGET_at91_flexibity
	default n
```

## target/linux/ath79/files/drivers/net/ethernet/atheros/ag71xx/Kconfig
```kconfig
config AG71XX_LEGACY
	tristate "Atheros AR7XXX/AR9XXX built-in ethernet mac support"
	depends on ATH79
	select PHYLIB
	help
	  If you wish to compile a kernel for AR7XXX/91XXX and enable
	  ethernet support, then you should always answer Y to this.

if AG71XX_LEGACY

config AG71XX_LEGACY_DEBUG
	bool "Atheros AR71xx built-in ethernet driver debugging"
	help
	  Atheros AR71xx built-in ethernet driver debugging messages.

config AG71XX_LEGACY_DEBUG_FS
	bool "Atheros AR71xx built-in ethernet driver debugfs support"
	depends on DEBUG_FS
	help
	  Say Y, if you need access to various statistics provided by
	  the ag71xx driver.

endif
```

## target/linux/bcm4908/image/bootfs-generic.its
```
// SPDX-License-Identifier: GPL-2.0-or-later OR MIT

/dts-v1/;

/ {
	description = "OpenWrt bootfs image";
	#address-cells = <1>;

	images {
		atf {
			description = "ATF";
			data = /incbin/("${images_dir}/bl31.bin");
			type = "firmware";
			arch = "arm64";
			os = "arm-trusted-firmware";
			compression = "none";
			load = <0x4000>;
			entry = <0x4000>;

			hash-1 {
				algo = "sha256";
			};
		};

		kernel {
			description = "Linux kernel";
			data = /incbin/("${kernel}");
			type = "kernel";
			os = "linux";
			arch = "arm64";
			compression = "lzma";
			load = <0x80000>;
			entry = <0x80000>;

			hash-1 {
				algo = "sha256";
			};
		};

		fdt_linux_RAX220 {
			description = "dtb";
			data = /incbin/("${dts_dir}/broadcom/bcm4908/bcm4908-netgear-raxe500.dtb");
			arch = "arm64";
			type = "flat_dt";
			compression = "none";

			hash-1 {
				algo = "sha256";
			};
		};
	};

	configurations {
		conf_lx_RAX220 {
			description = "BRCM 63xxx linux";
			kernel = "kernel";
			fdt = "fdt_linux_RAX220";
		};
	};
};
```

## target/linux/bcm4908/image/pkgtb-bcm4908.its
```
// SPDX-License-Identifier: GPL-2.0-or-later OR MIT

/dts-v1/;

/ {
	description = "Broadcom image upgrade package tree binary";
	#address-cells = <1>;

	images {
		bootfs_4908_a0+ {
			description = "bootfs";
			data = /incbin/("${bootfs}");
			type = "multi";
			compression = "none";

			hash-1 {
				algo = "sha256";
			};
		};

		nand_squashfs {
			description = "rootfs";
			data = /incbin/("${rootfs}");
			type = "filesystem";
			compression = "none";

			hash-1 {
				algo = "sha256";
			};
		};
	};

	configurations {
		default = "conf_4908_a0+_nand_squashfs";

		conf_4908_a0+_nand_squashfs {
			description = "Brcm Image Bundle";
			bootfs = "bootfs_4908_a0+";
			rootfs = "nand_squashfs";
			compatible = "flash=nand;chip=4908;rev=a0+;ip=ipv6,ipv4;ddr=ddr3;fstype=squashfs";
		};
	};
};
```

## target/linux/bcm4908/image/pkgtb-bcm4912.its
```
// SPDX-License-Identifier: GPL-2.0-or-later OR MIT

/dts-v1/;

/ {
	description = "Broadcom image upgrade package tree binary";
	#address-cells = <1>;

	images {
		bootfs_4912_a0+ {
			description = "bootfs";
			data = /incbin/("${bootfs}");
			type = "multi";
			compression = "none";

			hash-1 {
				algo = "sha256";
			};
		};

		nand_squashfs {
			description = "rootfs";
			data = /incbin/("${rootfs}");
			type = "filesystem";
			compression = "none";

			hash-1 {
				algo = "sha256";
			};
		};
	};

	configurations {
		default = "conf_4912_a0+_nand_squashfs";

		conf_4912_a0+_nand_squashfs {
			description = "Brcm Image Bundle";
			bootfs = "bootfs_4912_a0+";
			rootfs = "nand_squashfs";
			compatible = "flash=nand;chip=4912;rev=a0+;ip=ipv6,ipv4;ddr=ddr3,ddr4;fstype=squashfs";
		};
	};
};
```

## target/linux/brcm2708/image/Config.in
```kconfig
config BRCM2708_SD_BOOT_PARTSIZE
	int "Boot (SD Card) filesystem partition size (in MB)"
	depends on TARGET_brcm2708
	default 20
```

## target/linux/cns3xxx/files/drivers/net/ethernet/cavium/Kconfig
```kconfig
config NET_VENDOR_CAVIUM
	bool "Cavium devices"
	default y
	depends on ARCH_CNS3XXX
	---help---
	  If you have a network (Ethernet) chipset belonging to this class,
	  say Y.

	  Note that the answer to this question does not directly affect
	  the kernel: saying N will just case the configurator to skip all
	  the questions regarding AMD chipsets. If you say Y, you will be asked
	  for your specific chipset/driver in the following questions.

if NET_VENDOR_CAVIUM

config CNS3XXX_ETH
	tristate "Cavium CNS3xxx Ethernet support"
	depends on ARCH_CNS3XXX
	select PHYLIB
	help
	  Say Y here if you want to use built-in Ethernet ports
	  on CNS3XXX processor.

endif
```

## target/linux/d1/image/Config.in
```kconfig
config D1_SD_BOOT_PARTSIZE
	int "Boot (SD Card) filesystem partition size (in MB)"
	depends on TARGET_d1
	default 32
```

## target/linux/gemini/files/drivers/net/ethernet/gemini/Kconfig
```kconfig
#
# Gemini device configuration
#

config NET_VENDOR_GEMINI
	bool "Cortina Gemini devices"
	default y
	depends on ARCH_GEMINI
	---help---
	  If you have a network (Ethernet) card belonging to this class, say Y
	  and read the Ethernet-HOWTO, available from
	  <http://www.tldp.org/docs.html#howto>.

	  Note that the answer to this question doesn't directly affect the
	  kernel: saying N will just cause the configurator to skip all
	  the questions about D-Link devices. If you say Y, you will be asked for
	  your specific card in the following questions.

if NET_VENDOR_GEMINI

config GEMINI_SL351X
	tristate "StorLink SL351x Gigabit Ethernet support"
	depends on ARCH_GEMINI
	select PHYLIB
	select MDIO_BITBANG
	select MDIO_GPIO
	select CRC32
	---help---
	  This driver supports StorLink SL351x (Gemini) dual Gigabit Ethernet.

endif # NET_VENDOR_GEMINI
```
