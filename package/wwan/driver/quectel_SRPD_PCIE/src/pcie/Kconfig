## target/linux/generic/files-6.12/Documentation/devicetree/bindings/mtd/partitions/openwrt,uimage.yaml
```yaml
# SPDX-License-Identifier: GPL-2.0-only OR BSD-2-Clause
%YAML 1.2
---
$id: http://devicetree.org/schemas/mtd/partitions/openwrt,uimage.yaml#
$schema: http://devicetree.org/meta-schemas/core.yaml#

title: OpenWrt variations of U-Boot Image partitions

maintainers:
  - Bjørn Mork <bjorn@mork.no>

description: |
  The image format defined by the boot loader "Das U-Boot" is often
  modified or extended by device vendors. This defines a few optional
  properties which can be used to describe such modifications.

# partition.txt defines common properties, but has not yet been
# converted to YAML
#allOf:
#  - $ref: ../partition.yaml#

properties:
  compatible:
    items:
      - enum:
          - openwrt,uimage
      - const: denx,uimage

  openwrt,padding:
    description: Number of padding bytes between header and data
    $ref: /schemas/types.yaml#/definitions/uint32
    default: 0

  openwrt,ih-magic:
    description: U-Boot Image Header magic number.
    $ref: /schemas/types.yaml#/definitions/uint32
    default: 0x27051956 # IH_MAGIC

  openwrt,ih-type:
    description: U-Boot Image type
    $ref: /schemas/types.yaml#/definitions/uint32
    default: 2 # IH_TYPE_KERNEL

  openwrt,offset:
    description:
      Offset between partition start and U-Boot Image in bytes
    $ref: /schemas/types.yaml#/definitions/uint32
    default: 0

  openwrt,partition-magic:
    description:
      Magic number found at the start of the partition. Will only be
      validated if both this property and openwrt,offset is non-zero
    $ref: /schemas/types.yaml#/definitions/uint32
    default: 0

required:
  - compatible
  - reg

#unevaluatedProperties: false
additionalProperties: false

examples:
  - |
    // device with non-default magic
    partition@300000 {
          compatible = "openwrt,uimage", "denx,uimage";
          reg = <0x00300000 0xe80000>;
          label = "firmware";
          openwrt,ih-magic = <0x4e474520>;
    };
  - |
    // device with U-Boot Image at an offset, with a partition magic value
    partition@70000 {
          compatible = "openwrt,uimage", "denx,uimage";
          reg = <0x00070000 0x00790000>;
          label = "firmware";
          openwrt,offset = <20>;
          openwrt,partition-magic = <0x43535953>;
    };
  - |
    // device using a non-default image type
    #include "dt-bindings/mtd/partitions/uimage.h"
    partition@6c0000 {
          compatible = "openwrt,uimage", "denx,uimage";
          reg = <0x6c0000 0x1900000>;
          label = "firmware";
          openwrt,ih-magic = <0x33373033>;
          openwrt,ih-type = <IH_TYPE_FILESYSTEM>;
    };
```

## target/linux/generic/files-6.12/drivers/net/phy/b53/Kconfig
```kconfig
menuconfig SWCONFIG_B53
	tristate "Broadcom bcm53xx managed switch support"
	depends on SWCONFIG
	help
	  This driver adds support for Broadcom managed switch chips. It supports
	  BCM5325E, BCM5365, BCM539x, BCM53115 and BCM53125 as well as BCM63XX
	  integrated switches.

config SWCONFIG_B53_SPI_DRIVER
	tristate "B53 SPI connected switch driver"
	depends on SWCONFIG_B53 && SPI
	help
	  Select to enable support for registering switches configured through SPI.

config SWCONFIG_B53_PHY_DRIVER
	tristate "B53 MDIO connected switch driver"
	depends on SWCONFIG_B53
	select SWCONFIG_B53_PHY_FIXUP
	help
	  Select to enable support for registering switches configured through MDIO.

config SWCONFIG_B53_MMAP_DRIVER
	tristate "B53 MMAP connected switch driver"
	depends on SWCONFIG_B53
	help
	  Select to enable support for memory-mapped switches like the BCM63XX
	  integrated switches.

config SWCONFIG_B53_SRAB_DRIVER
	tristate "B53 SRAB connected switch driver"
	depends on SWCONFIG_B53
	help
	  Select to enable support for memory-mapped Switch Register Access
	  Bridge Registers (SRAB) like it is found on the BCM53010

config SWCONFIG_B53_PHY_FIXUP
	bool
```

## target/linux/generic/files-6.12/drivers/platform/mikrotik/Kconfig
```kconfig
menuconfig MIKROTIK
	bool "Platform support for MikroTik RouterBoard virtual devices"
	help
	  Say Y here to get to see options for the MikroTik RouterBoard platform.
	  This option alone does not add any kernel code.


if MIKROTIK

config MIKROTIK_RB_SYSFS
	tristate "RouterBoot sysfs support"
	depends on MTD
	select LZO_DECOMPRESS
	select CRC32
	help
	  This driver exposes RouterBoot configuration in sysfs.

config NVMEM_LAYOUT_MIKROTIK
	tristate "RouterBoot NVMEM layout support"
	depends on NVMEM_LAYOUTS
	help
	  This driver exposes MikroTik hard_config via NVMEM layout.

config MIKROTIK_WLAN_DECOMPRESS_LZ77
	tristate "Mikrotik factory Wi-Fi caldata LZ77 decompression support"
	depends on MIKROTIK_RB_SYSFS
	help
	  Allow Mikrotik LZ77 factory flashed Wi-Fi calibration data to be
	  decompressed

endif # MIKROTIK
```

## target/linux/generic/files/drivers/mtd/mtdsplit/Kconfig
```kconfig
config MTD_SPLIT
	def_bool n
	help
	  Generic MTD split support.

config MTD_SPLIT_SUPPORT
	def_bool MTD = y

comment "Rootfs partition parsers"

config MTD_SPLIT_SQUASHFS_ROOT
	bool "Squashfs based root partition parser"
	depends on MTD_SPLIT_SUPPORT
	select MTD_SPLIT
	help
	  This provides a parsing function which allows to detect the
	  offset and size of the unused portion of a rootfs partition
	  containing a squashfs.

comment "Firmware partition parsers"

config MTD_SPLIT_BCM63XX_FW
	bool "BCM63xx firmware parser"
	depends on MTD_SPLIT_SUPPORT
	select MTD_SPLIT

config MTD_SPLIT_BCM_WFI_FW
	bool "Broadcom Whole Flash Image parser"
	depends on MTD_SPLIT_SUPPORT
	select MTD_SPLIT

config MTD_SPLIT_CFE_BOOTFS
	bool "Parser finding rootfs appended to the CFE bootfs"
	depends on MTD_SPLIT_SUPPORT && (ARCH_BCM4908 || ARCH_BCMBCA)
	select MTD_SPLIT
	help
	  cferom on BCM4908 (and bcm63xx) uses JFFS2 bootfs partition
	  for storing kernel, cferam and some device specific files.
	  There isn't any straight way of storing rootfs so it gets
	  appended to the JFFS2 bootfs partition. Kernel needs to find
	  it and run init from it. This parser is responsible for
	  finding appended rootfs.

config MTD_SPLIT_SEAMA_FW
	bool "Seama firmware parser"
	depends on MTD_SPLIT_SUPPORT
	select MTD_SPLIT

config MTD_SPLIT_WRGG_FW
	bool "WRGG firmware parser"
	depends on MTD_SPLIT_SUPPORT
	select MTD_SPLIT

config MTD_SPLIT_UIMAGE_FW
	bool "uImage based firmware partition parser"
	depends on MTD_SPLIT_SUPPORT
	select MTD_SPLIT

config MTD_SPLIT_FIT_FW
	bool "FIT based firmware partition parser"
	depends on MTD_SPLIT_SUPPORT
	select MTD_SPLIT

config MTD_SPLIT_LZMA_FW
	bool "LZMA compressed kernel based firmware partition parser"
	depends on MTD_SPLIT_SUPPORT
	select MTD_SPLIT

config MTD_SPLIT_TPLINK_FW
	bool "TP-Link firmware parser"
	depends on MTD_SPLIT_SUPPORT
	select MTD_SPLIT

config MTD_SPLIT_TRX_FW
	bool "TRX image based firmware partition parser"
	depends on MTD_SPLIT_SUPPORT
	select MTD_SPLIT

config MTD_SPLIT_BRNIMAGE_FW
	bool "brnImage (brnboot image) firmware parser"
	depends on MTD_SPLIT_SUPPORT
	select MTD_SPLIT

config MTD_SPLIT_EVA_FW
	bool "EVA image based firmware partition parser"
	depends on MTD_SPLIT_SUPPORT
	select MTD_SPLIT

config MTD_SPLIT_MINOR_FW
	bool "Mikrotik NOR image based firmware partition parser"
	depends on MTD_SPLIT_SUPPORT
	select MTD_SPLIT

config MTD_SPLIT_JIMAGE_FW
	bool "JBOOT Image based firmware partition parser"
	depends on MTD_SPLIT_SUPPORT
	select MTD_SPLIT

config MTD_SPLIT_ELF_FW
	bool "ELF loader firmware partition parser"
	depends on MTD_SPLIT_SUPPORT
	select MTD_SPLIT

config MTD_SPLIT_H3C_VFS
	bool "Parser finding rootfs appended to H3C VFS"
	depends on MTD_SPLIT_SUPPORT
	select MTD_SPLIT

config MTD_SPLIT_SEIL_FW
	bool "IIJ SEIL firmware parser"
	depends on MTD_SPLIT_SUPPORT
	select MTD_SPLIT
```
