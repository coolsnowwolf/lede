## package/wwan/driver/quectel_MHI/src/controllers/Kconfig
```kconfig
menu "MHI controllers"

config MHI_QTI
       tristate "MHI QTI"
       depends on MHI_BUS
       help
	  If you say yes to this option, MHI bus support for QTI modem chipsets
	  will be enabled. QTI PCIe based modems uses MHI as the communication
	  protocol. MHI control driver is the bus master for such modems. As the
	  bus master driver, it oversees power management operations such as
	  suspend, resume, powering on and off the device.

endmenu
```

## package/wwan/driver/quectel_MHI/src/devices/Kconfig
```kconfig
menu "MHI device support"

config MHI_NETDEV
       tristate "MHI NETDEV"
       depends on MHI_BUS
       help
	  MHI based net device driver for transferring IP traffic
	  between host and modem. By enabling this driver, clients
	  can transfer data using standard network interface. Over
	  the air traffic goes thru mhi netdev interface.

config MHI_UCI
       tristate "MHI UCI"
       depends on MHI_BUS
       help
	  MHI based uci driver is for transferring data between host and
	  modem using standard file operations from user space. Open, read,
	  write, ioctl, and close operations are supported by this driver.
	  Please check mhi_uci_match_table for all supported channels that
	  are exposed to userspace.

config MHI_SATELLITE
       tristate "MHI SATELLITE"
       depends on MHI_BUS
       help
	  MHI proxy satellite device driver enables NON-HLOS MHI satellite
	  drivers to communicate with device over PCIe link without host
	  involvement. Host facilitates propagation of events from device
	  to NON-HLOS MHI satellite drivers, channel states, and power
	  management over IPC communication. It helps in HLOS power
	  savings.

endmenu
```

## package/wwan/driver/quectel_SRPD_PCIE/src/mcd/Kconfig
```kconfig
config SPRD_MCD
	tristate "SPRD modem power control module"
	default n
	help
	  mcd is a module for spreadtrum AP/CP communicaiton control driver,
	  it can control modem power on/off,triger modem event of assert,watchdog
	  reset,panic.
```
