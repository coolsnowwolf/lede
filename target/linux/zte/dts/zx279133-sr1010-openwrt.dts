// SPDX-License-Identifier: GPL-2.0-only
/*
 * OpenWrt view of the ZXSLC SR1010 flash.
 *
 * The vendor configuration partition stays read-only so that the vendor
 * firmware keeps its settings. OpenWrt keeps its overlay on the Plugin
 * partition, in the .lede directory next to the files the vendor firmware
 * wrote there. The partition keeps its name: fstools looks for it by the name
 * in /etc/fstools-shared-overlay.
 */

#include "zte/zx279133-sr1010.dts"

&spifc {
	flash@0 {
		partitions {
			partition@200000 {
				read-only;
			};
		};
	};
};
