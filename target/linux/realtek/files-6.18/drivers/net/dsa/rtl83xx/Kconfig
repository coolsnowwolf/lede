## target/linux/realtek/files-6.18/drivers/net/dsa/rtl83xx/Kconfig
```kconfig
# SPDX-License-Identifier: GPL-2.0-only
config NET_DSA_RTL83XX
	tristate "Realtek RTL838x/RTL839x switch support"
	depends on MACH_REALTEK_RTL
	select NET_DSA_TAG_RTL_OTTO
	help
	  This driver adds support for Realtek RTL83xx series switching.

config NET_DSA_RTL83XX_RTL930X_L3_OFFLOAD
	bool "Realtek RTL930x layer 3 offload (experimental)"
	depends on NET_DSA_RTL83XX
```

## target/linux/realtek/files-6.6/Documentation/devicetree/bindings/realtek,otto-timer.yaml
```yaml
# SPDX-License-Identifier: GPL-2.0
%YAML 1.2
---
$id: http://devicetree.org/schemas/timer/realtek,rtl8300-timer.yaml#
$schema: http://devicetree.org/meta-schemas/core.yaml#

title: Realtek Timer Device Tree Bindings

maintainers:
  - Markus Stockhausen <markus.stockhausen@gmx.de>

description: |
  The Realtek SOCs of the RTL83XX and RTL93XX series have at least 5 known
  timers with corresponding interrupt lines . Their speed is derived from the
  Lexra Bus (LXB) by dividers. Each timer has a block of 4 control registers in
  the address range 0xb800xxxx with following start offsets.

  RTL83XX: 0x3100, 0x3110, 0x3120, 0x3130, 0x3140
  RTL93XX: 0x3200, 0x3210, 0x3220, 0x3230, 0x3240

properties:
  compatible:
    items:
      - enum:
        - realtek,rtl8380-timer
        - realtek,rtl8390-timer
        - realtek,rtl9300-timer
      - const: realtek,otto-timer

  reg:
    minItems: 5
    maxItems: 5
    description:
      List of timer register addresses.

  interrupts:
    minItems: 5
    maxItems: 5
    description:
      List of timer interrupts.

  clocks:
    maxItems: 1

required:
  - compatible
  - reg
  - interrupts
  - clocks

additionalProperties: false

examples:
  - |
    timer0: timer@3100 {
      compatible = "realtek,rtl8380-timer", "realtek,otto-timer";
      reg = <0x3100 0x10>, <0x3110 0x10>, <0x3120 0x10>,
            <0x3130 0x10>, <0x3140 0x10>;

      interrupt-parent = <&intc>;
      interrupts = <29 4>, <28 4>, <17 4>, <16 4>, <15 4>;
      clocks = <&ccu CLK_LXB>;
    };
  - |
    timer0: timer@3100 {
      compatible = "realtek,rtl8390-timer", "realtek,otto-timer";
      reg = <0x3100 0x10>, <0x3110 0x10>, <0x3120 0x10>,
            <0x3130 0x10>, <0x3140 0x10>;

      interrupt-parent = <&intc>;
      interrupts = <29 4>, <28 4>, <17 4>, <16 4>, <15 4>;
      clocks = <&ccu CLK_LXB>;
    };
  - |
    timer0: timer@3200 {
      compatible = "realtek,rtl9300-timer", "realtek,otto-timer";
      reg = <0x3200 0x10>, <0x3210 0x10>, <0x3220 0x10>,
            <0x3230 0x10>, <0x3240 0x10>;

      interrupt-parent = <&intc>;
      interrupts = <7 4>, <8 4>, <9 4>, <10 4>, <11 4>;
      clocks = <&ccu CLK_LXB>;
    };

...
```

## target/linux/realtek/files-6.6/drivers/clk/realtek/Kconfig
```kconfig
# SPDX-License-Identifier: GPL-2.0-only

menuconfig COMMON_CLK_REALTEK
	bool "Support for Realtek's clock controllers"
	depends on MACH_REALTEK_RTL

if COMMON_CLK_REALTEK

config COMMON_CLK_RTL83XX
	bool "Clock driver for Realtek RTL83XX"
	depends on MACH_REALTEK_RTL
	select SRAM
	help
	  This driver adds support for the Realtek RTL83xx series basic clocks.
	  This includes chips in the RTL838x series, such as RTL8380, RTL8381,
	  RTL832, as well as chips from the RTL839x series, such as RTL8390,
	  RT8391, RTL8392, RTL8393 and RTL8396.

endif
```

## target/linux/realtek/files-6.6/drivers/net/dsa/rtl83xx/Kconfig
```kconfig
# SPDX-License-Identifier: GPL-2.0-only
config NET_DSA_RTL83XX
	tristate "Realtek RTL838x/RTL839x switch support"
	depends on MACH_REALTEK_RTL
	select NET_DSA_TAG_TRAILER
	help
	  This driver adds support for Realtek RTL83xx series switching.
```

## target/linux/rockchip/files-5.10/drivers/video/rockchip/rga/Kconfig
```kconfig
# SPDX-License-Identifier: GPL-2.0
menu "RGA"
	depends on ARCH_ROCKCHIP

config ROCKCHIP_RGA
	tristate "ROCKCHIP_RGA"
	depends on ARCH_ROCKCHIP && !ROCKCHIP_MULTI_RGA
	help
	  rk30 rga module.

endmenu
```

## target/linux/rockchip/files/Documentation/devicetree/bindings/phy/phy-rockchip-inno-usb3.yaml
```yaml
# SPDX-License-Identifier: (GPL-2.0 OR BSD-2-Clause)
%YAML 1.2
---
$id: "http://devicetree.org/schemas/phy/phy-rockchip-inno-usb3.yaml#"
$schema: "http://devicetree.org/meta-schemas/core.yaml#"

title: ROCKCHIP USB 3.0 PHY WITH INNO IP BLOCK

maintainers:

properties:
  compatible:
    enum:
      - rockchip,rk3328-u3phy

  reg:
    - description: the base address of the USB 3.0 PHY

  interrupts:
    maxItems: 1

  interrupt-names:
    items:
      - const: linestate
        description: host/otg linestate interrupt

  clocks:
    maxItems: 2

  clock-names:
    items:
      - const: u3phy-otg
        description: USB 3.0 PHY UTMI
      - const: u3phy-pipe
        description: USB 3.0 PHY Pipe

  resets:
    maxItems: 6

  reset-names:
    items:
      - const: u3phy-u2-por
      description: USB 2.0 logic of USB 3.0 PHY
      - const: u3phy-u3-por
      description: USB 3.0 logic of USB 3.0 PHY
      - const: u3phy-pipe-mac
      description: USB 3.0 PHY pipe MAC
      - const: u3phy-utmi-mac
      description: USB 3.0 PHY utmi MAC
      - const: u3phy-utmi-apb
      description: USB 3.0 PHY utmi apb
      - const: u3phy-pipe-apb
      description: USB 3.0 PHY pipe apb

  "#phy-cells":
    const: 1

  rockchip,u3phygrf:
    $ref: /schemas/types.yaml#/definitions/phandle-array
    type: array
    - description: phandle to the syscon managing the
                   "USB 3.0 PHY general register files".

  vbus-drv-gpios:
    $ref: /schemas/types.yaml#/definitions/phandle-array
    type: array
    - description: phandle for gpio vbus supply

required:
  - compatible
  - reg
  - interrupts
  - interrupt-names
  - clocks
  - clock-names
  - resets
  - reset-names
  - "#phy-cells"
  - rockchip,u3phygrf

patternProperties:
  "^u3phy_utmi@[0-9a-f]+$":
    type: object

    properties:
      - description: USB 2.0 utmi phy.

      rockchip,odt-val-tuning:
        type: boolean
        - description: specify 45ohm ODT tuning value.

      "phy-cells":
        const: 0

    required:
      - reg
      - "#phy-cells"

patternProperties:
  "^u3phy_pipe@[0-9a-f]+$":
    type: object

    properties:
      - description: USB 3.0 pipe phy.

      rockchip,refclk-25m-quirk :

        - description: phy reference clock changed to 25m quirk.

      "phy-cells":
        const: 0

    required:
      - reg
      - "#phy-cells"

examples:

usb3phy_grf: syscon@ff460000 {
	compatible = "rockchip,usb3phy-grf", "syscon";
	reg = <0x0 0xff460000 0x0 0x1000>;
};

...

u3phy: usb3-phy@ff470000 {
	compatible = "rockchip,rk3328-u3phy";
	reg = <0x0 0xff470000 0x0 0x0>;
	rockchip,u3phygrf = <&usb3phy_grf>;
	interrupts = <GIC_SPI 77 IRQ_TYPE_LEVEL_HIGH>;
	interrupt-names = "linestate";
	clocks = <&cru PCLK_USB3PHY_OTG>, <&cru PCLK_USB3PHY_PIPE>;
	clock-names = "u3phy-otg", "u3phy-pipe";
	resets = <&cru SRST_USB3PHY_U2>,
		 <&cru SRST_USB3PHY_U3>,
		 <&cru SRST_USB3PHY_PIPE>,
		 <&cru SRST_USB3OTG_UTMI>,
		 <&cru SRST_USB3PHY_OTG_P>,
		 <&cru SRST_USB3PHY_PIPE_P>;
	reset-names = "u3phy-u2-por", "u3phy-u3-por",
		      "u3phy-pipe-mac", "u3phy-utmi-mac",
		      "u3phy-utmi-apb", "u3phy-pipe-apb";
	vbus-drv-gpios = <&gpio0 0 GPIO_ACTIVE_HIGH>;
	#address-cells = <2>;
	#size-cells = <2>;
	ranges;

	u3phy_utmi: utmi@ff470000 {
		reg = <0x0 0xff470000 0x0 0x8000>;
		#phy-cells = <0>;
	};

	u3phy_pipe: pipe@ff478000 {
		reg = <0x0 0xff478000 0x0 0x8000>;
		#phy-cells = <0>;
	};
};
```

## target/linux/sifiveu/image/Config.in
```kconfig
config SIFIVEU_SD_BOOT_PARTSIZE
	int "Boot (SD Card) filesystem partition size (in MB)"
	depends on TARGET_sifiveu
	default 32
```

## target/linux/siflower/files-6.12/drivers/clk/siflower/Kconfig
```kconfig
# SPDX-License-Identifier: GPL-2.0

menuconfig CLK_SIFLOWER
	bool "Siflower SoC driver support"
	depends on MIPS || RISCV || COMPILE_TEST
	help
	  SoC drivers for Siflower Linux-capable SoCs.

if CLK_SIFLOWER

config CLK_SF19A2890
	bool "Clock driver for Siflower CLK_SF19A2890"
	depends on MIPS || COMPILE_TEST
	help
	  Supports the Top Clock Module found in SF19A2890. If this
	  kernel is meant to run on a Siflower SF19A2890 SoC,
	  enable this driver.

config CLK_SF19A2890_PERIPH
	bool "Clock driver for Siflower SF19A2890 peripheral clock gates"
	depends on MIPS || RISCV || COMPILE_TEST
	help
	  Supports the clock gates for various peripherals in SF19A2890.
	  If this kernel is meant to run on a Siflower SF19A2890 SoC,
	  enable this driver.

config CLK_SF21_TOPCRM
	bool "Clock driver for Siflower SF21A6826/SF21H8898 Top Clock & Reset Module"
	depends on RISCV || COMPILE_TEST
	help
	  Supports the Top Clock & Reset Module IP block found in SF21A6826.
	  If this kernel is meant to run on a Siflower SF21A6826 SoC,
	  enable this driver.

endif
```

## target/linux/siflower/files-6.12/drivers/net/ethernet/siflower/Kconfig
```kconfig
# SPDX-License-Identifier: GPL-2.0
#
# Siflower network device configuration
#

config NET_VENDOR_SIFLOWER
	bool "Siflower Ethernet"
	default y
	depends on ARCH_SIFLOWER

if NET_VENDOR_SIFLOWER

config NET_SIFLOWER_ETH_DPNS
	tristate "Siflower DPNS driver"
	help
	  Support the Dataplane network subsystem of SiFlower SF21A6826/SF21H8898 SoC.

config NET_SIFLOWER_ETH_XGMAC
	tristate "Siflower Ethernet MAC driver"
	depends on NET_SIFLOWER_ETH_DPNS
	select MII
	select PAGE_POOL
	select PHYLINK
	select NET_SIFLOWER_ETH_DMA
        select NET_SIFLOWER_ETH_XPCS
	help
	  Support the Ethernet controller of SiFlower SF21A6826/SF21H8898 SoC.

config NET_SIFLOWER_ETH_DMA
	tristate "Siflower Ethernet DMA driver"
	depends on NET_SIFLOWER_ETH_DPNS
	select PAGE_POOL
	help
	  Support the Ethernet controller of SiFlower SF21A6826/SF21H8898 SoC.

config NET_SIFLOWER_ETH_XPCS
	tristate "Siflower Ethernet XPCS driver"
	depends on NET_SIFLOWER_ETH_DPNS
	select PAGE_POOL
	help
	  Support the PCS block of SiFlower SF21A6826/SF21H8898 SoC.

if NET_SIFLOWER_ETH_DMA

config NET_SIFLOWER_ETH_USE_INTERNAL_SRAM
	bool "Use internal SRAM for DMA descriptors"
	select SRAM
	help
	  Use internal SRAM instead of system memory for DMA descriptors.

endif # NET_SIFLOWER_ETH_DMA

endif # NET_VENDOR_SIFLOWER
```

## target/linux/siflower/files-6.12/drivers/phy/siflower/Kconfig
```kconfig
config PHY_SF19A2890_USB
	tristate "SIFLOWER sf19a2890 USB2.0 PHY driver"
	default n
	select GENERIC_PHY
	help
	  Enable this to support the USB2.0 PHY on the SIFLOWER SF19A2890.

config PHY_SF21_PCIE
	tristate "Siflower SF21A6826/SF21H8898 PCIE PHY driver"
	default n
	depends on HAS_IOMEM
	select GENERIC_PHY
	help
	  Enable this to support the PCIE PHY on the Siflower SF21A6826 SoC.

config PHY_SF21_USB
	tristate "Siflower SF21A6826/SF21H8898 USB2.0 PHY driver"
	default n
	depends on HAS_IOMEM
	select GENERIC_PHY
	help
	  Enable this to support the USB2.0 PHY on the Siflower SF21A6826/SF21H8898 SoC.
```

## target/linux/siflower/files-6.6/drivers/clk/siflower/Kconfig
```kconfig
# SPDX-License-Identifier: GPL-2.0

menuconfig CLK_SIFLOWER
	bool "Siflower SoC driver support"
	depends on MIPS || COMPILE_TEST
	help
	  SoC drivers for Siflower Linux-capable SoCs.

if CLK_SIFLOWER

config CLK_SF19A2890
	bool "Clock driver for Siflower CLK_SF19A2890"
	depends on MIPS || COMPILE_TEST
	help
	  Supports the Top Clock Module found in SF19A2890. If this
	  kernel is meant to run on a Siflower SF19A2890 SoC,
	  enable this driver.

config CLK_SF19A2890_PERIPH
	bool "Clock driver for Siflower SF19A2890 peripheral clock gates"
	depends on MIPS || COMPILE_TEST
	help
	  Supports the clock gates for various peripherals in SF19A2890.
	  If this kernel is meant to run on a Siflower SF19A2890 SoC,
	  enable this driver.

endif
```

## target/linux/siflower/files-6.6/drivers/phy/siflower/Kconfig
```kconfig
config PHY_SF19A2890_USB
	tristate "SIFLOWER sf19a2890 USB2.0 PHY driver"
	default n
	select GENERIC_PHY
	help
	  Enable this to support the USB2.0 PHY on the SIFLOWER SF19A2890.
```

## target/linux/sunxi/image/Config.in
```kconfig
config SUNXI_SD_BOOT_PARTSIZE
	int "Boot (SD Card) filesystem partition size (in MB)"
	depends on TARGET_sunxi
	default 20
```

## target/sdk/Config.in
```kconfig
config SDK
	bool "Build the OpenWrt SDK"
	depends on !EXTERNAL_TOOLCHAIN
	default BUILDBOT
	help
	  This is essentially a stripped-down version of the buildroot
	  with a precompiled toolchain. It can be used to develop and
	  test packages for OpenWrt before including them in the buildroot

config SDK_LLVM_BPF
	bool "Build the LLVM-BPF toolchain tarball"
	depends on BPF_TOOLCHAIN_BUILD_LLVM
	default BUILDBOT
	help
	  This is a tarball of the precompiled LLVM toolchain suitable
	  for unpacking into the buildroot/SDK. It is used to build packages
	  that ship with eBPF kernel modules
```

## target/sdk/files/Config.in
```kconfig
mainmenu "OpenWrt Configuration"

menu "Global build settings"

	config ALL_NONSHARED
		bool "Select all target specific packages by default"
		default ALL

	config ALL_KMODS
		bool "Select all kernel module packages by default"
		default ALL

	config ALL
		bool "Select all userspace packages by default"
		default y

	config SIGNED_PACKAGES
		bool "Cryptographically sign package lists"
		default y

	comment "Package build options"

	config DEBUG
		bool
		prompt "Compile packages with debugging info"
		default n
		help
		  Adds -g3 to the CFLAGS.

	comment "Stripping options"

	choice
		prompt "Binary stripping method"
		default USE_STRIP   if USE_GLIBC
		default USE_SSTRIP
		help
		  Select the binary stripping method you wish to use.

		config NO_STRIP
			bool "none"
			help
			  This will install unstripped binaries (useful for native
			  compiling/debugging).

		config USE_STRIP
			bool "strip"
			help
			  This will install binaries stripped using strip from binutils.

		config USE_SSTRIP
			bool "sstrip"
			depends on !USE_GLIBC
			help
			  This will install binaries stripped using sstrip.
	endchoice

	config STRIP_ARGS
		string
		prompt "Strip arguments"
		depends on USE_STRIP
		default "--strip-unneeded --remove-section=.comment --remove-section=.note" if DEBUG
		default "--strip-all"
		help
		  Specifies arguments passed to the strip command when stripping binaries.

endmenu

menu "Advanced configuration options (for developers)"

	config BROKEN
		bool "Show broken packages"
		default n

	config DOWNLOAD_FOLDER
		string "Download folder"
		default ""
		help
		  Store downloaded source bundles in this directory.
		  If not set then defaults to './dl', which is removed by operations such as
		  'git clean -xdf' or 'make distclean'.
		  This option is useful if you have a low bandwidth Internet connection, and by
		  setting a path outside the OpenWrt tree downloads will be saved.

	config LOCALMIRROR
		string "Local mirror for source packages"
		default ""

	config AUTOREBUILD
		bool "Automatic rebuild of packages"
		default y
		help
		  Automatically rebuild packages when their files change.

	config AUTOREMOVE
		bool "Automatic removal of build directories"
		default y
		help
		  Automatically delete build directories after make target completed.
		  This allows you to symlink build_dir into a scratch location, e.g. a ramdisk,
		  which does not have enough space to keep a complete build_dir.

	config CCACHE
		bool "Use ccache"
		default n
		help
		  Compiler cache; see https://ccache.samba.org/

	config BUILD_LOG
		bool "Enable log files during build process"
		default n
		help
		  If enabled, log files will be written to the ./log directory.

	config SRC_TREE_OVERRIDE
		bool "Enable package source tree override"
		default n
		help
		  If enabled, you can force a package to use a git tree as source
		  code instead of the normal tarball. Create a symlink 'git-src'
		  in the package directory, pointing to the .git tree that you want
		  to pull the source code from.

endmenu

config IN_SDK
	default y
	bool

config MODULES
	bool
	default y
	modules

source "Config-build.in"
source "tmp/.config-package.in"
```
