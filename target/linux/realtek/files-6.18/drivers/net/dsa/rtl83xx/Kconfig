## target/toolchain/Config.in
```kconfig
config MAKE_TOOLCHAIN
	bool "Package the LEDE-based Toolchain"
	depends on !EXTERNAL_TOOLCHAIN
	default BUILDBOT
	help
	  Package the created toolchain as a tarball under the bin/ directory as
	  OpenWrt-Toolchain-$(BOARD)-for-$(ARCH)$(ARCH_SUFFIX)-gcc-$(GCCV)$(DIR_SUFFIX).
	  For example, a toolchain for the MIPS architecture might be named
	  OpenWrt-Toolchain-malta-for-mipsel_mips32-gcc-4.8-linaro_uClibc-0.9.33.2.tar.bz2.
```

## toolchain/Config.in
```kconfig
# Copyright (C) 2006-2013 OpenWrt.org
#
# This is free software, licensed under the GNU General Public License v2.
# See /LICENSE for more information.
#

menuconfig TARGET_OPTIONS
	bool "Target Options"  if DEVEL

	config TARGET_OPTIMIZATION
		string "Target Optimizations" if TARGET_OPTIONS
		default DEFAULT_TARGET_OPTIMIZATION
		help
		  Optimizations to use when building for the target host.

	config SOFT_FLOAT
		bool "Use software floating point by default" if TARGET_OPTIONS
		default y if !HAS_FPU
		depends on arm || armeb || powerpc || mipsel || mips || mips64el || mips64
		help
		  If your target CPU does not have a Floating Point Unit (FPU) or a
		  kernel FPU emulator, but you still wish to support floating point
		  functions, then everything will need to be compiled with soft floating
		  point support (-msoft-float).

		  Most people will answer N.

	config USE_MIPS16
		bool "Build packages with MIPS16 instructions" if TARGET_OPTIONS
		depends on HAS_MIPS16
		default y
		help
		  If your target CPU does support the MIPS16 instruction set
		  and you want to use it for packages, enable this option.
		  MIPS16 produces smaller binaries thus reducing pressure on
		  caches and TLB.

		  Most people will answer N.

	choice BPF_TOOLCHAIN
		prompt "BPF toolchain" if DEVEL
		default BPF_TOOLCHAIN_BUILD_LLVM if BUILDBOT
		default BPF_TOOLCHAIN_PREBUILT if HAS_PREBUILT_LLVM_TOOLCHAIN
		default BPF_TOOLCHAIN_NONE

		config BPF_TOOLCHAIN_NONE
			bool "None"

		config BPF_TOOLCHAIN_PREBUILT
			bool "Use prebuilt LLVM toolchain"
			depends on HAS_PREBUILT_LLVM_TOOLCHAIN
			select USE_LLVM_PREBUILT

		config BPF_TOOLCHAIN_HOST
			select USE_LLVM_HOST
			bool "Use host LLVM toolchain"

		config BPF_TOOLCHAIN_BUILD_LLVM
			select USE_LLVM_BUILD
			bool "Build LLVM toolchain for eBPF"
			help
			  If enabled, a LLVM toolchain for building eBPF binaries will be built.
			  If this is not enabled, eBPF packages can only be built if the host
			  has a suitable toolchain
	endchoice

	config BPF_TOOLCHAIN_HOST_PATH
		string
		depends on BPF_TOOLCHAIN_HOST
		prompt "Host LLVM toolchain path (prefix)" if DEVEL
		default "/usr/local/opt/llvm" if HOST_OS_MACOS
		default ""

menuconfig EXTERNAL_TOOLCHAIN
	bool
	prompt "Use external toolchain"  if DEVEL
	help
	  If enabled, the buildroot will compile using an existing toolchain instead of
	  compiling one.

	config NATIVE_TOOLCHAIN
		bool
		prompt "Use host's toolchain"  if DEVEL
		depends on EXTERNAL_TOOLCHAIN
		select NO_STRIP
		help
		  If enabled, the buildroot will compile using the native toolchain for your
		  host instead of compiling one.

	config TARGET_NAME
		string
		prompt "Target name"  if DEVEL
		depends on EXTERNAL_TOOLCHAIN && !NATIVE_TOOLCHAIN
		default "aarch64-unknown-linux-gnu"  if aarch64
		default "aarch64_be-unknown-linux-gnu"  if aarch64_be
		default "arm-unknown-linux-gnu"      if arm
		default "armeb-unknown-linux-gnu"    if armeb
		default "i486-unknown-linux-gnu"     if i386
		default "mips-unknown-linux-gnu"     if mips
		default "mipsel-unknown-linux-gnu"   if mipsel
		default "powerpc-unknown-linux-gnu"  if powerpc
		default "x86_64-unknown-linux-gnu"   if x86_64

	config TOOLCHAIN_PREFIX
		string
		prompt "Toolchain prefix"  if DEVEL
		depends on EXTERNAL_TOOLCHAIN && !NATIVE_TOOLCHAIN
		default "aarch64-unknown-linux-gnu"  if aarch64
		default "aarch64_be-unknown-linux-gnu"  if aarch64_be
		default "arm-unknown-linux-gnu-"      if arm
		default "armeb-unknown-linux-gnu-"    if armeb
		default "i486-unknown-linux-gnu-"     if i386
		default "mips-unknown-linux-gnu-"     if mips
		default "mipsel-unknown-linux-gnu-"   if mipsel
		default "powerpc-unknown-linux-gnu-"  if powerpc
		default "x86_64-unknown-linux-gnu-"   if x86_64

	config TOOLCHAIN_ROOT
		string
		prompt "Toolchain root"  if DEVEL
		depends on EXTERNAL_TOOLCHAIN && !NATIVE_TOOLCHAIN
		default "/opt/cross/aarch64-unknown-linux-gnu"  if aarch64
		default "/opt/cross/aarch64_be-unknown-linux-gnu"  if aarch64_be
		default "/opt/cross/arm-unknown-linux-gnu"      if arm
		default "/opt/cross/armeb-unknown-linux-gnu"    if armeb
		default "/opt/cross/i486-unknown-linux-gnu"     if i386
		default "/opt/cross/mips-unknown-linux-gnu"     if mips
		default "/opt/cross/mipsel-unknown-linux-gnu"   if mipsel
		default "/opt/cross/powerpc-unknown-linux-gnu"  if powerpc
		default "/opt/cross/x86_64-unknown-linux-gnu"   if x86_64

	choice TOOLCHAIN_LIBC_TYPE
		prompt "Toolchain libc"  if DEVEL
		depends on EXTERNAL_TOOLCHAIN && !NATIVE_TOOLCHAIN
		default EXTERNAL_TOOLCHAIN_LIBC_USE_MUSL
		help
		  Specify the libc type used by the external toolchain. The given value
		  is passed as -m flag to all gcc and g++ invocations. This is mainly
		  intended for multilib toolchains which support glibc and uclibc at
		  the same time. If no value is specified, no -m flag is passed.

		config EXTERNAL_TOOLCHAIN_LIBC_USE_GLIBC
			bool "glibc"
			select USE_GLIBC

		config EXTERNAL_TOOLCHAIN_LIBC_USE_MUSL
			bool "musl"
			select USE_MUSL

	endchoice

	config TOOLCHAIN_LIBC
		string
		depends on EXTERNAL_TOOLCHAIN && !NATIVE_TOOLCHAIN
		default "glibc" if EXTERNAL_TOOLCHAIN_LIBC_USE_GLIBC
		default "musl" if EXTERNAL_TOOLCHAIN_LIBC_USE_MUSL

	config TOOLCHAIN_BIN_PATH
		string
		prompt "Toolchain program path"  if DEVEL
		depends on EXTERNAL_TOOLCHAIN && !NATIVE_TOOLCHAIN
		default "./usr/bin ./bin"
		help
		  Specify additional directories searched for toolchain binaries
		  (override PATH). Use ./DIR for directories relative to the root above.

	config TOOLCHAIN_INC_PATH
		string
		prompt "Toolchain include path"  if DEVEL
		depends on EXTERNAL_TOOLCHAIN && !NATIVE_TOOLCHAIN
		default "./usr/include ./include"
		help
		  Specify additional directories searched for header files (override
		  CPPFLAGS). Use ./DIR for directories relative to the root above.

	config TOOLCHAIN_LIB_PATH
		string
		prompt "Toolchain library path"  if DEVEL
		depends on EXTERNAL_TOOLCHAIN && !NATIVE_TOOLCHAIN
		default "./usr/lib ./lib"
		help
		  Specify additional directories searched for libraries (override LDFLAGS).
		  Use ./DIR for directories relative to the root above.

config NEED_TOOLCHAIN
	bool
	depends on DEVEL
	default y if !EXTERNAL_TOOLCHAIN

menuconfig TOOLCHAINOPTS
	bool "Toolchain Options"  if DEVEL
	depends on NEED_TOOLCHAIN

menuconfig EXTRA_TARGET_ARCH
	bool
	prompt "Enable an extra toolchain target architecture" if TOOLCHAINOPTS
	depends on !sparc
	default n
	help
	  Some builds may require a 'biarch' toolchain. This option
	  allows you to specify an additional target arch.

	  Most people will answer N here.

	config EXTRA_TARGET_ARCH_NAME
		string
		prompt "Extra architecture name" if EXTRA_TARGET_ARCH
		help
		  Specify the cpu name (eg powerpc64 or x86_64) of the
		  additional target architecture.

	config EXTRA_TARGET_ARCH_OPTS
		string
		prompt "Extra architecture compiler options" if EXTRA_TARGET_ARCH
		help
		  If you're specifying an addition target architecture,
		  you'll probably need to also provide options to make
		  the compiler use this alternate arch.

		  For example, if you're building a compiler that can build
		  both powerpc and powerpc64 binaries, you'll need to
		  specify -m64 here.


	choice
		prompt "MIPS64 user-land ABI" if TOOLCHAINOPTS && (mips64 || mips64el)
		default MIPS64_ABI_N64
		help
		   MIPS64 supports 3 different user-land ABIs: o32 (legacy),
		   n32 and n64.

		config MIPS64_ABI_N64
			bool "n64"

		config MIPS64_ABI_N32
			depends on !LIBC_USE_MUSL
			bool "n32"

		config MIPS64_ABI_O32
			bool "o32"

	endchoice

comment "Binary tools"
	depends on TOOLCHAINOPTS

source "toolchain/binutils/Config.in"

config DWARVES
	bool
	prompt "Build pahole" if TOOLCHAINOPTS
	depends on !HOST_OS_MACOS
	default n
	help
	  Enable if you want to build pahole and the dwarves tools.

comment "Compiler"
	depends on TOOLCHAINOPTS

source "toolchain/gcc/Config.in"

config NASM
	bool
	depends on ( i386 || x86_64 )
	prompt "Build nasm" if TOOLCHAINOPTS
	default y
	help
	  Enable if you want to build nasm

comment "C Library"
	depends on TOOLCHAINOPTS

choice
	prompt "C Library implementation" if TOOLCHAINOPTS
	default LIBC_USE_GLIBC if arc
	default LIBC_USE_MUSL
	help
	  Select the C library implementation.

	config LIBC_USE_GLIBC
		bool "Use glibc"
		select USE_GLIBC

	config LIBC_USE_MUSL
		select USE_MUSL
		bool "Use musl"
		depends on !arc

endchoice

source "toolchain/musl/Config.in"

comment "Debuggers"
	depends on TOOLCHAINOPTS

config GDB
	bool
	prompt "Build gdb" if TOOLCHAINOPTS
	default y if !EXTERNAL_TOOLCHAIN
	help
	  Enable if you want to build the gdb.

config GDB_PYTHON
	bool
	depends on GDB
	prompt "Build gdb with python binding"
	
	help
	  Enable the python bindings for GDB to allow using python in the gdb shell.
	  
config HAS_BPF_TOOLCHAIN
	bool

config HAS_PREBUILT_LLVM_TOOLCHAIN
	def_bool $(shell, [ -f llvm-bpf/.llvm-version ] && echo y || echo n)

config USE_LLVM_HOST
	select HAS_BPF_TOOLCHAIN
	bool

config USE_LLVM_PREBUILT
	select HAS_BPF_TOOLCHAIN
	default y if !DEVEL && !BUILDBOT && HAS_PREBUILT_LLVM_TOOLCHAIN
	bool

config USE_LLVM_BUILD
	default y if !DEVEL && BUILDBOT
	select HAS_BPF_TOOLCHAIN
	bool	  

config USE_GLIBC
	default y if !TOOLCHAINOPTS && !EXTERNAL_TOOLCHAIN && !NATIVE_TOOLCHAIN && (arc)
	bool

config USE_MUSL
	default y if !TOOLCHAINOPTS && !EXTERNAL_TOOLCHAIN && !NATIVE_TOOLCHAIN && !(arc)
	bool

config SSP_SUPPORT
	default y if !PKG_CC_STACKPROTECTOR_NONE
	bool

config USE_EXTERNAL_LIBC
	bool
	default y if EXTERNAL_TOOLCHAIN || NATIVE_TOOLCHAIN

source "toolchain/binutils/Config.version"
source "toolchain/gcc/Config.version"

config LIBC
	string
	default "glibc"   if USE_GLIBC
	default "musl"	  if USE_MUSL

config TARGET_SUFFIX
	string
	default "gnueabi"         if USE_GLIBC && (arm || armeb)
	default "gnu"             if USE_GLIBC && !(arm || armeb)
	default "muslgnueabi"     if USE_MUSL && (arm || armeb)
	default "musl"            if USE_MUSL && !(arm || armeb)

config MIPS64_ABI
	depends on mips64 || mips64el
	string
	default "64" if MIPS64_ABI_N64
	default "n32" if MIPS64_ABI_N32
	default "32" if MIPS64_ABI_O32
	default "64"
```

## toolchain/binutils/Config.in
```kconfig
# Choose binutils version.

choice
	prompt "Binutils Version" if TOOLCHAINOPTS
	default BINUTILS_USE_VERSION_2_42
	help
	  Select the version of binutils you wish to use.

	config BINUTILS_USE_VERSION_2_40
		bool "Binutils 2.40"
		select BINUTILS_VERSION_2_40

	config BINUTILS_USE_VERSION_2_42
		bool "Binutils 2.42"
		select BINUTILS_VERSION_2_42

	config BINUTILS_USE_VERSION_2_43
		bool "Binutils 2.43.1"
		select BINUTILS_VERSION_2_43
endchoice

config EXTRA_BINUTILS_CONFIG_OPTIONS
	string
	prompt "Additional binutils configure options" if TOOLCHAINOPTS
	default ""
	help
	    Any additional binutils options you may want to include....
```

## toolchain/gcc/Config.in
```kconfig
# Choose gcc version.

choice
	prompt "GCC compiler Version" if TOOLCHAINOPTS
	default GCC_USE_VERSION_8 if mips || mipsel || mips64 || mips64el
	default GCC_USE_VERSION_13
	help
	  Select the version of gcc you wish to use.

	config GCC_USE_VERSION_8
		bool "gcc 8.x"

	config GCC_USE_VERSION_11
		bool "gcc 11.x"

	config GCC_USE_VERSION_12
		bool "gcc 12.x"
		
	config GCC_USE_VERSION_13
		bool "gcc 13.x"	
endchoice

config GCC_USE_GRAPHITE
	bool
	prompt "Compile in support for the new Graphite framework in GCC 4.4+" if TOOLCHAINOPTS

config EXTRA_GCC_CONFIG_OPTIONS
	string
	prompt "Additional gcc configure options" if TOOLCHAINOPTS
	default ""
	help
	    Any additional gcc options you may want to include....

config GCC_DEFAULT_PIE
	bool
	prompt "Build executable with PIE enabled by default" if TOOLCHAINOPTS
	default n
	help
	    Use gcc configure option --enable-default-pie to turn on -fPIE and -pie by default.

config GCC_DEFAULT_SSP
	bool
	prompt "Build executable with Stack-Smashing Protection enabled by default" if TOOLCHAINOPTS
	default n
	help
	    Use gcc configure option --enable-default-ssp to turn on -fstack-protector-strong by default.

config SJLJ_EXCEPTIONS
	bool
	prompt "Use setjump()/longjump() exceptions" if TOOLCHAINOPTS
	default n
	help
	    Use old setjump()/longjump() exceptions instead of the newer
	    frame unwinding exceptions handling routines.  Warning: increases
	    code size and runtime memory usage.

config INSTALL_GFORTRAN
	bool
	prompt "Build/install fortran compiler?" if TOOLCHAINOPTS
	default n
	help
	    Build/install GNU fortran compiler ?

config INSTALL_GCCGO
	bool
	prompt "Build/install Go compiler?" if TOOLCHAINOPTS
	depends on USE_GLIBC || BROKEN
	default n
	help
	    Build/install GNU gccgo compiler ?
```

## toolchain/musl/Config.in
```kconfig
# Password crypt stubbing

config MUSL_DISABLE_CRYPT_SIZE_HACK
	bool
	prompt "Include crypt() support for SHA256, SHA512 and Blowfish ciphers" if TOOLCHAINOPTS
	depends on USE_MUSL && !EXTERNAL_TOOLCHAIN
	default y
	help
	  Enable this option to re-include crypt() support for the SHA256, SHA512 and
	  Blowfish ciphers. Without this option, attempting to hash a string with a salt
	  requesting one of these ciphers will cause the crypt() function to call stub
	  implementations which will always fail with errno ENOSYS. Including the ciphers
	  will increase the library size by about 14KB after LZMA compression.
```

## toolchain/uClibc/Config.in
```kconfig
# Debug version.

config UCLIBC_ENABLE_DEBUG
	bool "Build with debug information"
	depends on TOOLCHAINOPTS && USE_UCLIBC && !EXTERNAL_TOOLCHAIN
	default n
```
