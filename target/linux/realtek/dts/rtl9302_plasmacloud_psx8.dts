// SPDX-License-Identifier: GPL-2.0-or-later
/dts-v1/;

#include "rtl9302_plasmacloud_common.dtsi"

/ {
	compatible = "plasmacloud,psx8", "realtek,rtl9302-soc";
	model = "Plasma Cloud PSX8";
};

&led_set {
	realtek,led-set0-force-port-mask = <0x0c000000>;
};
