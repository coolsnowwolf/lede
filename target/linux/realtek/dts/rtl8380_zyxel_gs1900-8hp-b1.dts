// SPDX-License-Identifier: GPL-2.0-or-later

#include "rtl8380_zyxel_gs1900-8hp.dtsi"

/ {
	compatible = "zyxel,gs1900-8hp-b1", "realtek,rtl838x-soc";
	model = "Zyxel GS1900-8HP B1 Switch";
};

&pse {
	compatible = "zyxel,gs1900-8hp-b1-pse", "realtek,pse-mcu-gen1";
	current-speed = <19200>;
};
