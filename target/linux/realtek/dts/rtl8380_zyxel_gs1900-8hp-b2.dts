// SPDX-License-Identifier: GPL-2.0-or-later

#include "rtl8380_zyxel_gs1900-8hp.dtsi"

/ {
	compatible = "zyxel,gs1900-8hp-b2", "realtek,rtl838x-soc";
	model = "Zyxel GS1900-8HP B2 Switch";
};

&pse {
	compatible = "zyxel,gs1900-8hp-b2-pse", "realtek,pse-mcu-gen2";
	current-speed = <115200>;
};
