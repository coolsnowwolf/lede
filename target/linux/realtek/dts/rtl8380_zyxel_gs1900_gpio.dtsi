// SPDX-License-Identifier: GPL-2.0-or-later

#include <dt-bindings/gpio/gpio.h>

&mdio_aux {
	status = "okay";

	gpio1: expander@0 {
		compatible = "realtek,rtl8231";
		reg = <0x0>;

		gpio-controller;
		#gpio-cells = <2>;
		gpio-ranges = <&gpio1 0 0 37>;

		poe_enable {
			gpio-hog;
			gpios = <13 GPIO_ACTIVE_HIGH>;
			output-high;
		};

		led-controller {
			compatible = "realtek,rtl8231-leds";
			status = "disabled";
		};
	};
};
