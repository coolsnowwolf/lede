// SPDX-License-Identifier: GPL-2.0-or-later

#include "rtl8380_zyxel_gs1900.dtsi"

/ {
	compatible = "zyxel,gs1900-8", "realtek,rtl838x-soc";
	model = "ZyXEL GS1900-8 Switch";
};

&gpio1 {
	/delete-node/ poe_enable;
};
