// SPDX-License-Identifier: GPL-2.0-or-later
/dts-v1/;

#include "rtl9303_hasivo_f1100w-4sx-4xgt-common.dtsi"

/ {
	compatible = "hasivo,f1100w-4sx-4xgt", "realtek,rtl9303-soc";
	model = "Hasivo F1100W-4SX-4XGT";

	memory@0 {
		reg = <0x00000000 0x10000000>; /* 256 MiB */
	};
};
