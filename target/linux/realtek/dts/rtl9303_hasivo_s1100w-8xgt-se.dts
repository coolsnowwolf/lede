// SPDX-License-Identifier: GPL-2.0-or-later
/dts-v1/;

#include "rtl9303_hasivo_s1100w-8xgt-se-common.dtsi"

/ {
	compatible = "hasivo,s1100w-8xgt-se", "realtek,rtl9303-soc";
	model = "Hasivo S1100W-8XGT-SE";
};
