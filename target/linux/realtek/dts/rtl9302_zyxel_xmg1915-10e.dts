// SPDX-License-Identifier: GPL-2.0-or-later
/dts-v1/;

#include "rtl9302_zyxel_xmg1915.dtsi"

#include <dt-bindings/input/input.h>
#include <dt-bindings/gpio/gpio.h>
#include <dt-bindings/leds/common.h>

/ {
	compatible = "zyxel,xmg1915-10e", "realtek,rtl9302c-soc";
	model = "Zyxel XMG1915-10E Switch";
};
