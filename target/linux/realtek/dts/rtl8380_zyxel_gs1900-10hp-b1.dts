// SPDX-License-Identifier: GPL-2.0-or-later

#include "rtl8380_zyxel_gs1900-10hp.dtsi"

/ {
	compatible = "zyxel,gs1900-10hp-b1", "realtek,rtl838x-soc";
	model = "Zyxel GS1900-10HP B1 Switch";
};

&pse {
	compatible = "zyxel,gs1900-10hp-b1-pse", "realtek,pse-mcu-gen2";
	current-speed = <115200>;
};
