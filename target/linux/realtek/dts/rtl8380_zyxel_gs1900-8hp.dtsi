// SPDX-License-Identifier: GPL-2.0-or-later

#include "rtl8380_zyxel_gs1900.dtsi"
#include "rtl8380_zyxel_gs1900_gpio.dtsi"

&uart1 {
	status = "okay";

	/* PoE MCU; compatible and current-speed are set per variant */
	pse: ethernet-pse {
		pse-pis {
			#address-cells = <1>;
			#size-cells = <0>;

			PSE_PI(0)
			PSE_PI(1)
			PSE_PI(2)
			PSE_PI(3)
			PSE_PI(4)
			PSE_PI(5)
			PSE_PI(6)
			PSE_PI(7)
		};
	};
};

&phy8 { pses = <&pse_pi0>; };
&phy9 { pses = <&pse_pi1>; };
&phy10 { pses = <&pse_pi2>; };
&phy11 { pses = <&pse_pi3>; };
&phy12 { pses = <&pse_pi4>; };
&phy13 { pses = <&pse_pi5>; };
&phy14 { pses = <&pse_pi6>; };
&phy15 { pses = <&pse_pi7>; };
