// SPDX-License-Identifier: GPL-2.0-or-later

#include "rtl8380_engenius_ews2910p.dtsi"

/ {
	compatible = "engenius,ews2910p-v1", "realtek,rtl838x-soc";
	model = "EnGenius EWS2910P v1";
};

&firmware_partition_1 {
	compatible = "openwrt,uimage";
	openwrt,ih-magic = <0x03802910>;
};
