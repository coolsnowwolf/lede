// SPDX-License-Identifier: GPL-2.0-or-later

#include "rtl8380_zyxel_gs1900.dtsi"
#include "rtl8380_zyxel_gs1900_gpio_emulated.dtsi"

/ {
	compatible = "zyxel,gs1900-8-v1", "realtek,rtl838x-soc";
	model = "Zyxel GS1900-8 v1 Switch";
};

&gpio1 {
	/delete-node/ poe_enable;
};
