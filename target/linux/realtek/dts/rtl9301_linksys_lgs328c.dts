// SPDX-License-Identifier: (GPL-2.0-or-later or MIT)
/dts-v1/;

#include "rtl9301_linksys_lgs328x_nand_common.dtsi"

/ {
	compatible = "linksys,lgs328c", "realtek,rtl9301-soc";
	model = "Linksys LGS328C";
};
