// SPDX-License-Identifier: GPL-2.0-or-later OR MIT

#include "rtl8382_hpe_1920-24g.dtsi"

/ {
	compatible = "hpe,1920-24g-poe-370w", "realtek,rtl838x-soc";
	model = "HPE 1920-24G-PoE+ 370W (JG926A)";

	gpio_fan_array {
		compatible = "gpio-fan";

		gpios = <&gpio1 5 GPIO_ACTIVE_HIGH>;
		gpio-fan,speed-map =    <5000 0>,
					<8200 1>;

		alarm-gpios = <&gpio1 6 GPIO_ACTIVE_LOW>;
		#cooling-cells = <2>;
	};
};

&uart1 {
	status = "okay";
};
