// SPDX-License-Identifier: GPL-2.0-or-later
/dts-v1/;

#include "rtl9303_hasivo_f1100wp-4sx-4xgt-common.dtsi"

/ {
	compatible = "hasivo,f1100wp-4sx-4xgt-512mb", "realtek,rtl9303-soc";
	model = "Hasivo F1100WP-4SX-4XGT (512MB)";

	memory@0 {
		reg = <0x00000000 0x10000000>, /* 256 MiB lowmem */
		      <0x20000000 0x10000000>; /* 256 MiB highmem */
	};
};
