// SPDX-License-Identifier: GPL-2.0-or-later OR MIT

#include "rtl838x.dtsi"
#include "rtl83xx_d-link_dgs-1210_common.dtsi"
#include "rtl83xx_d-link_dgs-1210_gpio.dtsi"
#include "rtl83xx_d-link_dgs-1210_gpio_sfp.dtsi"
#include "rtl8382_d-link_dgs-1210-28_common.dtsi"
#include "rtl8382_d-link_dgs-1210-28p_common.dtsi"

/ {
	compatible = "d-link,dgs-1210-28p-f", "realtek,rtl8382-soc", "realtek,rtl838x-soc";
	model = "D-Link DGS-1210-28P F";
};
