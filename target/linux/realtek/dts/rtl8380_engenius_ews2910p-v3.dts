// SPDX-License-Identifier: GPL-2.0-or-later

#include "rtl8380_engenius_ews2910p.dtsi"

/ {
	compatible = "engenius,ews2910p-v3", "realtek,rtl838x-soc";
	model = "EnGenius EWS2910P v3";
};

&firmware_partition_1 {
	compatible = "openwrt,uimage";
	openwrt,ih-magic = <0x03010500>;
};

&pse {
	compatible = "engenius,ews2910p-v3-pse", "realtek,pse-mcu-gen2";
	current-speed = <115200>;
};
