// SPDX-License-Identifier: GPL-2.0-or-later
/dts-v1/;

#include "rtl9313_zyxel_xs1930-aqr813.dtsi"

#include <dt-bindings/input/input.h>
#include <dt-bindings/gpio/gpio.h>
#include <dt-bindings/leds/common.h>
#include <dt-bindings/mux/mux.h>
#include <dt-bindings/phy/phy.h>

/ {
	compatible = "zyxel,xs1930-10", "realtek,rtl9313-soc";
	model = "Zyxel XS1930-10";
};

&led_set {
	realtek,led-set0-force-port-mask = <0x00300000 0x00000000>;
};

&mdio_ctrl {
	pinctrl-names = "default";
	pinctrl-0 = <&pinmux_enable_mdc_mdio_0>;
};

&switch0 {
	ethernet-ports {
		SWITCH_PORT_SFP(54, 9, 12, 0, 1)
		SWITCH_PORT_SFP(55, 10, 13, 0, 2)
	};
};
