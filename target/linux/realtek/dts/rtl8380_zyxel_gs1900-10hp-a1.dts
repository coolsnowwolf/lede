// SPDX-License-Identifier: GPL-2.0-or-later

#include "rtl8380_zyxel_gs1900-10hp.dtsi"

/ {
	compatible = "zyxel,gs1900-10hp-a1", "realtek,rtl838x-soc";
	model = "Zyxel GS1900-10HP A1 Switch";
};

&pse {
	compatible = "zyxel,gs1900-10hp-a1-pse", "realtek,pse-mcu-gen1";
	current-speed = <19200>;
};
