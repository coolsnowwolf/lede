// SPDX-License-Identifier: GPL-2.0-or-later OR MIT

#include "rtl8380_hpe_1920-8g.dtsi"

/ {
	compatible = "hpe,1920-8g-poe-65w", "realtek,rtl838x-soc";
	model = "HPE 1920-8G-PoE+ 65W (JG921A)";
};

&uart1 {
	status = "okay";
};
