// SPDX-License-Identifier: GPL-2.0-or-later

#include "rtl8382_zyxel_gs1900-24.dtsi"

/ {
	compatible = "zyxel,gs1900-24-a1", "realtek,rtl838x-soc";
	model = "Zyxel GS1900-24 A1";

	memory@0 {
		reg = <0x0 0x4000000>;
	};
};
