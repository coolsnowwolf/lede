// SPDX-License-Identifier: (GPL-2.0-or-later OR MIT)
/*
 * Device Tree file for Sercomm H500-s lowi
 *
 * Copyright (C) 2020 Daniel González Cabanelas <dgcbueu@gmail.com>
 */

#include "bcm63167-sercomm-h500-s.dtsi"

/ {
	model = "Sercomm H500-s lowi";
	compatible = "sercomm,h500-s-lowi", "brcm,bcm63167", "brcm,bcm63268";
};
