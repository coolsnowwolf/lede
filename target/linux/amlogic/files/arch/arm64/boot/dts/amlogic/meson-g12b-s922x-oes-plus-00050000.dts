// SPDX-License-Identifier: (GPL-2.0+ OR MIT)
/*
 * Copyright (c) 2019 BayLibre, SAS
 * Author: Neil Armstrong <narmstrong@baylibre.com>
 * Copyright (c) 2019 Christian Hewitt <christianshewitt@gmail.com>
 * Copyright (c) 2025 retro98boy <retro98boy@qq.com>
 */

/dts-v1/;

#include "meson-g12b-s922x-oes-plus.dts"

&ethmac {
	phy-mode = "rgmii-rxid";
	amlogic,prg-eth-reg0 = <0xffffffff 0x00001629>;
	amlogic,prg-eth-reg1 = <0xffffffff 0x00050000>;
};
