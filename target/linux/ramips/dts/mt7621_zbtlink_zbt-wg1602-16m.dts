#include "mt7621_zbtlink_zbt-wg1602.dtsi"

/ {
	compatible = "zbtlink,zbt-wg1602-16m", "zbtlink,zbt-wg1602", "mediatek,mt7621-soc";
	model = "Zbtlink ZBT-WG1602 (16M)";
};

&firmware {
	reg = <0x50000 0xfb0000>;
};
