// SPDX-License-Identifier: GPL-2.0-or-later OR MIT

#include "mt7628an_jotale_js76x8.dtsi"

/ {
	compatible = "jotale,js76x8-8m", "mediatek,mt7628an-soc";
	model = "Jotale JS76x8 (8M)";
};

&firmware {
	reg = <0x50000 0x7b0000>;
};
