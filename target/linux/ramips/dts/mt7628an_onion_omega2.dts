/dts-v1/;

#include "mt7628an_onion_omega2.dtsi"

/ {
	compatible = "onion,omega2", "mediatek,mt7628an-soc";
	model = "Onion Omega2";
};

&firmware {
	reg = <0x50000 0xfb0000>;
};

&system_led {
	label = "omega2:amber:system";
};
