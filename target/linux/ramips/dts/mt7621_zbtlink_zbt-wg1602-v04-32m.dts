#include "mt7621_zbtlink_zbt-wg1602-v04.dtsi"

/ {
	compatible = "zbtlink,zbt-wg1602-v04-32m", "zbtlink,zbt-wg1602-v04", "mediatek,mt7621-soc";
	model = "Zbtlink ZBT-WG1602-V04 (32M)";
};

&firmware {
	reg = <0x50000 0x1fb0000>;
};
