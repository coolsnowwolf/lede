/* This file is released into the public domain */

#include "mt7620a_netgear_ex3x00_ex61xx.dtsi"

/ {
	compatible = "netgear,ex6130", "ralink,mt7620a-soc";
	model = "Netgear EX6130";

	aliases {
		label-mac-device = &ethernet;
	};
};
