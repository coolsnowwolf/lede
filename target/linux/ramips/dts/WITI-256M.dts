/dts-v1/;

#include "WITI.dtsi"

/ {
	compatible = "mqmaker,witi-256m", "mqmaker,witi", "mediatek,mt7621-soc";
	model = "MQmaker WiTi (256MB RAM)";

	memory@0 {
		device_type = "memory";
		reg = <0x0 0x10000000>;
	};
};
