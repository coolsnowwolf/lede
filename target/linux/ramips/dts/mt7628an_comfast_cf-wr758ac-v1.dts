// SPDX-License-Identifier: GPL-2.0-or-later OR MIT

#include "mt7628an_comfast_cf-wr758ac.dtsi"

/ {
	compatible = "comfast,cf-wr758ac-v1", "mediatek,mt7628an-soc";
	model = "COMFAST CF-WR758AC V1";
};
