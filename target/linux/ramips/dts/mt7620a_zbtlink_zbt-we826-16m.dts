#include "mt7620a_zbtlink_zbt-we826.dtsi"

/ {
	compatible = "zbtlink,zbt-we826-16m", "zbtlink,zbt-we826", "ralink,mt7620a-soc";
	model = "Zbtlink ZBT-WE826 (16M)";
};

&firmware {
	reg = <0x50000 0xfb0000>;
};
