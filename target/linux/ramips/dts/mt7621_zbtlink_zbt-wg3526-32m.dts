#include "mt7621_zbtlink_zbt-wg3526.dtsi"

/ {
	compatible = "zbtlink,zbt-wg3526-32m", "zbtlink,zbt-wg3526", "mediatek,mt7621-soc";
	model = "Zbtlink ZBT-WG3526 (32M)";
};

&firmware {
	reg = <0x50000 0x1fb0000>;
};
