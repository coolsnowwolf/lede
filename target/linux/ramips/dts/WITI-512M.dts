/dts-v1/;

#include "WITI.dtsi"

/ {
	compatible = "mqmaker,witi-512m", "mqmaker,witi", "mediatek,mt7621-soc";
	model = "MQmaker WiTi (512MB RAM)";

	memory@0 {
		device_type = "memory";
		reg = <0x0 0x1c000000>, <0x20000000 0x4000000>;
	};
};
