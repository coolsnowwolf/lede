/dts-v1/;

#include "mt7621_ubiquiti_edgerouterx.dtsi"

#include <dt-bindings/gpio/gpio.h>

/ {
	model = "UBNT-ERX-SFP";
	compatible = "ubiquiti,edgerouterx-sfp", "mediatek,mt7621-soc";

	i2c-gpio {
		compatible = "i2c-gpio";
		gpios = <&gpio0 3 GPIO_ACTIVE_HIGH /* sda */
		         &gpio0 4 GPIO_ACTIVE_HIGH /* scl */
		        >;
		#address-cells = <1>;
		#size-cells = <0>;

		pca9555@25 {
			compatible = "pca9555";
			reg = <0x25>;
		};
	};
};
