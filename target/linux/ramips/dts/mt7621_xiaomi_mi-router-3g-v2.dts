// SPDX-License-Identifier: GPL-2.0-or-later OR MIT

#include "mt7621_xiaomi_mi-router-4a-3g-v2.dtsi"

/ {
	compatible = "xiaomi,mi-router-3g-v2", "mediatek,mt7621-soc";
	model = "Xiaomi Mi Router 3G v2";
};
