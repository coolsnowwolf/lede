// SPDX-License-Identifier: GPL-2.0-or-later OR MIT

#include "mt7628an_glinet_vixmini_microuter.dtsi"

/ {
	compatible = "glinet,microuter-n300", "mediatek,mt7628an-soc";
	model = "GL.iNet microuter-N300";
};

&firmware_part {
		reg = <0x50000 0xfb0000>;
};
