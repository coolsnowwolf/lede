// SPDX-License-Identifier: GPL-2.0-or-later OR MIT
/dts-v1/;

#include "mt7620a_zbtlink_zbt-we1026-h.dtsi"

/ {
	compatible = "zbtlink,zbt-we1026-h-32m", "zbtlink,zbt-we1026-h",
		"zbtlink,zbt-we1026", "ralink,mt7620a-soc";
	model = "Zbtlink ZBT-WE1026-H (32M)";
};

&firmware {
	reg = <0x50000 0x1fb0000>;
};
