/dts-v1/;

#include "W2914NSV2.dtsi"

/ {
	model = "WeVO W2914NS v2";

	memory@0 {
		device_type = "memory";
		reg = <0x0 0x8000000>;
	};

	gpio-leds {
		compatible = "gpio-leds";

		usb {
			label = "w2914nsv2:green:usb";
			gpios = <&gpio0 27 GPIO_ACTIVE_LOW>;
		};
	};
};
