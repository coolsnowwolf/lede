// SPDX-License-Identifier: GPL-2.0-or-later OR MIT

#include "mt7621_xiaomi_mi-router-cr660x.dtsi"

/ {
	compatible = "xiaomi,mi-router-cr6606", "mediatek,mt7621-soc";
	model = "Xiaomi Mi Router CR6606";
};
