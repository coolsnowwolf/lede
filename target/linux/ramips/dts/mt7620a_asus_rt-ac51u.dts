#include "mt7620a_asus_rt-ac5x.dtsi"

/ {
	compatible = "asus,rt-ac51u", "ralink,mt7620a-soc";
	model = "Asus RT-AC51U";
};

&pcie0 {
	wifi@0,0 {
		reg = <0x0000 0 0 0 0>;
		mediatek,mtd-eeprom = <&factory 0x8000>;
	};
};
