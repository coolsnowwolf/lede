// SPDX-License-Identifier: GPL-2.0-or-later OR MIT

#include "mt7620a_youku_yk-l1.dtsi"

/ {
	compatible = "youku,yk-l1c", "ralink,mt7620a-soc";
	model = "Youku YK-L1c";
};

&firmware {
	reg = <0x50000 0xfb0000>;
};
