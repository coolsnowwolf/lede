#include "mt7621_zbtlink_zbt-wg3526.dtsi"

/ {
	compatible = "zbtlink,zbt-wg3526-16m", "zbtlink,zbt-wg3526", "mediatek,mt7621-soc";
	model = "Zbtlink ZBT-WG3526 (16M)";
};

&firmware {
	reg = <0x50000 0xfb0000>;
};
