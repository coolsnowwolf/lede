// SPDX-License-Identifier: GPL-2.0-or-later OR MIT

#include "mt7620a_youku_yk-l1.dtsi"

/ {
	compatible = "youku,yk-l1", "ralink,mt7620a-soc";
	model = "Youku YK-L1";
};

&firmware {
	reg = <0x50000 0x1fb0000>;
};
