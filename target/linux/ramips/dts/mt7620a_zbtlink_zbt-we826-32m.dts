#include "mt7620a_zbtlink_zbt-we826.dtsi"

/ {
	compatible = "zbtlink,zbt-we826-32m", "zbtlink,zbt-we826", "ralink,mt7620a-soc";
	model = "Zbtlink ZBT-WE826 (32M)";
};

&flash0 {
	broken-flash-reset;
};

&firmware {
	reg = <0x50000 0x1fb0000>;
};
