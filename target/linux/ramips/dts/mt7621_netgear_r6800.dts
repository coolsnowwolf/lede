// SPDX-License-Identifier: GPL-2.0-only

#include "mt7621_netgear_sercomm_bzv.dtsi"

/ {
	compatible = "netgear,r6800", "mediatek,mt7621-soc";
	model = "Netgear R6800";
};

&leds {
	usb2 {
		gpios = <&gpio_expander 6 GPIO_ACTIVE_LOW>;
		label = "white:usb2";
		linux,default-trigger = "usbport";
		trigger-sources = <&ehci_port2>;
	};
};
