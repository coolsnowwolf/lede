// SPDX-License-Identifier: GPL-2.0-or-later OR MIT

#include "mt7621_zbtlink_zbt-wg1608.dtsi"

/ {
	compatible = "zbtlink,zbt-wg1608-16m", "zbtlink,zbt-wg1608", "mediatek,mt7621-soc";
	model = "Zbtlink ZBT-WG1608 (16M)";
};

&firmware {
	reg = <0x50000 0xfb0000>;
};
