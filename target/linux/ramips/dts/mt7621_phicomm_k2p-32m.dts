/dts-v1/;

#include "mt7621_phicomm_k2p.dtsi"

/ {
	compatible = "phicomm,k2p-32m", "mediatek,mt7621-soc";
	model = "Phicomm K2P (32M)";
};

&firmware {
	reg = <0xa0000 0x1f60000>;
};

&flash {
	broken-flash-reset;
};
