// SPDX-License-Identifier: GPL-2.0-or-later OR MIT

#include "mt7621_arcadyan_wg4xx223.dtsi"

/ {
	compatible = "beeline,smartbox-flash", "mediatek,mt7621-soc";
	model = "Beeline SmartBox Flash";

	leds {
		led-0 {
			label = "blue:wan";
			color = <LED_COLOR_ID_BLUE>;
			function = LED_FUNCTION_WAN;
			gpios = <&gpio 14 GPIO_ACTIVE_LOW>;
		};
	};
};
