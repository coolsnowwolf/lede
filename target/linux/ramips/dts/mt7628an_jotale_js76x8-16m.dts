// SPDX-License-Identifier: GPL-2.0-or-later OR MIT

#include "mt7628an_jotale_js76x8.dtsi"

/ {
	compatible = "jotale,js76x8-16m", "jotale,js76x8", "mediatek,mt7628an-soc";
	model = "Jotale JS76x8 (16M)";
};

&firmware {
	reg = <0x50000 0xfb0000>;
};
