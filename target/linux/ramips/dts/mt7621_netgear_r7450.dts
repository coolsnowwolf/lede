// SPDX-License-Identifier: GPL-2.0-only

#include "mt7621_netgear_sercomm_bzv.dtsi"

/ {
	compatible = "netgear,r7450", "mediatek,mt7621-soc";
	model = "Netgear R7450";
};

&leds {
	guest_wifi {
		gpios = <&gpio_expander 6 GPIO_ACTIVE_LOW>;
		label = "white:guest_wifi";
	};
};
