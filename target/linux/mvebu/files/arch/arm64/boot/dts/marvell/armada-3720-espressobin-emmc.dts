// SPDX-License-Identifier: (GPL-2.0+ OR MIT)
/*
 * Device Tree file for Globalscale Marvell ESPRESSOBin Board with eMMC
 * Copyright (C) 2018 Marvell
 *
 * Romain Perier <romain.perier@free-electrons.com>
 * Konstantin Porotchkin <kostap@marvell.com>
 *
 */

#include "armada-3720-espressobin.dts"

/ {
	model = "Globalscale Marvell ESPRESSOBin Board (eMMC)";
	compatible = "globalscale,espressobin-emmc", "globalscale,espressobin",
		     "marvell,armada3720", "marvell,armada3710";
};

&sdhci0 {
	status = "okay";

	#address-cells = <1>;
	#size-cells = <0>;
	mmccard: mmccard@0 {
		compatible = "mmc-card";
		reg = <0>;
	};
};
