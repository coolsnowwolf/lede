// SPDX-License-Identifier: (GPL-2.0+ OR MIT)

/dts-v1/;

#include "armada-3720-uDPU.dtsi"

/ {
	model = "Methode eDPU Board";
	compatible = "methode,edpu", "marvell,armada3720", "marvell,armada3710";
};

/* PHY mode is set to 1000Base-X despite Maxlinear IC being capable of
 * 2500Base-X since until 5.15 support for mvebu is available trying to
 * use 2500Base-X will cause buffer overruns for which the fix is not
 * easily backportable.
 */
&eth0 {
	phy-mode = "1000base-x";
};
