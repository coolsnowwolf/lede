// SPDX-License-Identifier: (GPL-2.0+ OR MIT)
/dts-v1/;
#include "armada-385-wd_cloud.dtsi"

/ {
	model = "WD MyCloud Ex2 Ultra";
	compatible = "wd,cloud-ex2-ultra", "marvell,armada385", "marvell,armada380";

	memory {
		device_type = "memory";
		reg = <0x00000000 0x40000000>; /* 1GB */
	};
};
