// SPDX-License-Identifier: GPL-2.0-or-later OR MIT

#include "armada-385-fortinet-fg-5xe.dtsi"

/ {
	model = "Fortinet FortiWiFi 50E-2R";
	compatible = "fortinet,fwf-50e-2r", "marvell,armada385", "marvell,armada380";
};

&pciec {
	status = "okay";
};

&pcie1 {
	status = "okay";
};

&pcie2 {
	status = "okay";
};
