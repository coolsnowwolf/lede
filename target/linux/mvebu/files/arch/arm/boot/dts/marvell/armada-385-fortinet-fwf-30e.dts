// SPDX-License-Identifier: GPL-2.0-or-later OR MIT

#include "armada-385-fortinet-fg-3xe.dtsi"


/ {
        model = "Fortinet FortiWiFi 30E";
        compatible = "fortinet,fwf-30e", "marvell,armada385", "marvell,armada380";
};

&pciec {
        status = "okay";
};

&pcie2 {
        status = "okay";
};
