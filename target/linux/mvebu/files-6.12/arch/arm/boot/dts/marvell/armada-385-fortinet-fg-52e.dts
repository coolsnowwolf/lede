// SPDX-License-Identifier: GPL-2.0-or-later OR MIT

#include "armada-385-fortinet-fg-5xe.dtsi"

/ {
	model = "Fortinet FortiGate 52E";
	compatible = "fortinet,fg-52e", "marvell,armada385", "marvell,armada380";
};

&ahci0 {
	status = "okay";
};
