// SPDX-License-Identifier: GPL-2.0-or-later OR MIT

#include "armada-385-fortinet-fg-5xe.dtsi"

/ {
	model = "Fortinet FortiGate 50E";
	compatible = "fortinet,fg-50e", "marvell,armada385", "marvell,armada380";
};
