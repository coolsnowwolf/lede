// SPDX-License-Identifier: GPL-2.0-or-later OR MIT

#include "armada-385-fortinet-fg-5xe.dtsi"

/ {
	model = "Fortinet FortiWiFi 51E";
	compatible = "fortinet,fwf-51e", "marvell,armada385", "marvell,armada380";
};

&ahci0 {
	status = "okay";
};

&pciec {
	status = "okay";
};

&pcie2 {
	status = "okay";
};
