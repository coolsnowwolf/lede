// SPDX-License-Identifier: (GPL-2.0+ OR MIT)

&cpu0_opp_table {
	opp-1800000000 {
		opp-microvolt = <1100000 1100000 1100000>;
		opp-microvolt-L1 = <1087500 1087500 1100000>;
		opp-microvolt-L2 = <1075000 1075000 1100000>;
		opp-microvolt-L3 = <1062500 1062500 1100000>;
		opp-microvolt-L4 = <1050000 1050000 1100000>;
		opp-microvolt-L5 = <1037500 1037500 1100000>;
		opp-microvolt-L6 = <1025000 1025000 1100000>;
		opp-microvolt-L7 = <1012500 1012500 1100000>;
		opp-microvolt-L8 = <1000000 1000000 1100000>;
		opp-microvolt-L9 = <987500 987500 1100000>;
		opp-microvolt-L10 = <975000 975000 1100000>;
		opp-microvolt-L11 = <962500 962500 1100000>;
	};

	opp-2016000000 {
		opp-microvolt = <1100000 1100000 1200000>;
		opp-microvolt-L1 = <1190000 1190000 1200000>;
		opp-microvolt-L2 = <1180000 1180000 1200000>;
		opp-microvolt-L3 = <1170000 1170000 1200000>;
		opp-microvolt-L4 = <1160000 1160000 1200000>;
		opp-microvolt-L5 = <1150000 1150000 1200000>;
		opp-microvolt-L6 = <1140000 1140000 1200000>;
		opp-microvolt-L7 = <1130000 1130000 1200000>;
		opp-microvolt-L8 = <1120000 1120000 1200000>;
		opp-microvolt-L9 = <1110000 1110000 1200000>;
		opp-microvolt-L10 = <1100000 1100000 1200000>;
		opp-microvolt-L11 = <1090000 1090000 1200000>;
	};
};
