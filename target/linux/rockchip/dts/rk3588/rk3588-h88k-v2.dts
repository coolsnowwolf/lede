// SPDX-License-Identifier: (GPL-2.0+ OR MIT)
/*
 * Copyright (c) 2023 iStoreOS
 * (https://www.istoreos.com)
 *
 * Copyright (c) 2022 Rockchip Electronics Co., Ltd.
 *
 */

/dts-v1/;

#include "rk3588-hinlink.dtsi"

/ {
	model = "HINLINK H88K V2";
	compatible = "hinlink,h88k-v2", "rockchip,rk3588";

	vcc3v3_m2_sata: vcc3v3-m2-sata {
		compatible = "regulator-fixed";
		enable-active-high;
		regulator-always-on;
		regulator-boot-on;
		gpios = <&gpio4 RK_PA4 GPIO_ACTIVE_HIGH>;
		regulator-min-microvolt = <3300000>;
		regulator-max-microvolt = <3300000>;
		regulator-name = "vcc3v3_sata";
		vin-supply = <&vcc12v_dcin>;
	};
};

// combphy0_ps
&sata0 {
	status = "okay";
};
