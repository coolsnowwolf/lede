// SPDX-License-Identifier: (GPL-2.0+ OR MIT)
/*
 * Copyright (c) 2023 iStoreOS
 * (https://www.istoreos.com)
 *
 * Copyright (c) 2022 Rockchip Electronics Co., Ltd.
 *
 */

/dts-v1/;

#include "rk3588-hinlink.dtsi"

/ {
	model = "HINLINK H88K V3";
	compatible = "hinlink,h88k-v3", "rockchip,rk3588";

	vcc3v3_sd: vcc3v3-sd-regulator {
		compatible = "regulator-fixed";
		enable-active-high;
		regulator-always-on;
		regulator-boot-on;
		gpios = <&gpio4 RK_PA4 GPIO_ACTIVE_HIGH>;
		regulator-min-microvolt = <3300000>;
		regulator-max-microvolt = <3300000>;
		regulator-name = "vcc3v3_sd";
		vin-supply = <&vcc12v_dcin>;
	};
};

// combphy0_ps
&pcie2x1l2 {
	// rtl8125
	reset-gpios = <&gpio4 RK_PA5 GPIO_ACTIVE_HIGH>;
	status = "okay";
};
