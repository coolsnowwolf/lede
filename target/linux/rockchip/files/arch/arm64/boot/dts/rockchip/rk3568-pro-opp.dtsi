// SPDX-License-Identifier: (GPL-2.0+ OR MIT)

&cpu0_opp_table {
	opp-2088000000 {
		opp-hz = /bits/ 64 <2088000000>;
		opp-microvolt = <1200000>;
	};

	opp-2184000000 {
		opp-hz = /bits/ 64 <2184000000>;
		opp-microvolt = <1250000>;
	};

	opp-2208000000 {
		opp-hz = /bits/ 64 <2208000000>;
		opp-microvolt = <1275000>;
	};
};
