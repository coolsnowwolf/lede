// SPDX-License-Identifier: (GPL-2.0+ OR MIT)
// Copyright (c) 2022 AmadeusGhost <amadeus@jmu.edu.cn>

/dts-v1/;

#include "rk3568-hinlink-opc.dtsi"

/ {
	model = "HINLINK OPC-H66K Board";
	compatible = "hinlink,opc-h66k", "rockchip,rk3568";
};
