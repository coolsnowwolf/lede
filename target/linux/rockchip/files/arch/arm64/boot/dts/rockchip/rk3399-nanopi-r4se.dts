// SPDX-License-Identifier: (GPL-2.0+ OR MIT)

/dts-v1/;
#include "rk3399-nanopi-r4s.dts"

/ {
	model = "FriendlyElec NanoPi R4SE";
	compatible = "friendlyarm,nanopi-r4se", "rockchip,rk3399";
};


&emmc_phy {
	status = "okay";
};

&sdhci {
	status = "okay";
};
