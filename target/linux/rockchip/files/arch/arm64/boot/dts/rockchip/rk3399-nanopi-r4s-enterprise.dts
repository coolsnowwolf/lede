// SPDX-License-Identifier: GPL-2.0-or-later

#include "rk3399-nanopi-r4s.dts"

/ {
	model = "FriendlyElec NanoPi R4S Enterprise Edition";
	compatible = "friendlyarm,nanopi-r4s-enterprise", "rockchip,rk3399";
};
