// SPDX-License-Identifier: (GPL-2.0+ OR MIT)
/*
 * Copyright (c) 2019 Akash Gajjar <Akash_Gajjar@mentor.com>
 * Copyright (c) 2019 Pragnesh Patel <Pragnesh_Patel@mentor.com>
 */

/* TODO
 * Delete this file and migrate RockPi 4 to RockPi 4A after
 * removing Kernel 5.4.
 */


/dts-v1/;
#include "rk3399-rock-pi-4.dtsi"

/ {
	model = "SHAREVDI GuangMiao G4C";
	compatible = "sharevdi,guangmiao-g4c", "rockchip,rk3399";
};
