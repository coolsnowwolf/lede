// SPDX-License-Identifier: (GPL-2.0+ OR MIT)
/*
 * Copyright (c) 2021 Rockchip Electronics Co., Ltd.
 *
 */

/dts-v1/;
/ {
	model = "Firefly Station P2";
	compatible = "firefly,rk3568-roc-pc", "rockchip,rk3568";
};
