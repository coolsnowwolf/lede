// SPDX-License-Identifier: GPL-2.0-or-later OR MIT

#include "kirkwood-linksys-viper.dts"

/ {
	model = "Linksys EA4500 (Viper)";
	compatible = "linksys,ea4500", "linksys,viper", "marvell,kirkwood-88f6282", "marvell,kirkwood";
};
