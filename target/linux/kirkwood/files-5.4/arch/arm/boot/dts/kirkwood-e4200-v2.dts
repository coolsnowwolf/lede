// SPDX-License-Identifier: GPL-2.0-or-later OR MIT

#include "kirkwood-linksys-viper.dts"

/ {
	model = "Linksys E4200 v2 (Viper)";
	compatible = "linksys,e4200-v2", "linksys,viper", "marvell,kirkwood-88f6282", "marvell,kirkwood";
};
