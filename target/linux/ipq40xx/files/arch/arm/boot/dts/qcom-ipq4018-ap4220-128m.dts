// SPDX-License-Identifier: GPL-2.0-or-later OR MIT

#include "qcom-ipq4018-ap4220.dtsi"

/ {
	model = "Alibaba AP4220 128M";
	compatible = "alibaba,ap4220-128m";
};

&ubi_rootfs {
	reg = <0x0 0x08000000>;
};
