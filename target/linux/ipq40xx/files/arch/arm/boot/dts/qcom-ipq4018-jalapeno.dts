// SPDX-License-Identifier: GPL-2.0-or-later OR MIT
// Copyright (c) 2018, Robert Marko <robimarko@gmail.com>

#include "qcom-ipq4018-jalapeno.dtsi"

/ {
	model = "8devices Jalapeno";
	compatible = "8dev,jalapeno";
};
