// SPDX-License-Identifier: GPL-2.0-or-later OR MIT

#include "qcom-ipq4019-r619ac.dtsi"

/ {
	model = "P&W R619AC 128M";
	compatible = "p2w,r619ac-128m";
};

&nand_rootfs {
	/*
	 * Watch out: stock MIBIB is set up for a 64MiB chip.
	 * If a 128MiB flash chip is used, make sure to have
	 * the right values in MIBIB or the device might not
	 * boot.
	 */
	reg = <0x0 0x8000000>;
};
