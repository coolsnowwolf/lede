// SPDX-License-Identifier: GPL-2.0-or-later OR MIT

#include "qcom-ipq4028-fogpod800.dtsi"

/ {
	model = "ThinkPlus FogPOD800 128m";
	compatible = "thinkplus,fogpod800-128m";
};

&ubi_rootfs {
	reg = <0x0 0x08000000>;
};
