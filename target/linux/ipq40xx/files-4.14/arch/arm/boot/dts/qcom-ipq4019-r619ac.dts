// SPDX-License-Identifier: GPL-2.0-or-later OR MIT

#include "qcom-ipq4019-r619ac.dtsi"

/ {
	model = "P&W R619AC";
	compatible = "p2w,r619ac";

	chosen {
		bootargs-append = " root=/dev/ubiblock0_1 rootfstype=squashfs";
	};
};