// SPDX-License-Identifier: GPL-2.0-or-later OR MIT

#include "cn7130_ubnt_edgerouter-e300.dtsi"

/ {
	compatible = "ubnt,edgerouter-4", "cavium,cn7130";
	model = "Ubiquiti EdgeRouter 4";
};

&pip {
	interface@0 {
		ethernet@0 {
			label = "lan3";
			status = "okay";
			phy-mode = "sgmii";
			phy-handle = <&phy4>;
			nvmem-cells = <&macaddr_eeprom_0 0>;
			nvmem-cell-names = "mac-address";
		};
	};
};
