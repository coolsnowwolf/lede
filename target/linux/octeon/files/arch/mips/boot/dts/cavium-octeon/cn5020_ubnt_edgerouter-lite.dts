// SPDX-License-Identifier: GPL-2.0-only
/*
 * Device tree source for Ubiquity Edgerouter Lite
 */

/include/ "ubnt_e100.dts"

/ {
	compatible = "ubnt,erlite", "cavium,cn5020";
	model = "Ubiquiti Edgerouter Lite";
};
