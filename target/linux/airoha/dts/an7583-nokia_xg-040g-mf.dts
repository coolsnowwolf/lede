// SPDX-License-Identifier: GPL-2.0-only OR MIT

#include "an7583-nokia_xg-040g-mf-common.dtsi"
#include "an758x-nokia_xg-040g-stock-parts.dtsi"

/ {
	model = "Nokia XG-040G-MF";
	compatible = "nokia,xg-040g-mf", "airoha,an7583", "airoha,en7583";
};
