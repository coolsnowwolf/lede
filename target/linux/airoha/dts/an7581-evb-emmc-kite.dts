// SPDX-License-Identifier: (GPL-2.0-only OR BSD-2-Clause)
/dts-v1/;

#include "an7581-evb-emmc.dtsi"
#include "an7581-npu-mt7992.dtsi"

/ {
	model = "Airoha AN7581 Evaluation Board (eMMC + Kite)";
	compatible = "airoha,an7581-evb", "airoha,an7581", "airoha,en7581";

	aliases {
		serial0 = &uart1;
	};

	chosen {
		bootargs = "console=ttyS0,115200 earlycon";
		stdout-path = "serial0:115200n8";
	};

	memory@80000000 {
		device_type = "memory";
		reg = <0x0 0x80000000 0x2 0x00000000>;
	};
};
