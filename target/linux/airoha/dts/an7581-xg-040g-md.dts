// SPDX-License-Identifier: (GPL-2.0-only OR BSD-2-Clause)
/dts-v1/;

#include "an7581-xg-040g-series.dtsi"

/ {
    model = "Nokia Bell XG-040G-MD";
    compatible = "bell,xg-040g-md", "airoha,an7581", "airoha,en7581";
};

&usb0 {
	status = "okay";
};

&usb1 {
	status = "okay";
	mediatek,u3p-dis-msk = <0x1>;
	phys = <&usb1_phy PHY_TYPE_USB2>;
};