// SPDX-License-Identifier: (GPL-2.0-only OR BSD-2-Clause)
/dts-v1/;

/* Firmware reserves the first 2 MiB of DRAM. */
/memreserve/ 0x80000000 0x200000;

#include "an7581-znxt-zn50xg-d-common.dtsi"

/ {
	model = "ZNXT ZN504XG-D";
	compatible = "znxt,zn504xg-d", "airoha,an7581", "airoha,en7581";
};

&znxt_proline_layout {
	/*
	 * ZN504 stores X-PON serial at factory offset 0x14104b as a vendor ID
	 * followed by eight hexadecimal ASCII characters.
	 */
	pon_serial: pon-serial@14104b {
		reg = <0x0014104b 0x0000000c>;
	};
};

&xpon_mac {
	nvmem-cells = <&pon_serial>;
};
