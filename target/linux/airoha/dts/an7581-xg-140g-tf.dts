// SPDX-License-Identifier: (GPL-2.0-only OR BSD-2-Clause)
/dts-v1/;

#include "an7581-xg-040g-series.dtsi"

/ {
    model = "Nokia Bell XG-140G-TF";
    compatible = "bell,xg-140g-tf", "airoha,an7581", "airoha,en7581";
};