// SPDX-License-Identifier: GPL-2.0-only OR MIT

#include "an7581-nokia_xg-040g-md-common.dtsi"
#include "an758x-nokia_xg-040g-ubi-parts.dtsi"

/ {
	model = "Nokia XG-040G-MD (UBI)";
	compatible = "nokia,xg-040g-md-ubi", "airoha,an7581",
		     "airoha,en7581";
};
