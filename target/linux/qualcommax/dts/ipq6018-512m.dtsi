// SPDX-License-Identifier: GPL-2.0-only

#include "ipq6018.dtsi"

&q6_region {
	reg = <0x0 0x4ab00000 0x0 0x3700000>;
};

&q6_etr_region {
	reg = <0x0 0x4e200000 0x0 0x100000>;
};

&m3_dump_region {
	reg = <0x0 0x4e300000 0x0 0x100000>;
};
