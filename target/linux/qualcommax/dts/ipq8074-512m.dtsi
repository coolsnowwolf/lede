// SPDX-License-Identifier: GPL-2.0-only

#include "ipq8074.dtsi"

&tzapp_region {
	reg = <0x0 0x4a400000 0x0 0x100000>;
};

&q6_region {
	reg = <0x0 0x4b000000 0x0 0x3700000>;
};

&q6_etr_region {
	reg = <0x0 0x4e700000 0x0 0x100000>;
};

&m3_dump_region {
	reg = <0x0 0x4e800000 0x0 0x100000>;
};
