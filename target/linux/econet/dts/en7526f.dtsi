// SPDX-License-Identifier: (GPL-2.0-only OR BSD-2-Clause)
/dts-v1/;

#include "en751221.dtsi"

/ {
	compatible = "econet,en7526f", "econet,en751221";
};

/* EN7526F only has one USB port */
// Awaiting USB PHY driver
// &u2port1 {
// 	status = "disabled";
// };

// &u3port0 {
// 	status = "disabled";
// };

&usb {
	mediatek,u3p-dis-msk = <0x1>;
	mediatek,u2p-dis-msk = <0x2>;
	// phys = <&u2port0>;
};

/* EN7526F only has one PCIe port */
&pcie1 {
	status = "disabled";
};
