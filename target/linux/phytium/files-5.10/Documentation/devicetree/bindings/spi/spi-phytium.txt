## target/linux/phytium/files-6.18/drivers/gpu/drm/phytium/Kconfig
```kconfig
config DRM_PHYTIUM
	tristate "DRM Support for Phytium Graphics Card"
	depends on DRM
	select FB_IOMEM_HELPERS
	select DRM_KMS_HELPER
	select DRM_DISPLAY_HELPER
	select DRM_DISPLAY_DP_HELPER
	select DRM_DISPLAY_HDCP_HELPER
	select BACKLIGHT_CLASS_DEVICE
	help
	  Choose this option if you have a phytium graphics card.
	  This driver provides kernel mode setting and buffer management to userspace.
```

## target/linux/qualcommax/files-5.15/drivers/power/qcom/Kconfig
```kconfig
config QCOM_APM
       bool "Qualcomm Technologies Inc platform specific APM driver"
       help
	Platform specific driver to manage the power source of
	memory arrays. Interfaces with regulator drivers to ensure
	SRAM Vmin requirements are met across different performance
	levels.
```

## target/linux/ramips/files-4.14/drivers/net/ethernet/mtk/Kconfig
```kconfig
config NET_VENDOR_MEDIATEK
	tristate "Mediatek/Ralink ethernet driver"
	depends on RALINK
	help
	  This driver supports the ethernet mac inside the Mediatek and Ralink WiSoCs

config NET_MEDIATEK_SOC
	def_tristate NET_VENDOR_MEDIATEK

if NET_MEDIATEK_SOC
choice
	prompt "MAC type"

config NET_MEDIATEK_RT2880
	bool "RT2882"
	depends on MIPS && SOC_RT288X

config NET_MEDIATEK_RT3050
	bool "RT3050/MT7628"
	depends on MIPS && (SOC_RT305X || SOC_MT7620)

config NET_MEDIATEK_RT3883
	bool "RT3883"
	depends on MIPS && SOC_RT3883

config NET_MEDIATEK_MT7620
	bool "MT7620"
	depends on MIPS && SOC_MT7620

config NET_MEDIATEK_MT7621
	bool "MT7621"
	depends on MIPS && SOC_MT7621

endchoice

config NET_MEDIATEK_OFFLOAD
	def_bool NET_MEDIATEK_SOC
	depends on NET_MEDIATEK_MT7621

config NET_MEDIATEK_HW_QOS
	def_bool NET_MEDIATEK_SOC
	depends on NET_MEDIATEK_MT7623

config NET_MEDIATEK_MDIO
	def_bool NET_MEDIATEK_SOC
	depends on (NET_MEDIATEK_RT2880 || NET_MEDIATEK_RT3883 || NET_MEDIATEK_MT7620 || NET_MEDIATEK_MT7621)
	select PHYLIB

config NET_MEDIATEK_MDIO_RT2880
	def_bool NET_MEDIATEK_SOC
	depends on (NET_MEDIATEK_RT2880 || NET_MEDIATEK_RT3883)
	select NET_MEDIATEK_MDIO

config NET_MEDIATEK_MDIO_MT7620
	def_bool NET_MEDIATEK_SOC
	depends on (NET_MEDIATEK_MT7620 || NET_MEDIATEK_MT7621)
	select NET_MEDIATEK_MDIO

config NET_MEDIATEK_ESW_RT3050
	def_tristate NET_MEDIATEK_SOC
	depends on NET_MEDIATEK_RT3050

config NET_MEDIATEK_GSW_MT7620
	def_tristate NET_MEDIATEK_SOC
	depends on NET_MEDIATEK_MT7620

config NET_MEDIATEK_GSW_MT7621
	def_tristate NET_MEDIATEK_SOC
	depends on NET_MEDIATEK_MT7621
endif
```

## target/linux/ramips/files/drivers/net/ethernet/mediateksdk/Kconfig
```kconfig
# SPDX-License-Identifier: GPL-2.0-only
config NET_VENDOR_MEDIATEK_SDK
	bool "MediaTek ethernet driver(SDK)"
	depends on ARCH_MEDIATEK || SOC_MT7621 || SOC_MT7620
	help
	  If you have a Mediatek SoC with ethernet, say Y.

if NET_VENDOR_MEDIATEK_SDK

config NET_MTKSDK
	tristate "MediaTek SoC Gigabit Ethernet support(SDK)"
	select PHYLINK
	select DIMLIB
	help
	  This driver supports the gigabit ethernet MACs in the
	  MediaTek SoC family.

config MEDIATEK_NETSYS_V2
	tristate "MediaTek Ethernet NETSYS V2 support"
	help
	  This options enable MTK Ethernet NETSYS V2 support
	 

config MEDIATEK_NETSYS_V3
	tristate "MediaTek Ethernet NETSYS V3 support"
	help
	  This options enable MTK Ethernet NETSYS V3 support

config NET_MEDIATEK_HNAT
	tristate "MediaTek HW NAT support"
	help
	  This driver supports the hardward Network Address Translation
	  in the MediaTek MT7986/MT2701/MT7622/MT7629/MT7621 chipset
	  family.
	  
config ARCH_MT7622_WIFI_HW_NAT
	tristate "ARCH_MT7622_WIFI_HW_NAT"
	bool
	default n
	  
config RA_HW_NAT
	tristate "RA_HW_NAT"
	help
	  This driver supports RA_HW_NAT
	  
config RA_HW_NAT_PPTP_L2TP
	tristate "RA_HW_NAT_PPTP_L2TP"
	help
	  This driver supports RA_HW_NAT_PPTP_L2TP
	  
config NET_MEDIATEK_HW_QOS
	bool "Mediatek HW QoS support"
	depends on NET_MEDIATEK_HNAT
	default n

endif #NET_VENDOR_MEDIATEK_SDK
```

## target/linux/ramips/files/drivers/net/ethernet/mtk/Kconfig
```kconfig
# SPDX-License-Identifier: GPL-2.0-only
config NET_VENDOR_RAW_MEDIATEK
	bool "MediaTek ethernet driver"
	depends on ARCH_MEDIATEK || SOC_MT7621 || SOC_MT7620
	help
	  If you have a Mediatek SoC with ethernet, say Y.

if NET_VENDOR_RAW_MEDIATEK

config NET_MEDIATEK_SOC_GE
	tristate "MediaTek SoC Gigabit Ethernet support"
	select PHYLINK
	help
	  This driver supports the gigabit ethernet MACs in the
	  MediaTek SoC family.

config MEDIATEK_NETSYS_V2
	tristate "MediaTek Ethernet NETSYS V2 support"
	 depends on ARCH_MEDIATEK && NET_MEDIATEK_SOC_GE
	help
	  This options enable MTK Ethernet NETSYS V2 support

config NET_MEDIATEK_HNAT
	tristate "MediaTek HW NAT support"
	depends on NET_MEDIATEK_SOC_GE && NF_CONNTRACK && IP_NF_NAT
	help
	  This driver supports the hardward Network Address Translation
	  in the MediaTek MT2701/MT7622/MT7629/MT7621 chipset family.

endif #NET_VENDOR_RAW_MEDIATEK
```

## target/linux/ramips/files/drivers/net/ethernet/ralink/Kconfig
```kconfig
config NET_VENDOR_RALINK
	tristate "Ralink ethernet driver"
	depends on RALINK
	help
	  This driver supports the ethernet mac inside Ralink WiSoCs

config NET_RALINK_SOC
	def_tristate NET_VENDOR_RALINK

if NET_RALINK_SOC
choice
	prompt "MAC type"

config NET_RALINK_RT2880
	bool "RT2882"
	depends on MIPS && SOC_RT288X

config NET_RALINK_RT3050
	bool "RT3050/MT7628"
	depends on MIPS && (SOC_RT305X || SOC_MT7620)

config NET_RALINK_RT3883
	bool "RT3883"
	depends on MIPS && SOC_RT3883

config NET_RALINK_MT7620
	bool "MT7620"
	depends on MIPS && SOC_MT7620

endchoice

config NET_RALINK_HW_QOS
	def_bool NET_RALINK_SOC
	depends on NET_RALINK_MT7623

config NET_RALINK_MDIO
	def_bool NET_RALINK_SOC
	depends on (NET_RALINK_RT2880 || NET_RALINK_RT3883 || NET_RALINK_MT7620)
	select PHYLIB

config NET_RALINK_MDIO_RT2880
	def_bool NET_RALINK_SOC
	depends on (NET_RALINK_RT2880 || NET_RALINK_RT3883)
	select NET_RALINK_MDIO

config NET_RALINK_MDIO_MT7620
	def_bool NET_RALINK_SOC
	depends on NET_RALINK_MT7620
	select NET_RALINK_MDIO

config NET_RALINK_ESW_RT3050
	def_tristate NET_RALINK_SOC
	depends on NET_RALINK_RT3050

config NET_RALINK_GSW_MT7620
	def_tristate NET_RALINK_SOC
	depends on NET_RALINK_MT7620
endif
```

## target/linux/ramips/files/sound/soc/ralink/Kconfig
```kconfig
config SND_RALINK_SOC_I2S
	depends on RALINK && SND_SOC && !SOC_RT288X
	select SND_SOC_GENERIC_DMAENGINE_PCM
	select REGMAP_MMIO
	tristate "SoC Audio (I2S protocol) for Ralink SoC"
	help
	  Say Y if you want to use I2S protocol and I2S codec on Ralink/MediaTek
	  based boards.
```

## target/linux/realtek/files-5.10/drivers/net/dsa/rtl83xx/Kconfig
```kconfig
# SPDX-License-Identifier: GPL-2.0-only
config NET_DSA_RTL83XX
	tristate "Realtek RTL838x/RTL839x switch support"
	depends on RTL83XX
	select NET_DSA_TAG_TRAILER
	help
	  This driver adds support for Realtek RTL83xx series switching.
```

## target/linux/realtek/files-5.4/drivers/net/dsa/rtl83xx/Kconfig
```kconfig
# SPDX-License-Identifier: GPL-2.0-only
config NET_DSA_RTL83XX
	tristate "Realtek RTL838x/RTL839x switch support"
	depends on RTL838X
	select NET_DSA_TAG_TRAILER
	---help---
	  This driver adds support for Realtek RTL83xx series switching.
```

## target/linux/realtek/files-6.12/Documentation/devicetree/bindings/i2c/i2c-gpio-shared.yaml
```yaml
# SPDX-License-Identifier: GPL-2.0
%YAML 1.2
---
$id: http://devicetree.org/schemas/i2c/i2c-gpio-shared.yaml#
$schema: http://devicetree.org/meta-schemas/core.yaml#

title: mulitple GPIO bitbanged I2C busses with shared SCL

maintainers:
  - Markus Stockhausen <markus.stockhausen@gmx.de>

allOf:
  - $ref: /schemas/i2c/i2c-controller.yaml#

properties:
  compatible:
    items:
      - const: i2c-gpio-shared

  scl-gpios:
    description:
      gpio used for the shared scl signal, this should be flagged as
      active high using open drain with (GPIO_ACTIVE_HIGH|GPIO_OPEN_DRAIN)
      from <dt-bindings/gpio/gpio.h> since the signal is by definition
      open drain.
    maxItems: 1

examples:
  - |
    #include <dt-bindings/gpio/gpio.h>

    i2c-gpio-shared {
      compatible = "i2c-gpio-shared";
      scl-gpios = <&gpio1 31 (GPIO_ACTIVE_HIGH | GPIO_OPEN_DRAIN)>;
      #address-cells = <1>;
      #size-cells = <0>;

      i2c0: i2c@0 {
        sda-gpios = <&gpio1 6 (GPIO_ACTIVE_HIGH | GPIO_OPEN_DRAIN)>;
        i2c-gpio,delay-us = <2>;
      };

      i2c1: i2c@1 {
        sda-gpios = <&gpio1 7 (GPIO_ACTIVE_HIGH | GPIO_OPEN_DRAIN)>;
        i2c-gpio,delay-us = <2>;
      };
    };

required:
  - compatible
  - scl-gpios
```
