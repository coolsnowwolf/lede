## target/linux/phytium/files-5.10/Documentation/devicetree/bindings/spi/spi-phytium.txt
```
Phytium SPI controller

Required properties:
- compatible: should be "phytium,spi"
- #address-cells: see spi-bus.txt
- #size-cells: see spi-bus.txt
- reg: address and length of the spi master registers
- interrupts: should contain one interrupt
- clocks: spi clock phandle
- num-cs: see spi-bus.txt

Optional properties:
- cs-gpios: see spi-bus.txt

Example:


spi0: spi@2800c000 {
	compatible = "phytium,spi";
	interrupts = <GIC_SPI 18 IRQ_TYPE_LEVEL_HIGH>;
	reg = <0x0 0x2800c000 0x0 0x1000>;
	clocks = <&sysclk_48mhz>;
	num-cs = <4>;
};
```

## target/linux/phytium/files-5.10/drivers/gpu/drm/phytium/Kconfig
```kconfig
config DRM_PHYTIUM
	tristate "DRM Support for Phytium Graphics Card"
	depends on DRM
	select DRM_KMS_HELPER
	help
	  Choose this option if you have a phytium graphics card.
	  This driver provides kernel mode setting and buffer management to userspace.
```

## target/linux/phytium/files-5.10/drivers/net/can/phytium/Kconfig
```kconfig
# SPDX-License-Identifier: GPL-2.0-only
menuconfig CAN_PHYTIUM
	tristate "Phytium CAN support"
	help
	  Say Y here if you want support for Phytium CAN controller framework.
	  This is common support for devices that embed the Phytium CAN IP.

	  To compile this driver as a module, choose M here: the module will
	  be called phytium_can.

if CAN_PHYTIUM

config CAN_PHYTIUM_PLATFORM
	tristate "Phytium CAN support for io-mapped devices"
	depends on HAS_IOMEM
	help
	  Say Y here is you want to support for IO Mapped Phytium CAN controller.
	  This support is for devices that have the Phytium CAN controller IP
	  embedded into the device and the IP is IO Mapped to the processor.

	  To compile this driver as a module, choose M here: the module will
	  be called phytium_can_platform.

config CAN_PHYTIUM_PCI
	tristate "Phytium CAN support for PCI devices"
	depends on PCI
	help
	  Say Y here is you want to support for Phytium CAN controller connected
	  to the PCI bus. This support is for devices that have the Phytium CAN
	  controller IP embedded into a PCI device.

	  To compile this driver as a module, choose M here: the module will
	  be called phytium_can_pci.
endif
```

## target/linux/phytium/files-5.10/drivers/usb/phytium/Kconfig
```kconfig
config USB_PHYTIUM
	tristate "PHYTIUM USB Support"
	depends on USB && USB_GADGET
	help
	  Say Y or M here if your system has a OTG USB Controller based on PHYTIUM SOC.

	  If you choose to build this driver is a dynamically linked modules, the module will
          be called phytium-usb.ko
```

## target/linux/phytium/files-5.10/sound/soc/phytium/Kconfig
```kconfig
config SND_SOC_PHYTIUM_I2S
	tristate "Phytium I2S Device Driver"
	help
	 Say Y or M if you want to add support for I2S driver for
	 Phytium I2S device . The device supports 2 channels each
	 for play and record.

config SND_PMDK_ES8388
	tristate "Phytium machine support with ES8388"
	depends on I2C && SND_SOC_PHYTIUM_I2S
	select SND_SOC_ES8388
	help
	 Say Y if you want to add Phytium machine support for
	 ES8388 codecs.

config SND_PMDK_ES8336
	tristate "Phytium machine support with ES8336"
	depends on I2C && SND_SOC_PHYTIUM_I2S
	select SND_SOC_ES8336
	help
	 Say Y if you want to add Phytium machine support for
	 ES8336 codecs.

config SND_PMDK_DP
	tristate "Phytium machine support with DP"
	depends on I2C && SND_SOC_PHYTIUM_I2S
	select SND_SOC_HDMI_CODEC
	help
	 Say Y if you want to add Phytium machine support for
	 Displayport.
```

## target/linux/phytium/files-6.18/Documentation/devicetree/bindings/edac/phytium-pe220x-edac.txt
```
* Phytium Pe220x SoC EDAC node

EDAC node is defined to describe on-chip error detection and correction.
The follow error types are supported:

  SoC			- SoC IP's such as Ethernet, SATA, and etc

The following section describes the EDAC DT node binding.

Required properties:
- compatible: Shall be "phytium,pe220x-edac".
- reg: Shall be the Pe220x RAS resource.
- interrupts: Interrupt-specifier for RAS error IRQ(s).

Example:
	edac: edac@32b28000 {
		compatible = "phytium,pe220x-edac";
		reg = <0x0 0x32b28000 0x0 0x1000>,
			<0x0 0x31400000 0x0 0x1000>,
			<0x0 0x31401000 0x0 0x1000>;
		interrupts = <GIC_SPI 0 IRQ_TYPE_LEVEL_HIGH>,
				<GIC_SPI 1 IRQ_TYPE_LEVEL_HIGH>,
	};
```

## target/linux/phytium/files-6.18/Documentation/devicetree/bindings/hwmon/tacho-phytium.txt
```
Phytium Fan Tacho and capture counter controller device driver

The controller can support one input signal. The function of controller is to
measure the speed of fan and the edge number of input signal. The function
can be selected by devicetree setting. The edging mode and anti-jitter level
can also setted in devicetree.

Required properties for tacho node:
- #address-cells : should be 1.

- #size-cells : should be 1.

- reg : address and length of the register set for the device.

- compatible : should be "phytium,tacho"

- clocks : phandle to clock provider with the clock number in the second cell

Optional properties for tacho node:

- tacho : set the controller work as fan tachometer, which is a default option.

- capture : set the controller work as capture counter.

-------------------------------------------------------------------------------

- up : set the input edging mode as ascending, which is a default option.

- down : set the input edging mode as descending.

- double : set the input edging mode as doule-edging.

-------------------------------------------------------------------------------

- debounce-level : set the debounce-levle, which can be 0, 1, 2 and 3.

Examples:

tacho: tacho@28054000 {
	#address-cells = <1>;
	#size-cells = <1>;
	reg = <0x0 0x28054000 0x0 0x1000>;
	compatible = "phytium,tacho";
	clocks = <&sysclk>;
	tacho;
	up;
	debounce-level = <2>;
};
```

## target/linux/phytium/files-6.18/Documentation/devicetree/bindings/iio/adc/phytium-adc.txt
```
Phytium ADC

This device is a 10-bit converter for 8 voltage channels. All inputs are
single ended.

Required properties:
- compatible: Should be "phytium,adc"
- reg: memory window mapping address and length
- interrupts: Interrupt for the ADC control interface.
- clocks: Input clock used to derive the sample clock.
- #address-cells: Should be <1> (settings for the subnodes).
- #size-cells: Should be <0> (settings for the subnodes).

Required subnodes:

The ADC channels are configured as subnodes of the ADC.

Required channel node properties:

- reg: should contain the hardware channel number.

Examples:

	adc0: adc@2807b000 {
		compatible = "phytium,adc";
		reg = <0x0 0x2807b000 0x0 0x1000>;
		interrupts = <GIC_SPI 232 IRQ_TYPE_LEVEL_HIGH>;
		clocks = <&sysclk_48mhz>;

		#address-cells = <1>;
		#size-cells = <0>;

		channel@0 {
			reg = <0>;
		};
		channel@1 {
			reg = <1>;
		};
		channel@2 {
			reg = <2>;
		};
		channel@3 {
			reg = <3>;
		};
		channel@4 {
			reg = <4>;
		};
		channel@5 {
			reg = <5>;
		};
		channel@6 {
			reg = <6>;
		};
		channel@7 {
			reg = <7>;
		};
	};
```

## target/linux/phytium/files-6.18/Documentation/devicetree/bindings/interrupt-controller/phytium,ixic.txt
```
Phytium INTx interrupt controller (IXIC)

This is a pseudo interrupt controller to handle PCI legacy interrupt on
some Phytium SoCs, which sits between the PCI INTx devices and the GIC
and forwards the 4 INTx input signals to 4 adjacent GICv3 SPIs.

Required properties:

- compatible		: "phytium,ixic"
- reg			: Specifies two regions of the register set, which
			  are called 'ctr' and 'hpb'.
- interrupt-controller	: Identifies the node as an interrupt controller.
- #interrupt-cells	: Specifies the number of cells needed to encode an
			  interrupt source. The value must be 3.
- intx-spi-base		: The SPI number of the first SPI of the 4 adjacent
			  ones the IXIC forwards its interrupts to.

Example:
	ixic: interrupt-controller@29000000 {
		compatible = "phytium,ixic";
		reg-names = "ctr", "hpb";
		reg = <0x0 0x29000000 0x0 0x00060000>,
		      <0x0 0x29100000 0x0 0x00002000>;
		interrupt-controller;
		interrupt-parent = <&gic>;
		#interrupt-cells = <3>;
		intx-spi-base = <28>;
	};
```

## target/linux/phytium/files-6.18/Documentation/devicetree/bindings/mailbox/phytium,mbox.yaml
```yaml
# SPDX-License-Identifier: (GPL-2.0-only OR BSD-2-Clause)
%YAML 1.2
---
$id: http://devicetree.org/schemas/mailbox/phytium,mbox.yaml#
$schema: http://devicetree.org/meta-schemas/core.yaml#

title: Phytium Mailbox Driver

maintainers:
  - Chen Baozi <chenbaozi@phytium.com.cn>

description: |
  The Phytium mailbox controller that has a channel/link to communicate
  with the remote end. A link raises interrupt for any received data. However,
  there is no specified way of knowing if the sent data has been read by the
  remote. This driver assumes the sender polls STAT register and the remote
  clears it after having read the data.

properties:
  compatible:
    const: phytium,mbox

  reg:
    maxItems: 1

  interrupts:
    maxItems: 1

  '#mbox-cells':
    const: 1
    description: the index of the channel needed

required:
  - compatible
  - reg
  - interrupts
  - '#mbox-cells'

additionalProperties: false

examples:
  - |
    mbox: mailbox@2a000000 {
      compatible = "phytium,mbox";
      reg = <0x0 0x2a000000 0x0 0x1000>;
      #mbox-cells = <1>;
      interrupts = <0 48 4>;
    };
```

## target/linux/phytium/files-6.18/Documentation/devicetree/bindings/net/phytium,gmac.yaml
```yaml
# SPDX-License-Identifier: (GPL-2.0-only OR BSD-2-Clause)
%YAML 1.2
---
$id: "http://devicetree.org/schemas/net/phytium,gmac.yaml#"
$schema: "http://devicetree.org/meta-schemas/core.yaml#"

title: Phytium 10/100/1000 Ethernet driver (GMAC)

maintainers:
  - Chen Baozi <chenbaozi@phytium.com.cn>

# We need a select here so we don't match all nodes with 'snps,dwmac'
select:
  properties:
    compatible:
      contains:
        enum:
          - phytium,gmac
  required:
    - compatible

allOf:
  - $ref: "snps,dwmac.yaml#"

properties:
  compatible:
      - items:
          - enum:
              - phytium,gmac

  clock-frequency: true

required:
  - compatible
  - clock-frequency

unevaluatedProperties: false

examples:
  - |
    gmac0: eth@2820c000 {
        compatible = "phytium,gmac";
        reg = <0x0 0x2820c000 0x0 0x2000>;
        interrupts = <GIC_SPI 49 IRQ_TYPE_LEVEL_HIGH>;
        clock-frequency = <250000000>;

        snps,pbl = <16>;
        snps,fixed-burst;
        snps,multicast-filter-bins = <64>;
        snps,perfect-filter-entries = <128>;
        tx-fifo-depth = <4096>;
        rx-fifo-depth = <4096>;
        max-frame-size = <9000>;
    };
```

## target/linux/phytium/files-6.18/Documentation/devicetree/bindings/pwm/pwm-phytium.txt
```
Phytium PWM controller

Required properties:
- compatible: should be "phytium,pwm"
- reg: physical base address and length of the controller's registers
- interrupts:  interrupt for the pwm controller
- clocks : clock specifiers for both ipg and per clocks.
- phytium,db: One or two <cntmod dutymod div updbcly dbpolarity> to describe dead-band configurations.
              "cntmod" indicates the counter mode (0 for modulo, 1 for up-and-down).
              "dutymod" indicdates which duty to compare with (0 for PMW_CCR, 1 for FIFO).
              "div" selects the clock divider value, from 0 to 1023.
              "updbcly" selects the rising edge delay cycles.
              "dbpolarity" selects the polarity for dead-band.

Example:

pwm0: pwm@2804a000 {
	compatible = "phytium,pwm";
	reg= <0x0 0x2804a000 0x0 0x1000>;
	interrupts = <GIC_SPI 173 IRQ_TYPE_LEVEL_HIGH>;
	clocks = <&sysclk_48mhz>;
	phytium,db = <0 0 0 1000 0>;
};
```

## target/linux/phytium/files-6.18/Documentation/devicetree/bindings/w1/phytium-w1.txt
```
* Phytium 1-wire bus master controller

Required properties:
- compatible : should be "phytium,w1"
- reg : Address and length of the register set for the device
- interrupts : interrupt line.

Example:

  onewire0: onewire@2803f000 {
	compatible = "phytium,w1";
	reg = <0x0 0x2803f000 0x0 0x1000>;
	interrupts = <GIC_SPI 166 IRQ_TYPE_LEVEL_HIGH>;
  };
```
