// SPDX-License-Identifier: (GPL-2.0 OR MIT)
/*
 * Copyright (C) 2022 MediaTek Inc.
 * Author: Sam.Shih <sam.shih@mediatek.com>
 */

/dts-v1/;
/plugin/;

/ {
	compatible = "mediatek,mt7988a-rfb", "mediatek,mt7988a";

	fragment@0 {
		target = <&gmac1>;
		__overlay__ {
			phy-mode = "internal";
			phy-connection-type = "internal";
			phy = <&int_2p5g_phy>;
			status = "okay";
		};
	};

	fragment@1 {
		target = <&int_2p5g_phy>;
		__overlay__ {
			pinctrl-names = "i2p5gbe-led";
			pinctrl-0 = <&i2p5gbe_led0_pins>;
		};
	};
};
