// SPDX-License-Identifier: (GPL-2.0 OR MIT)
/*
 * Copyright (C) 2023
 * Author: Daniel Golle <daniel@makrotopia.org>
 */

/dts-v1/;
/plugin/;

/ {
	compatible = "bananapi,bpi-r4", "mediatek,mt7988a";

	fragment@0 {
		target = <&pcf8563>;
		__overlay__ {
			status = "okay";
		};
	};
};
