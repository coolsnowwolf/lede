// SPDX-License-Identifier: GPL-2.0-or-later OR MIT

/dts-v1/;
#include "mt7986a-bananapi-bpi-r3-mini.dts"

/ {
	model = "Bananapi BPI-R3 Mini (eMMC)";

	chosen {
		bootargs = "console=ttyS0,115200n8 root=PARTLABEL=rootfs rootwait";
	};
};
