// SPDX-License-Identifier: (GPL-2.0-or-later OR MIT)
/*
 * Copyright 2018 Kristian Evensen <kristian.evensen@gmail.com>
 */

/dts-v1/;
#include "mt7623a-unielec-u7623-02.dtsi"

/ {
	model = "UniElec U7623-02 eMMC";
	compatible = "unielec,u7623-02", "mediatek,mt7623";
};
