// SPDX-License-Identifier: (GPL-2.0 OR MIT)

/dts-v1/;

#include "mt7986a-zyxel-ex5700-common.dtsi"

/ {
	model = "ZyXEL EX5700 NO WIFI";
	compatible = "zyxel,ex5700-no-wifi", "mediatek,mt7986a";
};
