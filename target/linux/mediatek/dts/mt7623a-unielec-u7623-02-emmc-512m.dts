// SPDX-License-Identifier: (GPL-2.0-or-later OR MIT)
/*
 * Copyright 2018 Kristian Evensen <kristian.evensen@gmail.com>
 */

/dts-v1/;
#include "mt7623a-unielec-u7623-02.dtsi"

/ {
	model = "UniElec U7623-02 eMMC (legacy loader, 512M RAM)";
	compatible = "unielec,u7623-02-emmc-512m", "unielec,u7623-02", "mediatek,mt7623";

	chosen {
		bootargs = "earlycon=uart8250,mmio32,0x11004000 console=ttyS0,115200 blkdevparts=mmcblk0:3M@6M(recovery),256M@9M(root) rootfstype=squashfs root=/dev/mmcblk0p2";
	};

	memory@80000000 {
		device_type = "memory";
		reg = <0 0x80000000 0 0x20000000>;
	};
};
