// SPDX-License-Identifier: (GPL-2.0 OR MIT)
/*
 * Copyright (C) 2025 MediaTek Inc.
 * Author: Sam.Shih <sam.shih@mediatek.com>
 */

/dts-v1/;
/plugin/;

#include <dt-bindings/gpio/gpio.h>

/ {
	compatible = "bananapi,bpi-r4-lite",
		     "mediatek,mt7987a", "mediatek,mt7987";
};

/ {
	fragment@0 {
		target-path = "/soc/pinctrl@1001f000";
		__overlay__ {
			pcie_sel: aw35710qnr_sel {
				gpio-hog;
				gpios = <11 GPIO_ACTIVE_HIGH>;
				output-high;
			};
		};
	};

	fragment@1 {
		target-path = "/soc/pcie@11290000";
		__overlay__ {
			status = "disabled";
		};
	};
};
