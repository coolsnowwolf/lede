// SPDX-License-Identifier: GPL-2.0-or-later OR MIT

/dts-v1/;
/plugin/;

/ {
	compatible = "cmcc,rax3000me", "mediatek,mt7981";

	fragment@0 {
		target = <&usb_phy>;
		__overlay__ {
			status = "disabled";
		};
	};

	fragment@1 {
		target = <&xhci>;
		__overlay__ {
			status = "disabled";
		};
	};
};
