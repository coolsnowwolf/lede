// SPDX-License-Identifier: GPL-2.0-or-later OR MIT

/dts-v1/;
#include "mt7981b-cmcc-rax3000m.dts"

/ {
	model = "CMCC RAX3000Me";
	compatible = "cmcc,rax3000me", "mediatek,mt7981";
};

&usb_phy {
	status = "disabled";
};

&xhci {
	status = "disabled";
};
