OUTPUT_ARCH(mips)
ENTRY(entry)
SECTIONS
{
  /* Read-only sections, merged into text segment: */
  . = @LOADADDR@;
  .text      :
  {
    _ftext = . ;
    *(.text.entry)
    *(.text)
    lzma_start = .;
    kernel.o
    lzma_end = .;
    *(.rodata)
  } =0

  .reginfo : { *(.reginfo) }

  .bss       :
  {
   *(.bss)
  }
}
