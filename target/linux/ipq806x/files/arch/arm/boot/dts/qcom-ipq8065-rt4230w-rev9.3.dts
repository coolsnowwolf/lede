// SPDX-License-Identifier: GPL-2.0-or-later

#include "qcom-ipq8065-rt4230w.dtsi"
#include <dt-bindings/input/input.h>

/ {
	model = "Askey RT4230W REV9.3";
	compatible = "askey,rt4230w-rev9.3", "qcom,ipq8065", "qcom,ipq8064";
};

&ubi {
	reg = <0x2400000 0xdc00000>;
};
