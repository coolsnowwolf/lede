// SPDX-License-Identifier: GPL-2.0-or-later OR MIT
/dts-v1/;

#include "ar7241_tplink_tl-mr3x20.dtsi"

/ {
	compatible = "tplink,tl-mr3420-v1", "qca,ar7241";
	model = "TP-Link TL-MR3420 v1";

	ath9k-leds {
		compatible = "gpio-leds";

		wlan {
			label = "tp-link:green:wlan";
			gpios = <&ath9k 0 GPIO_ACTIVE_LOW>;
			default-state = "off";
			linux,default-trigger = "phy0tpt";
		};
	};
};
