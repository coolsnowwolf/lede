// SPDX-License-Identifier: GPL-2.0-or-later OR MIT
/dts-v1/;

#include "qca9558_tplink_tl-wr1043nd.dtsi"

/ {
	compatible = "tplink,tl-wr1043nd-v2", "qca,qca9557";
	model = "TP-Link TL-WR1043ND v2";
};
