// SPDX-License-Identifier: GPL-2.0-or-later OR MIT
/dts-v1/;

#include "ar7241_ubnt_xm.dtsi"

/ {
	compatible = "ubnt,bullet-m", "qca,ar7241";
	model = "Ubiquiti Bullet M";
};

&eth1 {
	compatible = "syscon", "simple-mfd";
};
