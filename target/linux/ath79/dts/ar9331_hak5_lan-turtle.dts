// SPDX-License-Identifier: GPL-2.0-or-later OR MIT

#include "ar9331_hak5_lan-turtle.dtsi"

/ {
	model = "Hak5 LAN Turtle";
	compatible = "hak5,lan-turtle", "qca,ar9331";

	aliases {
		led-boot = &led_system;
		led-failsafe = &led_system;
		led-upgrade = &led_system;
	};

	leds {
		compatible = "gpio-leds";

		pinctrl-names = "default";
		pinctrl-0 = <&switch_led_disable_pins>;

		led_system: system {
			label = "orange:system";
			gpios = <&gpio 13 GPIO_ACTIVE_LOW>;
		};
	};
};
