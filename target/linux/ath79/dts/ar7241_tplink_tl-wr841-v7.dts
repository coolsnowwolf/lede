// SPDX-License-Identifier: GPL-2.0-or-later OR MIT
/dts-v1/;

#include "ar7241_tplink.dtsi"

/ {
	compatible = "tplink,tl-wr841-v7", "qca,ar7241";
	model = "TP-Link TL-WR841N/ND v7";

	ath9k-leds {
		compatible = "gpio-leds";

		wlan {
			label = "tp-link:green:wlan";
			gpios = <&ath9k 0 GPIO_ACTIVE_LOW>;
			linux,default-trigger = "phy0tpt";
		};
	};
};
