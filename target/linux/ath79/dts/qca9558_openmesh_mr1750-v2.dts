// SPDX-License-Identifier: GPL-2.0-or-later OR MIT

#include "qca9558_openmesh_mr.dtsi"

/ {
	compatible = "openmesh,mr1750-v2", "qca,qca9558";
	model = "OpenMesh MR1750 v2";
};

&led_wifi2g {
	linux,default-trigger = "phy1tpt";
};

&led_wifi5g {
	linux,default-trigger = "phy0tpt";
};
