// SPDX-License-Identifier: GPL-2.0-or-later OR MIT

#include "qca9533_tplink_tl-wr841.dtsi"

/ {
	compatible = "tplink,tl-wr841-v10", "qca,qca9533";
	model = "TP-Link TL-WR841N/ND v10";

	aliases {
		led-boot = &led_qss;
		led-failsafe = &led_qss;
		led-running = &led_qss;
		led-upgrade = &led_qss;
	};
};
