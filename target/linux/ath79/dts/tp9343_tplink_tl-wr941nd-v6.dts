// SPDX-License-Identifier: GPL-2.0-or-later OR MIT
/dts-v1/;

#include "tp9343_tplink_tl-wr940n-v3.dtsi"

/ {
	compatible = "tplink,tl-wr941nd-v6", "qca,tp9343";
	model = "TP-Link TL-WR941ND v6";
};
