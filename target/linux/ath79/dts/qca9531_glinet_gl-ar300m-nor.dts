#include "qca9531_glinet_gl-ar300m.dtsi"

/ {
	compatible = "glinet,gl-ar300m-nor", "qca,qca9531";
	model = "GL.iNet GL-AR300M (NOR)";
};

&nor_firmware {
	compatible = "denx,uimage";
	label = "firmware";
};
