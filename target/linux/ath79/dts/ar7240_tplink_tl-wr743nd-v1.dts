// SPDX-License-Identifier: GPL-2.0-or-later OR MIT
/dts-v1/;

#include "ar7240_tplink_tl-wr74xn-v1.dtsi"

/ {
	model = "TP-Link TL-WR743ND v1";
	compatible = "tplink,tl-wr743nd-v1", "qca,ar7240";
};
