// SPDX-License-Identifier: GPL-2.0-or-later OR MIT

#include "qca953x_tplink_tl-wr810n.dtsi"

/ {
	compatible = "tplink,tl-wr810n-v1", "qca,qca9531";
	model = "TP-Link TL-WR810N v1";

	reg_usb_vbus: reg_usb_vbus {
		compatible = "regulator-fixed";
		regulator-name = "usb_vbus";
		regulator-min-microvolt = <5000000>;
		regulator-max-microvolt = <5000000>;
		gpio = <&gpio 11 GPIO_ACTIVE_HIGH>;
		enable-active-high;
		regulator-always-on;
	};
};

&usb0 {
	status = "okay";

	vbus-supply = <&reg_usb_vbus>;
};

&usb_phy {
	status = "okay";
};
