// SPDX-License-Identifier: GPL-2.0-or-later OR MIT
/dts-v1/;

#include "ar7241.dtsi"
#include "ar724x_ubnt_xm.dtsi"
#include "ar724x_ubnt_xm_outdoor.dtsi"

/ {
	compatible = "ubnt,powerbridge-m", "ubnt,xm", "qca,ar7241";
	model = "Ubiquiti PowerBridge M (XM)";
};

&eth1 {
	compatible = "syscon", "simple-mfd";
};
