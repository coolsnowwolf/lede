// SPDX-License-Identifier: GPL-2.0-or-later OR MIT

#include "qca9563_glinet_gl-ar750s.dtsi"

/ {
	compatible = "glinet,gl-ar750s-nor", "qca,qca9563";
	model = "GL.iNet GL-AR750S (NOR)";
};

&nor_partitions {
	partition@60000 {
		compatible = "denx,uimage";
		label = "firmware";
		reg = <0x060000 0xfa0000>;
	};
};
