// SPDX-License-Identifier: GPL-2.0-or-later OR MIT

#include "qca9533_tplink_cpexxx.dtsi"

&leds {
	lan {
		label = "green:lan";
		gpios = <&gpio 11 GPIO_ACTIVE_LOW>;
	};
};

&eth1 {
	compatible = "syscon", "simple-mfd";
};
