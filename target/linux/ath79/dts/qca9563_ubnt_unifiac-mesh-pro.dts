// SPDX-License-Identifier: GPL-2.0-or-later OR MIT
/dts-v1/;

#include "qca9563_ubnt_unifiac-pro.dtsi"

/ {
	compatible = "ubnt,unifiac-mesh-pro", "qca,qca9563";
	model = "Ubiquiti UniFi AC Mesh Pro";
};
