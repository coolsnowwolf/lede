// SPDX-License-Identifier: GPL-2.0-or-later OR MIT

#include "qca9558_qxwlan_e558.dtsi"

/ {
	model = "Qxwlan E558 v2 8M";
	compatible = "qxwlan,e558-v2-8m", "qca,qca9558";
};

&partitions {
	partition@70000 {
		compatible = "denx,uimage";
		label = "firmware";
		reg = <0x070000 0x790000>;
	};
};
