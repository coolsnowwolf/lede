// SPDX-License-Identifier: GPL-2.0-or-later OR MIT

#include "qca9563_dlink_dir-842-c.dtsi"

/ {
	compatible = "dlink,dir-842-c2", "qca,qca9563";
	model = "D-Link DIR-842 C2";
};

&usb_phy0 {
	status = "okay";
};

&usb0 {
	status = "okay";
};
