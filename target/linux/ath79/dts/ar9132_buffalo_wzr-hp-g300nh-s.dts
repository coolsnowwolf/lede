// SPDX-License-Identifier: GPL-2.0-or-later OR MIT

#include "ar9132_buffalo_wzr-hp-g300nh.dtsi"

/ {
	compatible = "buffalo,wzr-hp-g300nh-s", "qca,ar9132";
	model = "Buffalo WZR-HP-G300NH (rtl8366s)";
};

&switch {
	status = "okay";

	compatible = "realtek,rtl8366s";
};

&eth0 {
	status = "okay";

	pll-data = <0x1e000100 0x13000a44 0x00441099>;
};

&eth1 {
	status = "okay";

	pll-data = <0x1e000100 0x13000a44 0x00441099>;
};
