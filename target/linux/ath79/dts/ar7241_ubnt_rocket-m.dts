// SPDX-License-Identifier: GPL-2.0-or-later OR MIT
/dts-v1/;

#include "ar7241.dtsi"
#include "ar724x_ubnt_xm.dtsi"
#include "ar724x_ubnt_xm_outdoor.dtsi"

/ {
	compatible = "ubnt,rocket-m", "ubnt,xm", "qca,ar7241";
	model = "Ubiquiti Rocket M";
};

&eth1 {
	compatible = "syscon", "simple-mfd";
};

&usb_phy {
	status = "okay";
};

&usb {
	status = "okay";
};
