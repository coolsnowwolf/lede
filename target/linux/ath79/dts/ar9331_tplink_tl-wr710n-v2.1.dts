// SPDX-License-Identifier: GPL-2.0-or-later OR MIT
/dts-v1/;

#include "ar9331_tplink_tl-wr710n-8m.dtsi"

/ {
	model = "TP-Link TL-WR710N v2.1";
	compatible = "tplink,tl-wr710n-v2.1", "qca,ar9331";
};
