// SPDX-License-Identifier: GPL-2.0-or-later OR MIT
/dts-v1/;

#include "ar7240_tplink_tl-wr74xn-v1.dtsi"

/ {
	model = "TP-Link TL-WR841N/ND v5/v6";
	compatible = "tplink,tl-wr841-v5", "qca,ar7240";
};
