// SPDX-License-Identifier: GPL-2.0-or-later OR MIT

#include "ar7241.dtsi"
#include "ar724x_ubnt_xm.dtsi"
#include "ar724x_ubnt_xm_outdoor.dtsi"

/ {
	compatible = "ubnt,bullet-m-ar7241", "ubnt,xm", "qca,ar7241";
	model = "Ubiquiti Bullet M (XM AR7241)";
};

&eth1 {
	compatible = "syscon", "simple-mfd";
};
