// SPDX-License-Identifier: GPL-2.0-or-later OR MIT
/dts-v1/;

#include "ar7241_ubnt-xm.dtsi"

/ {
	compatible = "ubnt,rm", "qca,ar7241";
	model = "Ubiquiti Rocket M";
};

&eth1 {
	compatible = "syscon";
};

&usb_phy {
	status = "okay";
};

&usb {
	status = "okay";
};
