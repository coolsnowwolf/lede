// SPDX-License-Identifier: GPL-2.0-or-later OR MIT
/dts-v1/;

#include "qca9533_tplink_tl-wr841-v11.dtsi"

/ {
	compatible = "tplink,tl-wr841-v12", "qca,qca9533";
	model = "TP-Link TL-WR841N/ND v12";
};
