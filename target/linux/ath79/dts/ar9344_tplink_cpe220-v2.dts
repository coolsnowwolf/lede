// SPDX-License-Identifier: GPL-2.0-or-later OR MIT
/dts-v1/;

#include "ar9344_tplink_cpe_2port.dtsi"

/ {
	compatible = "tplink,cpe220-v2", "qca,ar9344";
	model = "TP-Link CPE220 v2";
};

&led_link4 {
	gpios = <&gpio 16 GPIO_ACTIVE_LOW>;
};
