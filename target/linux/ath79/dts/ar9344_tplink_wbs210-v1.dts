// SPDX-License-Identifier: GPL-2.0-or-later OR MIT

#include "ar9344_tplink_cpe_2port.dtsi"

/ {
	compatible = "tplink,wbs210-v1", "qca,ar9344";
	model = "TP-Link WBS210 v1";
};

&led_link4 {
	gpios = <&gpio 2 GPIO_ACTIVE_LOW>;
};
