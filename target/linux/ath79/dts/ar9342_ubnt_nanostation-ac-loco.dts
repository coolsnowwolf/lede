// SPDX-License-Identifier: GPL-2.0-only

#include "ar9342_ubnt_wa_1port.dtsi"

/ {
	compatible = "ubnt,nanostation-ac-loco", "ubnt,wa", "qca,ar9342";
	model = "Ubiquiti Nanostation AC loco (WA)";
};
