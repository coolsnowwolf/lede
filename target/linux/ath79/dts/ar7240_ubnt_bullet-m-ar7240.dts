// SPDX-License-Identifier: GPL-2.0-or-later OR MIT
/dts-v1/;

#include "ar7240.dtsi"
#include "ar724x_ubnt_xm.dtsi"
#include "ar724x_ubnt_xm_outdoor.dtsi"

/ {
	compatible = "ubnt,bullet-m-ar7240", "ubnt,xm", "qca,ar7240";
	model = "Ubiquiti Bullet M (XM AR7240)";
};

&eth0 {
	fixed-link {
		speed = <100>;
		full-duplex;
	};
};

&eth1 {
	compatible = "syscon", "simple-mfd";
};
