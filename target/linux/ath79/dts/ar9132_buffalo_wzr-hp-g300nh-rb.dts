// SPDX-License-Identifier: GPL-2.0-or-later OR MIT

#include "ar9132_buffalo_wzr-hp-g300nh.dtsi"

/ {
	compatible = "buffalo,wzr-hp-g300nh-rb", "qca,ar9132";
	model = "Buffalo WZR-HP-G300NH (rtl8366rb)";
};

&switch {
	status = "okay";

	compatible = "realtek,rtl8366rb";
};

&eth0 {
	status = "okay";

	pll-data = <0x1f000000 0x13000a44 0x00441099>;
};

&eth1 {
	status = "okay";

	pll-data = <0x100 0x13000a44 0x00441099>;
};
