// SPDX-License-Identifier: GPL-2.0-or-later OR MIT

#include "ar9344_mikrotik_routerboard-sxt-5n.dtsi"

/ {
	compatible = "mikrotik,routerboard-sxt-5nd-r2", "qca,ar9344";
	model = "MikroTik RouterBOARD SXT 5nD r2 (SXT Lite5)";
};
