// SPDX-License-Identifier: GPL-2.0-or-later OR MIT

#include "ar9331_alfa-network_ap121f.dtsi"

/ {
	model = "ALFA Network AP121F";
	compatible = "alfa-network,ap121f", "qca,ar9331";
};

&usb {
	dr_mode = "host";
};
