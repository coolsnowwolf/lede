// SPDX-License-Identifier: GPL-2.0-or-later OR MIT

#include "ar7241_tplink_tl-mr3x20.dtsi"

/ {
	compatible = "tplink,tl-mr3220-v1", "qca,ar7241";
	model = "TP-Link TL-MR3220 v1";

	ath9k-leds {
		compatible = "gpio-leds";

		wlan {
			label = "tp-link:green:wlan";
			gpios = <&ath9k 1 GPIO_ACTIVE_LOW>;
			linux,default-trigger = "phy0tpt";
		};
	};
};
