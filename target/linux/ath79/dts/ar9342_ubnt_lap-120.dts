// SPDX-License-Identifier: GPL-2.0-only

#include "ar9342_ubnt_wa_1port.dtsi"

/ {
	compatible = "ubnt,lap-120", "ubnt,wa", "qca,ar9342";
	model = "Ubiquiti LiteAP ac (LAP-120)";
};

&wmac {
	status = "disabled";
};
