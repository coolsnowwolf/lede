// SPDX-License-Identifier: GPL-2.0-or-later OR MIT
/dts-v1/;

#include "qca9533_mikrotik_routerboard-lhg-hb.dtsi"

/ {
	compatible = "mikrotik,routerboard-lhg-2nd", "qca,qca9533";
	model = "MikroTik RouterBOARD LHG 2nD";
};
