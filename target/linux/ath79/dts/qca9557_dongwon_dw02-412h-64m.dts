// SPDX-License-Identifier: GPL-2.0-or-later OR MIT

#include "qca9557_dongwon_dw02-412h.dtsi"

/ {
	model = "Dongwon T&I DW02-412H (64M)";
	compatible = "dongwon,dw02-412h-64m", "qca,qca9557";
};

&ubi {
	reg = <0x1800000 0x2800000>;
};
