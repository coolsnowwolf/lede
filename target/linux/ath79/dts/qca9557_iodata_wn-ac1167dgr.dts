// SPDX-License-Identifier: GPL-2.0-or-later OR MIT
/dts-v1/;

#include <dt-bindings/gpio/gpio.h>
#include <dt-bindings/input/input.h>

#include "qca9557_iodata_wn-ac-dgr.dtsi"

/ {
	compatible = "iodata,wn-ac1167dgr", "qca,qca9557";
	model = "I-O DATA WN-AC1167DGR";
};
