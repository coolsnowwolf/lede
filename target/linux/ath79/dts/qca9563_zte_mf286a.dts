// SPDX-License-Identifier: GPL-2.0-or-later OR MIT
// Copyright (c) 2021 Cezary Jackiewicz
// Copyright (c) 2021, 2022 Lech Perczak
#include "qca9563_zte_mf286ar.dtsi"

/ {
	model = "ZTE MF286A";
	compatible = "zte,mf286a", "qca,qca9563";
};
