// SPDX-License-Identifier: GPL-2.0-or-later OR MIT
/dts-v1/;

#include "ar7241_ubnt-xm.dtsi"

/ {
	compatible = "ubnt,xm", "qca,ar7241";
	model = "Ubiquiti Networks XM (rev 1.0) board";
};

&eth1 {
	compatible = "syscon";
};
