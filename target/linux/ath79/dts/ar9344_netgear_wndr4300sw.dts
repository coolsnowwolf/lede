// SPDX-License-Identifier: GPL-2.0-or-later OR MIT
/dts-v1/;

#include "ar9344_netgear_wndr.dtsi"
#include "ar9344_netgear_wndr_wan.dtsi"
#include "ar9344_netgear_wndr_usb.dtsi"

/ {
	compatible = "netgear,wndr4300sw", "qca,ar9344";
	model = "Netgear WNDR4300SW";
};
