// SPDX-License-Identifier: GPL-2.0-or-later OR MIT

/dts-v1/;

#include "qca9531_glinet_gl-ar300m.dtsi"

/ {
	compatible = "glinet,gl-ar300m-nand", "qca,qca9531";
	model = "GL.iNet GL-AR300M (NAND)";
};

&nand_kernel {
	label = "kernel";
};

&nand_ubi {
	label = "ubi";
};
