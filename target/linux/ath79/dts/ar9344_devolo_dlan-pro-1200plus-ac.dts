// SPDX-License-Identifier: GPL-2.0-or-later OR MIT

#include "ar9344_devolo_dlan_wifi.dtsi"

/ {
	model = "Devolo dLAN pro 1200+ WiFi ac";
	compatible = "devolo,dlan-pro-1200plus-ac", "qca,ar9344";
};
