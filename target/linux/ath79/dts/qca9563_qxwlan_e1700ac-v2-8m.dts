// SPDX-License-Identifier: GPL-2.0-or-later OR MIT

#include "qca9563_qxwlan_e1700ac.dtsi"

/ {
	model = "Qxwlan E1700AC v2 8M";
	compatible = "qxwlan,e1700ac-v2-8m", "qca,qca9563";
};

&partitions {
	partition@70000 {
		compatible = "denx,uimage";
		label = "firmware";
		reg = <0x070000 0x790000>;
	};
};
