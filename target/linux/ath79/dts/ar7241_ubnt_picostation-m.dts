// SPDX-License-Identifier: GPL-2.0-or-later OR MIT
/dts-v1/;

#include "ar7241_ubnt_xm_outdoor.dtsi"

/ {
	compatible = "ubnt,picostation-m", "ubnt,xm", "qca,ar7241";
	model = "Ubiquiti Picostation M";
};

&eth1 {
	compatible = "syscon", "simple-mfd";
};
