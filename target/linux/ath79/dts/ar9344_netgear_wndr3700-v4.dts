// SPDX-License-Identifier: GPL-2.0-or-later OR MIT

#include "ar9344_netgear_wndr.dtsi"
#include "ar9344_netgear_wndr_wan.dtsi"
#include "ar9344_netgear_wndr_usb.dtsi"

/ {
	compatible = "netgear,wndr3700-v4", "qca,ar9344";
	model = "Netgear WNDR3700 v4";
};
