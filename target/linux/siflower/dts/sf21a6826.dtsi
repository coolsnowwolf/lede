#include "sf21.dtsi"
/ {
	compatible = "siflower,sf21a6826";
};

&cpus {
	timebase-frequency = <1125000000>;
};

&topcrm {
	assigned-clocks = <&topcrm CLK_CMNPLL_VCO>, <&topcrm CLK_PIC>, <&topcrm CLK_AXI>,
		<&topcrm CLK_AHB>, <&topcrm CLK_APB>, <&topcrm CLK_UART>,
		<&topcrm CLK_IRAM>, <&topcrm CLK_NPU>, <&topcrm CLK_ETHTSU>,
		<&topcrm CLK_GMAC_BYP_REF>, <&topcrm CLK_USB>, <&topcrm CLK_USBPHY>,
		<&topcrm CLK_SERDES_CSR>, <&topcrm CLK_CRYPT_CSR>, <&topcrm CLK_CRYPT_APP>,
		<&topcrm CLK_IROM>;
	assigned-clock-rates = <2250000000>, <562500000>, <375000000>,
		<281250000>, <187500000>, <93750000>,
		<562500000>, <562500000>, <93750000>,
		<250000000>, <250000000>, <50000000>,
		<93750000>, <75000000>, <375000000>,
		<375000000>;
};
