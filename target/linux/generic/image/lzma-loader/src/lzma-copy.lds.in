OUTPUT_ARCH(mips)
ENTRY(_start)
SECTIONS
{
  /* Read-only sections, merged into text segment: */
  . = @LOADADDR@;
  .text      :
  {
    _ftext = . ;
    *(.text)
    *(.rodata)
  } =0

  .reginfo : { *(.reginfo) }

  .bss       :
  {
   *(.bss)
  }
}
