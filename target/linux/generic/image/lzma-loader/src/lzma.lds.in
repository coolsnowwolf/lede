OUTPUT_ARCH(mips)
ENTRY(@ENTRY@)
SECTIONS
{
  /* Read-only sections, merged into text segment: */
  . = @LOADADDR@;
  .text      :
  {
    _ftext = . ;
    *(.text.entry)
    *(.text)
    *(.rodata)
    lzma_start = .;
    kernel.o
    lzma_end = .;
  } =0

  .reginfo : { *(.reginfo) }

  .bss       :
  {
   *(.bss)
  }
}
