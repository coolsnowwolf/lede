## target/linux/generic/files/drivers/net/phy/rtl8261n/Kconfig
```kconfig
config RTL8261N_PHY
	tristate "Driver for Realtek RTL8261N PHYs"
	help
	  Currently supports the RTL8261N,RTL8264B PHYs.
```

## target/linux/generic/files/drivers/platform/mikrotik/Kconfig
```kconfig
menuconfig MIKROTIK
	bool "Platform support for MikroTik RouterBoard virtual devices"
	help
	  Say Y here to get to see options for the MikroTik RouterBoard platform.
	  This option alone does not add any kernel code.


if MIKROTIK

config MIKROTIK_RB_SYSFS
	tristate "RouterBoot sysfs support"
	depends on MTD
	select LZO_DECOMPRESS
	select CRC32
	help
	  This driver exposes RouterBoot configuration in sysfs.

config NVMEM_LAYOUT_MIKROTIK
	tristate "RouterBoot NVMEM layout support"
	depends on NVMEM_LAYOUTS
	help
	  This driver exposes MikroTik hard_config via NVMEM layout.

endif # MIKROTIK
```

## target/linux/mcs814x/files-3.18/arch/arm/mach-mcs814x/Kconfig
```kconfig
if ARCH_MCS814X

config MCS8140
	bool
	select CPU_ARM926T

menu "Moschip MCS8140 boards"

config MACH_DLAN_USB_EXT
	bool "Devolo dLAN USB Extender"
	select MCS8140
	select NEW_LEDS
	select LEDS_CLASS
	select LEDS_GPIO
	help
	  Machine support for the Devolo dLAN USB Extender

config MACH_RBT_832
	bool "Tigal RBT-832"
	select MCS8140
	select NEW_LEDS
	select LEDS_CLASS
	select LEDS_GPIO
	help
	  Machine support for the Tigal RBT-832 board

endmenu

endif
```

## target/linux/mcs814x/files-3.18/drivers/net/ethernet/mcs8140/Kconfig
```kconfig
config  NUPORT_ETHERNET_DRIVER
	tristate "MCS8140 Ethernet driver"
	depends on ETHERNET && ARCH_MCS814X
          help
```

## target/linux/mediatek/files-5.10/drivers/mtd/mtk-snand/Kconfig
```kconfig
# SPDX-License-Identifier: GPL-2.0
#
# Copyright (C) 2020 MediaTek Inc. All rights reserved.
# Author: Weijie Gao <weijie.gao@mediatek.com>
#

config MTK_SPI_NAND
	tristate "MediaTek SPI NAND flash controller driver"
	depends on MTD
	default n
	help
	  This option enables access to SPI-NAND flashes through the
	  MTD interface of MediaTek SPI NAND Flash Controller
```

## target/linux/mediatek/image/Config.in
```kconfig
config MTK_BOOT_PARTSIZE
       int "Boot (SD Card/eMMC) filesystem partition size (in MiB)"
       depends on TARGET_mediatek_mt7623_DEVICE_bpi_bananapi-r2 || TARGET_DEVICE_mediatek_mt7623_DEVICE_bpi_bananapi-r2 || TARGET_mediatek_mt7623_DEVICE_unielec_u7623-emmc || TARGET_DEVICE_mediatek_mt7623_DEVICE_unielec_u7623-emmc
       default 32
```

## target/linux/mxs/image/Config.in
```kconfig
config MXS_SD_BOOT_PARTSIZE
	int "Boot (SD Card) filesystem partition size (in MB)"
	depends on TARGET_mxs
	default 8
	help
	    On the Olimex OLinuXino boards, mainline U-Boot loads the
	    linux kernel and device tree file from a FAT partition.
	    The default value of 8 MB should be more than adequate.
```

## target/linux/omap/image/Config.in
```kconfig
config OMAP_SD_BOOT_PARTSIZE
	int "Boot (SD Card) filesystem partition size (in MB)"
	depends on TARGET_omap
	default 20
```

## target/linux/oxnas/files/arch/arm/configs/ox820_defconfig
```kconfig
CONFIG_CROSS_COMPILE="arm-linux-gnueabi-"
CONFIG_SYSVIPC=y
CONFIG_POSIX_MQUEUE=y
CONFIG_NO_HZ_IDLE=y
CONFIG_HIGH_RES_TIMERS=y
CONFIG_IRQ_TIME_ACCOUNTING=y
CONFIG_CGROUPS=y
CONFIG_NAMESPACES=y
CONFIG_EMBEDDED=y
# CONFIG_COMPAT_BRK is not set
CONFIG_JUMP_LABEL=y
CONFIG_MODULES=y
CONFIG_MODULE_UNLOAD=y
CONFIG_ARCH_OXNAS=y
# CONFIG_DMA_CACHE_RWFO is not set
CONFIG_DMA_CACHE_FIQ_BROADCAST=y
CONFIG_PCI=y
CONFIG_PCI_OXNAS=y
CONFIG_SMP=y
# CONFIG_SMP_ON_UP is not set
CONFIG_NR_CPUS=2
CONFIG_HOTPLUG_CPU=y
CONFIG_AEABI=y
# CONFIG_OABI_COMPAT is not set
CONFIG_UACCESS_WITH_MEMCPY=y
CONFIG_USE_OF=y
CONFIG_BINFMT_MISC=y
# CONFIG_SUSPEND is not set
CONFIG_NET=y
CONFIG_PACKET=y
CONFIG_UNIX=y
CONFIG_INET=y
CONFIG_IP_PNP=y
CONFIG_IP_PNP_DHCP=y
CONFIG_IPV6=y
CONFIG_CFG80211=y
CONFIG_MAC80211=y
CONFIG_MAC80211_RC_PID=y
CONFIG_DEVTMPFS=y
CONFIG_DEVTMPFS_MOUNT=y
CONFIG_MTD=y
CONFIG_MTD_CMDLINE_PARTS=y
CONFIG_MTD_BLOCK=y
CONFIG_MTD_NAND=y
CONFIG_MTD_NAND_OXNAS=y
CONFIG_MTD_UBI=y
CONFIG_BLK_DEV_SD=y
CONFIG_SCSI_MULTI_LUN=y
CONFIG_ATA=y
CONFIG_SATA_OXNAS=y
CONFIG_NETDEVICES=y
CONFIG_STMMAC_ETH=y
CONFIG_STMMAC_DEBUG_FS=y
CONFIG_STMMAC_DA=y
CONFIG_ATH_CARDS=y
CONFIG_ATH9K=y
CONFIG_ATH9K_LEGACY_RATE_CONTROL=y
# CONFIG_RTL_CARDS is not set
# CONFIG_INPUT_MOUSEDEV_PSAUX is not set
# CONFIG_INPUT_KEYBOARD is not set
# CONFIG_INPUT_MOUSE is not set
# CONFIG_SERIO is not set
# CONFIG_LEGACY_PTYS is not set
CONFIG_SERIAL_8250=y
# CONFIG_SERIAL_8250_DEPRECATED_OPTIONS is not set
CONFIG_SERIAL_8250_CONSOLE=y
CONFIG_SERIAL_8250_NR_UARTS=1
CONFIG_SERIAL_8250_RUNTIME_UARTS=1
CONFIG_SERIAL_OF_PLATFORM=y
CONFIG_GPIO_SYSFS=y
CONFIG_USB=y
CONFIG_USB_ANNOUNCE_NEW_DEVICES=y
CONFIG_USB_EHCI_HCD=y
CONFIG_USB_EHCI_OXNAS=y
CONFIG_USB_STORAGE=y
CONFIG_LEDS_GPIO=y
CONFIG_LEDS_TRIGGER_TIMER=y
CONFIG_LEDS_TRIGGER_ONESHOT=y
CONFIG_LEDS_TRIGGER_HEARTBEAT=y
CONFIG_LEDS_TRIGGER_DEFAULT_ON=y
CONFIG_COMMON_CLK_DEBUG=y
CONFIG_EXT2_FS=y
CONFIG_EXT4_FS=y
CONFIG_FUSE_FS=y
CONFIG_VFAT_FS=y
CONFIG_NTFS_FS=m
CONFIG_NTFS_RW=y
CONFIG_TMPFS=y
CONFIG_TMPFS_POSIX_ACL=y
CONFIG_UBIFS_FS=y
CONFIG_NFS_FS=y
CONFIG_ROOT_NFS=y
CONFIG_PRINTK_TIME=y
# CONFIG_ENABLE_WARN_DEPRECATED is not set
# CONFIG_ENABLE_MUST_CHECK is not set
# CONFIG_FTRACE is not set
CONFIG_DEBUG_USER=y
CONFIG_DEBUG_LL=y
CONFIG_DEBUG_LL_UART_8250=y
CONFIG_DEBUG_UART_PHYS=0x44200000
CONFIG_DEBUG_UART_VIRT=0xF0000000
CONFIG_DEBUG_UART_8250_SHIFT=0
CONFIG_EARLY_PRINTK=y
CONFIG_CRYPTO_ANSI_CPRNG=y
```

## target/linux/oxnas/files/arch/arm/mach-oxnas/Kconfig
```kconfig
choice
	prompt "Oxnas platform type"
	default MACH_OXNAS
	depends on ARCH_OXNAS

config MACH_OX820
	bool "Generic NAS7820 Support"
	select ARM_GIC
	select GENERIC_CLOCKEVENTS
	select CPU_V6K
	select HAVE_ARM_SCU if SMP
	select HAVE_ARM_TWD if SMP
	select HAVE_SMP
	select PLXTECH_RPS
	select CLKSRC_OF
	select CLKSRC_RPS_TIMER
	select USB_ARCH_HAS_EHCI
	select PINCTRL_OXNAS
	select PINCTRL
	select RESET_CONTROLLER_OXNAS
	select ARCH_WANT_LIBATA_LEDS
	help
	  Include support for the ox820 platform.

endchoice
```

## target/linux/phytium/files-5.10/Documentation/devicetree/bindings/dma/phytium-ddma.yaml
```yaml
# SPDX-License-Identifier: (GPL-2.0-only OR BSD-2-Clause)
%YAML 1.2
---
title: Phytium DDMA Controller bindings

description:
  The Phytium DDMA is a general-purpose direct memory access controller capable of
  supporting 8 independent DMA channels. Each channel can have up to 32 requests.
  DMA clients connected to the Phytium DDMA controller must use the format
  described in the dma.txt file, using a two-cell specifier for each
  channel: a phandle to the DMA controller plus the following two integer cells:
    1. The channel id
    2. The request line number

maintainers:
  - Huang Jie <huangjie1663@phytium.com.cn>

allOf:
  - $ref: "dma-controller.yaml#"

properties:
  "#dma-cells":
    const: 2

  compatible:
    const: phytium,ddma

  reg:
    maxItems: 1

  interrupts:
    maxItems: 1

  dma-channels:
    minItems: 1
    maxItems: 8
    description: it indicates that the number of channels are used

required:
  - compatible
  - reg
  - interrupts
  - dma-channels

unevaluatedProperties: false

examples:
    ddma0: ddma@28003000 {
        compatible = "phytium,ddma";
        reg = <0x0 0x28003000 0x0 0x1000>;
        interrupts = <GIC_SPI 75 IRQ_TYPE_LEVEL_HIGH>;
        #dma-cells = <2>;
        dma-channels = <8>;
    };
...
```

## target/linux/phytium/files-5.10/Documentation/devicetree/bindings/gpio/gpio-phytium-sgpio.txt
```
* Phytium SGPIO controller

This SGPIO controller is for Phytium Pe220x SoC, which supports up to
96 (32x3) Serial GPIOs.

Required properties:
- compatible : Should contain "phytium,gpio"
- reg : Address and length of the register set for the device.
- interrupts: Interrupt mapping for GPIO IRQ.
- gpio-controller : Marks the device node as a gpio controller.
- #gpio-cells : Should be 2. The first cell is the pin number and
  the second cell is used to specify the gpio polarity:
      0 = active high
      1 = active low
- ngpios: number of GPIO lines, see gpio.txt
          (should be multiple of 32, up to 96 pins)
- bus-frequency: SGPIO CLK frequency
- clocks: A phandle to the APB clock for SGPIO clock division

Example:

	sgpio: sgpio@2807d000 {
		compatible = "phytium,sgpio";
		reg = <0x0 0x2807d000 0x0 0x1000>;
		interrupts = <GIC_SPI 190 IRQ_TYPE_LEVEL_HIGH>;
		clocks = <&sysclk_48mhz>;
		ngpios = <96>;
		bus-frequency = <48000>;
		gpio-controller;
		#gpio-cells = <2>;
	};
```

## target/linux/phytium/files-5.10/Documentation/devicetree/bindings/gpio/phytium,gpio.yaml
```yaml
# SPDX-License-Identifier: (GPL-2.0 OR BSD-2-Clause)
%YAML 1.2
---
$id: http://devicetree.org/schemas/gpio/phytium,gpio.yaml#
$schema: http://devicetree.org/meta-schemas/core.yaml#

title: Phytium GPIO controller

description: |
  Phytium GPIO controllers have one or two configurable ports, each of which
  are intended to be represented as child nodes with the generic GPIO-controller
  properties as desribed in this bindings file.

maintainers:
  - Chen Baozi <chenbaozi@phytium.com.cn>

properties:
  $nodename:
    pattern: "^gpio@[0-9a-f]+$"

  compatible:
    const: phytium,gpio

  reg:
    maxItems: 1

  gpio-controller: true

  "#address-cells":
    const: 1

  "#size-cells":
    const: 0

  '#gpio-cells':
    const: 2

  interrupts:
    description: |
      The interrupts to the parent controller raised when GPIOs generate
      the interrupts. If the controller provides one combined interrupt
      for all GPIOs, specify a single interrupt. If the controller provides
      one interrupt for each GPIO, provide a list of interrupts that
      correspond to each of the GPIO pins.
    minItems: 1
    maxItems: 32

  interrupt-controller: true

  '#interrupt-cells':
    const: 2

patternProperties:
  "^gpio-(port|controller)@[0-9a-f]+$":
    type: object
    properties:
      compatible:
        const: phytium,gpio-port

      reg:
        maxItems: 1

     nr-gpios:
        description: The number of GPIO pins exported by the port.
        default: 32
        minimum: 1
        maximum: 32

    required:
      - compatible
      - reg
      - gpio-controller
      - '#gpio-cells'

    dependencies:
      interrupt-controller: [ interrupts ]

    additionalProperties: false

additionalProperties: false

required:
  - compatible
  - reg
  - "#address-cells"
  - "#size-cells"

examples:
  - |
    gpio: gpio@28004000 {
      compatible = "phytium,gpio";
      reg = <0x0 0x28004000 0x0 0x1000>;
      gpio-controller;
      #gpio-cells = <2>;
      #address-cells = <1>;
      #size-cells = <0>;
      interrupts = <GIC_SPI 10 IRQ_TYPE_LEVEL_HIGH>;
      interrupt-controller;
      #interrupt-cells = <2>;

      porta: gpio-port@0 {
        compatible = "phytium,gpio-port";
        reg = <0>;
        nr-gpios = <8>;
      };

      portb: gpio-port@1 {
        compatible = "phytium,gpio-port";
        reg = <1>;
        nr-gpios = <8>;
      };
};
...
```

## target/linux/phytium/files-5.10/Documentation/devicetree/bindings/hwlock/phytium-hwspinlock.txt
```
Phytium HwSpinlock Driver
========================

Required properties:
- compatible:		Should be "phytium,hwspinlock"
- reg:			Contains the hwspinlock module register address space
			(base address and length)
- #hwlock-cells:	Should be 1.
- nr-locks:		The number of locks in the device.

Please look at the generic hwlock binding for usage information for consumers,
"Documentation/devicetree/bindings/hwlock/hwlock.txt"

Example:

hwspinlock: spinlock@40000000 {
	compatible = "phytium,hwspinlock";
	reg = <0x40000000 0x1000>;
	#hwlock-cells = <1>;
	nr-locks = <32>;
};
```

## target/linux/phytium/files-5.10/Documentation/devicetree/bindings/i2c/phytium,i2c.yaml
```yaml
# SPDX-License-Identifier: (GPL-2.0-only OR BSD-2-Clause)
%YAML 1.2
---
$id: http://devicetree.org/schemas/i2c/snps,designware-i2c.yaml#
$schema: http://devicetree.org/meta-schemas/core.yaml#

title: Phytium I2C/SMBus Controller

maintainers:
  - Chen Baozi <chenbaozi@phytium.com.cn>

allOf:
  - $ref: /schemas/i2c/i2c-controller.yaml#

properties:
  compatible:
    const: phytium,i2c

  reg:
    minItems: 1
    items:
      - description: Offset and length of the memory mapped registers

  interrupts:
    maxItems: 1

  clocks:
    minItems: 1
    items:
      - description: I2C controller reference clock source

unevaluatedProperties: false

required:
  - compatible
  - reg
  - interrupts

examples:
  - |
    i2c0: i2c@28011000 {
      compatible = "phytium,i2c";
      reg = <0x0 0x28011000 0x0 0x1000>;
      interrupts = <GIC_SPI 89 IRQ_TYPE_LEVEL_HIGH>;
      interrupt-names = "smbus_alert";
      clocks = <&sysclk_48mhz>;
    };
...
```

## target/linux/phytium/files-5.10/Documentation/devicetree/bindings/input/phytium-keypad.txt
```
* Phytium Keypad Port device tree bindings

The keypad port is designed to interface with a keypad matrix, which
simplify the software task of scanning a keypad matrix. It is capable
of detecting, debouncing, and decoding one or multiple keys pressed
simultaneously on a keypad.

Required SoC Specific Properties:
- compatible: Should be "phytium,keypad".
- reg: Physical base address and length of memory mapped region.
- interrupts: Interrupt number to the CPU(s).

Required Board Specific Properties:
- linux,keymap: The definition can be found at
bindings/input/matrix-keymap.txt.

Example:

keypad: keypad@2807a000 {
	compatible = "phytium,keypad";
	reg = <0x 0x2807a000 0x0 0x1000>;
	interrupts = <GIC_SPI 189 IRQ_TYPE_LEVEL_HIGH>;
	keypad,num-rows = <4>;
	keypad,num-columns = <4>;
	linux,keymap = <0x00000067	/* KEY_UP */
			0x0001006c	/* KEY_DOWN */
			0x00020072	/* KEY_VOLUMEDOWN */
			0x00030066	/* KEY_HOME */
			0x0100006a	/* KEY_RIGHT */
			0x01010069	/* KEY_LEFT */
			0x0102001c	/* KEY_ENTER */
			0x01030073	/* KEY_VOLUMEUP */
			0x02000040	/* KEY_F6 */
			0x02010042	/* KEY_F8 */
			0x02020043	/* KEY_F9 */
			0x02030044	/* KEY_F10 */
			0x0300003b	/* KEY_F1 */
			0x0301003c	/* KEY_F2 */
			0x0302003d	/* KEY_F3 */
			0x03030074>;	/* KEY_POWER */
};
```

## target/linux/phytium/files-5.10/Documentation/devicetree/bindings/interrupt-controller/phytium,ixic.yaml
```yaml
# SPDX-License-Identifier: GPL-2.0-only OR BSD-2-Clause
%YAML 1.2
---
$id: http://devicetree.org/schemas/interrupt-controller/phytium,ixic.yaml#
$schema: http://devicetree.org/meta-schemas/core.yaml#

title: Phytium INTx interrupt controller (IXIC)

description: |
This is a psuedo interrupt controller to handle PCI legacy interrupt on
Phytium D2000 and FT-2000/4C SoC, which sits between the PCI INTx devices
and the GIC and forwards the 4 INTx input signals to 4 adjacent GICv3 SPIs.

maintainers:
  - Chen Baozi <chenbaozi@phytium.com.cn>

allOf:
  - $ref: /schemas/interrupt-controller.yaml#

properties:
  compatible:
    enum:
      - phytium,d2000-ixic
      - phytium,ft2004c-ixic

  reg:
    description: |
      Specifies two regions of the register set, which are called
      'ctr' and 'hpb'
    minItems: 2
    maxItems: 2

  interrupt-controller: true

  '#interrupt-cells':
    description: |
      Specifies the number of cells needed to encode an interrupt source.
    const: 3

  intx-spi-base:
    $ref: /schemas/types.yaml#/definitions/uint32
    description: |
      The SPI number of the first SPI of the 4 adjacent ones the IXIC
      forwards its interrupts to.

required:
  - compatible
  - reg
  - interrupt-controller
  - '#interrupt-cells'
  - intx-spi-base

additionalProperties: false

examples:
  - |
    ixic: interrupt-controller@29000000 {
      compatible = "phytium,d2000-ixic";
      reg-names = "ctr", "hpb";
      reg = <0x0 0x29000000 0x0 0x00060000>,
            <0x0 0x29100000 0x0 0x00002000>;
      interrupt-controller;
      interrupt-parent = <&gic>;
      #interrupt-cells = <3>;
      intx-spi-base = <28>;
    };
```
