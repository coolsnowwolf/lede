## target/linux/phytium/files-5.10/Documentation/devicetree/bindings/mailbox/phytium,mbox.yaml
```yaml
# SPDX-License-Identifier: (GPL-2.0-only OR BSD-2-Clause)
%YAML 1.2
---
$id: http://devicetree.org/schemas/mailbox/arm,mhuv2.yaml#
$schema: http://devicetree.org/meta-schemas/core.yaml#

title: Phytium Mailbox Controller

maintainers:
  - Chen Baozi <chenbaozi@phytium.com.cn>

description: |
  The Phytium mailbox controller that has a channel/link to communicate
  with the remote end. A link raises interrupt for any received data. However,
  there is no specified way of knowing if the sent data has been read by the
  remote. This driver assumes the sender polls STAT register and the remote
  clears it after having read the data.

properties:
  compatible:
    - enum: phytium,mbox

  reg:
    maxItems: 1

  interrupts:
    description: |
      Contains the interrupt information corresponding to the link
    maxItems: 1

  '#mbox-cells':
    description: |
      It should be 1, which is the index of the channel needed.
    const: 1

required:
  - compatible
  - reg
  - interrupts
  - '#mbox-cells'

additionalProperties: false

examples:
  - |
    mbox: mailbox@2a000000 {
    	compatible = "phytium,mbox";
    	reg = <0x0 0x2a000000 0x0 0x1000>;
    	#mbox-cells = <1>;
    	interrupts = <0 48 4>;
    };
```

## target/linux/phytium/files-5.10/Documentation/devicetree/bindings/media/phytium-jpeg.txt
```
* Device tree bindings for Phytium JPEG Engine

The JPEG Engine embedded in the Phytium SOCs can capture
and compress video data from digital or analog sources.

Required properties:
 - compatible:		"phytium,jpeg"
 - reg:			 contains the offset and length of the
			 JPEG Engine memory region
 - interrupts:		 the interrupt associated with the VE on this platform
 - phytium,ocm-buf-addr  the physical address used to storage the inputing video data

Example:

jpeg: jpeg@32b32000 {
		compatible = "phytium,jpeg";
		reg = <0x0 0x32b32000 0 0x1000>;
		interrupts = <0 41 4>;
		phytium,ocm-buf-addr = <0x30c40000 0x30c60000>;
		status = "okay";
};
```

## target/linux/phytium/files-5.10/Documentation/devicetree/bindings/mmc/phytium,sdci.yaml
```yaml
# SPDX-License-Identifier: GPL-2.0-only
%YAML 1.2
---
$id: http://devicetree.org/schemas/mmc/phytium,sdci.yaml#
$schema: http://devicetree.org/meta-schemas/core.yaml#

title: Phytium SDCI Controller Binding

maintainers:
  - Chen Baozi <chenbaozi@phytium.com.cn>

allOf:
  - $ref: mmc-controller.yaml#

properties:
  compatible:
    enum:
      - phytium,sdci

  reg:
    maxItems: 1

  interrupts:
    minItems: 3
    maxItems: 3

  clocks:
    minItems: 1
    items:
      - description: core clock

  clock-names:
    minItems: 1
    items:
      - const: phytium_sdc_clk

required:
  - compatible
  - reg
  - interrupts
  - clocks
  - clock-names

unevaluatedProperties: false

examples:
  - |
    sdci: sdci@28207c00 {
      compatible = "phytium,sdci";
      reg = <0x0 0x28207c00 0x0 0x100>;
      interrupts = <GIC_SPI 20 IRQ_TYPE_LEVEL_HIGH>,
                   <GIC_SPI 21 IRQ_TYPE_LEVEL_HIGH>,
                   <GIC_SPI 22 IRQ_TYPE_LEVEL_HIGH>;
      clocks = <&sysclk_600mhz>;
      clock-names = "phytium_sdc_clk";
    };

...
```

## target/linux/phytium/files-5.10/Documentation/devicetree/bindings/mmc/phytium-mci.txt
```
* Phytium Multimedia Card Interface controller

The highspeed MMC host controller on Phytium SoCs provides an interface
for MMC, SD and SDIO types of memory cards.

Required properties:
- compatible : should be "phytium,mci".
- reg: mmc controller base registers.
- clocks : phandles to input clocks.
- clock-names : should be "phytium_mci_clk".
- interrupts : mmc controller interrupt.

Examples:
	- Within .dtsi:
	mmc0: mmc@28000000 {
		compatible = "phytium,mci";
		reg = <0x0 0x28000000 0x0 0x1000>;
		interrupts = <GIC_SPI 72 IRQ_TYPE_LEVEL_HIGH>;
		clocks = <&sysclk_1200mhz>;
		clock-names = "phytium_mci_clk";
		status = "disabled";
	};

	- Within dts:
	&mmc0 {
		bus-width = <4>;
		max-frequency = <50000000>;
		cap-sdio-irq;
		cap-sd-highspeed;
		sd-uhs-sdr12;
		sd-uhs-sdr25;
		sd-uhs-sdr50;
		no-mmc;
		status = "ok";
	};
```

## target/linux/phytium/files-5.10/Documentation/devicetree/bindings/net/can/phytium-can.txt
```
Phytium CAN controller
------------------------

Required properties:
- compatible: Should be:
              - "phytium,can" for Phytium CAN controllers
              - "phytium,canfd" for Phytium CAN controllers with CANFD support
- reg: Should contain CANFD controller registers location and length
- interrupts: Should contain IRQ line for the CANFD controller
- clocks: CLocks used by the controller
- clock-names: Input clock names, should be "can_clk"
- tx-fifo-depth: Indicates the length of TX FIFO
- rx-fifo-depth: Indicates the length of TX FIFO

Optional property:
- extend_brp: Indicates to apply the extend BRP parameter of bit timming for
              early version of CAN controller

Example:

	can0: can@2800a000{
		compatible = "phytium,canfd";
		reg = <0x0 0x2800a000 0x0 0x1000>;
		interrupts = <GIC_SPI 81 IRQ_TYPE_LEVEL_HIGH>;
		clocks = <&sysclk_600mhz>;
		clock-names = "can_clk";
		tx-fifo-depth = <64>;
		rx-fifo-depth = <64>;
	};
```

## target/linux/phytium/files-5.10/Documentation/devicetree/bindings/remoteproc/homo-rproc.txt
```
homogeneous remoteproc driver
==========================================

This driver implements communication between remote processors under a homogeneous CPU architecture(SMP).

Homogeneous RemoteProc Device Node:
=================================
A homo_remoteproc device node is used to represent the remote core instance within SoC.

Required properties:
--------------------
 - compatible : should be "homo,rproc"
 - remote-processor: remote processor's linux cpu logical number
 - inter-processor-interrupt: IPI/SGI interrupt number, default is 9
 - memory-region: reserved memory which will be used by remote processor
 - firmware-name: the name of openamp image, default is "openamp_core0.elf"

Example:
--------

    reserved-memory {
        #address-cells = <0x2>;
        #size-cells = <0x2>;
        ranges;

        rproc: rproc@b0100000 {
            no-map;
            reg = <0x0 0xb0100000 0x0 0x19900000>;
        };
    };

    homo_rproc: homo_rproc@0 {
        compatible = "homo,rproc";
        remote-processor = <3>;
        inter-processor-interrupt = <9>;
        memory-region = <&rproc>;
        firmware-name = "openamp_core0.elf";
        status = "disabled";
    };
```

## target/linux/phytium/files-5.10/Documentation/devicetree/bindings/rng/phytium-rng.txt
```
Phytium Random Number Generator

Required properties:
- compatible : Should be "phytium,rng"
- reg : Offset and length of the register set of this block

Example:

	rng@0x31a06000 {
		compatible = "phytium,rng";
		reg = <0x0 0x31a06000 0x0 0x1000>;
	};
```
