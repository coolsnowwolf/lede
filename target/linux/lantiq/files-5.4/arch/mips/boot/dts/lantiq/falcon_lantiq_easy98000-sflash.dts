/dts-v1/;

#include "falcon_lantiq_easy98000.dtsi"
#include "falcon_sflash-16m.dtsi"

/ {
	model = "Lantiq Falcon (SFLASH)";
	compatible = "lantiq,easy98000-sflash", "lantiq,easy98000", "lantiq,falcon";

	aliases {
		spi0 = &ebu_cs0;
		spi1 = &spi;
	};
};
