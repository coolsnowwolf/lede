/dts-v1/;

#include "ARV4518PWR01.dtsi"

/ {
	compatible = "arcadyan,arv4518pwr01a", "lantiq,xway", "lantiq,danube";
	model = "SMC7908A-ISP, Airties WAV-221";

	fpi@10000000 {
		pci@E105400 {
			lantiq,external-clock;
		};
	};
};
