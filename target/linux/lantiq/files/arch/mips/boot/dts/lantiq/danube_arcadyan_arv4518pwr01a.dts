#include "danube_arcadyan_arv4518pwr01.dtsi"

/ {
	compatible = "arcadyan,arv4518pwr01a", "lantiq,xway", "lantiq,danube";
	model = "SMC7908A-ISP, Airties WAV-221";
};

&pci0 {
	lantiq,external-clock;
};
