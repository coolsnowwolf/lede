/dts-v1/;

#include "falcon.dtsi"
#include "EASY98000-base.dtsi"
#include "falcon-sflash-16M.dtsi"

/ {
	model = "EASY98000SFLASH - Lantiq Falcon (SFLASH)";
	compatible = "lantiq,falcon-easy98000-sflash", "lantiq,falcon-easy98000", "lantiq,falcon";

	aliases {
		spi0 = &ebu_cs0;
		spi1 = &spi;
	};
};

