// SPDX-License-Identifier: GPL-2.0-or-later OR MIT

#include "vr9_avm_fritz3490.dtsi"

/ {
	compatible = "avm,fritz3490-micron", "lantiq,xway", "lantiq,vr9";
	model = "AVM FRITZ!Box 3490 (Micron NAND)";
};

&nand1 {
	nand-ecc-engine = <&nand1>;
};
