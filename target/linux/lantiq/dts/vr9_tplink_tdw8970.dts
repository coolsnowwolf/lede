#include "vr9_tplink_tdw89x0.dtsi"

/ {
	compatible = "tplink,tdw8970", "tplink,tdw89x0", "lantiq,xway", "lantiq,vr9";
	model = "TP-LINK TD-W8970";
};

&boardconfig {
	cal_boardconfig_21000: calibration@21000 {
		reg = <0x21000 0x440>;
	};
};

&ath9k {
	compatible = "pci168c,0030";
	nvmem-cells = <&macaddr_ath9k_cal_f100 2>, <&cal_boardconfig_21000>;
	nvmem-cell-names = "mac-address", "calibration";
};
