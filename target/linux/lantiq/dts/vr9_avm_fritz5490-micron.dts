// SPDX-License-Identifier: GPL-2.0-or-later OR MIT

#include "vr9_avm_fritz5490.dtsi"

/ {
	compatible = "avm,fritz5490-micron", "lantiq,xway", "lantiq,vr9";
	model = "AVM FRITZ!Box 5490/5491 (Micron NAND)";
};

&nand1 {
	nand-ecc-engine = <&nand1>;
};
