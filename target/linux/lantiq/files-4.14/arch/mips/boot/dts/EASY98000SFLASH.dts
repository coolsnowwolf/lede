/dts-v1/;

#include "falcon.dtsi"
#include "EASY98000-base.dtsi"
#include "falcon-sflash-16M.dtsi"

/ {
	model = "Lantiq Falcon (SFLASH)";
	compatible = "lantiq,easy98000-sflash", "lantiq,easy98000", "lantiq,falcon";

	aliases {
		spi0 = &ebu_cs0;
		spi1 = &spi;
	};
};

