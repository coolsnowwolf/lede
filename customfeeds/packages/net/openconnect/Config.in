## package/Twinzo/udev/Config.in
```kconfig
# udev package config

menu "Configuration"
	depends on PACKAGE_udev

config UDEV_DISABLE_LOGGING
	bool "Disable udev logging to syslog"
	default n
	help
	  Disable logging of udev messages to the syslog.  If
	  unsure, choose the default N.

config UDEV_ENABLE_DEBUG
	bool "Enable debug build of the udev package"
	default n
	help
	  Compile in udev debug messages.  If unsure, choose
	  the default N.

config UDEV_EXTRA_accelerometer
	bool "Install udev accelerometer callout"
	default y
	help
	  accelerometer - udev callout to export device orientation
	  through property

config UDEV_EXTRA_ata_id
	bool "Install udev ata_id callout"
	default y
	help
	  ata_id - udev callout to read product/serial number
	  from ATA drives

config UDEV_EXTRA_cdrom_id
	bool "Install udev cdrom_id callout"
	default y
	help
	  cdrom_id - udev callout to determine the capabilities
	  of optical drives and media

config UDEV_EXTRA_collect
	bool "Install udev collect"
	default n
	help
	  Adds ID to the list governed by <checkpoint>

config UDEV_EXTRA_edd_id
	bool "Install udev edd_id callout"
	default n
	help
	  edd_id - udev callout to identify BIOS disk drives
	  via EDD

config UDEV_EXTRA_firmware
	bool "Install firmware support"
	default n
	help
	  udev firmware loader via EDD

config UDEV_EXTRA_floppy
	bool "Install create_floppy_devices callout"
	default n
	help
	  create_floppy_devices - udev callout to create all
	  possible floppy devices based on the CMOS type

config UDEV_EXTRA_input_id
	bool "Install input_id callout"
	default y
	help
	 input_id - udev callout to classify input devices

config UDEV_EXTRA_mtd_probe
	bool "Install mtd_probe callout"
	default y
	help
	  mtd_probe - udev callout to probe mtd devices

config UDEV_EXTRA_path_id
	bool "Install udev path_id callout"
	default y
	help
	  path_id - udev callout to create a device path based
	  unique name for a device to implement the Linux
	  Persistent Device Naming scheme

config UDEV_EXTRA_qemu
	bool "Install qemu specific rules"
	default y
	help
	  Install rules for autosuspension of QEMU emulated
	  USB HID devices

config UDEV_EXTRA_rule_generator
	bool "Install udev rule_generator"
	default y
	help

config UDEV_EXTRA_scsi_id
	bool "Install udev scsi_id callout"
	default y
	help
	  scsi_id - retrieve and generate a unique SCSI identifier

config UDEV_EXTRA_usb_id
	bool "Install udev usb_id callout"
	default y
	help
	  usb_id - can find the unique id of USB devices

config UDEV_EXTRA_v4l_id
	bool "Install udev v4l_id callout"
	default y
	help
	  v4l_id - udev callout to identify Video4Linux devices

endmenu
```

## package/boot/kexec-tools/Config.in
```kconfig
menu "Configuration"
	depends on PACKAGE_kexec

config KEXEC_ZLIB
	bool
	prompt "zlib support"
	default y

config KEXEC_LZMA
	bool
	prompt "lzma support"
	default n

config KEXEC_ZSTD
	bool
	prompt "zstd support"
	default n

endmenu
```
