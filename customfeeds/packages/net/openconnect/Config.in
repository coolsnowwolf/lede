## customfeeds/packages/utils/lcd4linux/Config.in
```kconfig
if PACKAGE_lcd4linux-custom

config LCD4LINUX_CUSTOM_NEEDS_libdbus
	bool

#config LCD4LINUX_CUSTOM_NEEDS_libftdi
#	bool

config LCD4LINUX_CUSTOM_NEEDS_libgd
	bool

config LCD4LINUX_CUSTOM_NEEDS_libiconv
	bool

config LCD4LINUX_CUSTOM_NEEDS_libjpeg
	bool

config LCD4LINUX_CUSTOM_NEEDS_libmpdclient
	bool

config LCD4LINUX_CUSTOM_NEEDS_libmysqlclient
	bool

config LCD4LINUX_CUSTOM_NEEDS_libncurses
	bool

config LCD4LINUX_CUSTOM_NEEDS_libnmeap
	bool

config LCD4LINUX_CUSTOM_NEEDS_libsqlite3
	bool

config LCD4LINUX_CUSTOM_NEEDS_libusb
	bool

#config LCD4LINUX_CUSTOM_NEEDS_libX11
#	bool

config LCD4LINUX_CUSTOM_NEEDS_ppp
	bool

config LCD4LINUX_CUSTOM_NEEDS_python
	bool


comment "Drivers ---"

config LCD4LINUX_CUSTOM_DRIVER_ASTUSB
	bool
	prompt "ASTUSB"

config LCD4LINUX_CUSTOM_DRIVER_BeckmannEgle
	bool
	prompt "BeckmannEgle"

config LCD4LINUX_CUSTOM_DRIVER_BWCT
	bool
	prompt "BWCT"
	select LCD4LINUX_CUSTOM_NEEDS_libusb

config LCD4LINUX_CUSTOM_DRIVER_CrystalFontz
	bool
	prompt "CrystalFontz"

config LCD4LINUX_CUSTOM_DRIVER_Curses
	bool
	prompt "Curses"
	select LCD4LINUX_CUSTOM_NEEDS_libncurses

config LCD4LINUX_CUSTOM_DRIVER_Cwlinux
	bool
	prompt "Cwlinux"

config LCD4LINUX_CUSTOM_DRIVER_D4D
	bool
	prompt "D4D"
	select LCD4LINUX_CUSTOM_NEEDS_libgd

config LCD4LINUX_CUSTOM_DRIVER_dpf
	bool
	prompt "dpf"
	select LCD4LINUX_CUSTOM_NEEDS_libusb
	select LCD4LINUX_CUSTOM_NEEDS_libgd

config LCD4LINUX_CUSTOM_DRIVER_EA232graphic
	bool
	prompt "EA232graphic"
	select LCD4LINUX_CUSTOM_NEEDS_libgd

config LCD4LINUX_CUSTOM_DRIVER_EFN
	bool
	prompt "EFN"

config LCD4LINUX_CUSTOM_DRIVER_FutabaVFD
	bool
	prompt "FutabaVFD"

config LCD4LINUX_CUSTOM_DRIVER_FW8888
	bool
	prompt "FW8888"

config LCD4LINUX_CUSTOM_DRIVER_G15
	bool
	prompt "G15"
	select LCD4LINUX_CUSTOM_NEEDS_libgd
	select LCD4LINUX_CUSTOM_NEEDS_libusb

config LCD4LINUX_CUSTOM_DRIVER_GLCD2USB
	bool
	prompt "GLCD2USB"
	select LCD4LINUX_CUSTOM_NEEDS_libgd
	select LCD4LINUX_CUSTOM_NEEDS_libusb

config LCD4LINUX_CUSTOM_DRIVER_HD44780
	bool
	prompt "HD44780"
	depends on BROKEN

config LCD4LINUX_CUSTOM_DRIVER_HD44780-I2C
	bool
	prompt "HD44780-I2C"
	depends on BROKEN

config LCD4LINUX_CUSTOM_DRIVER_IRLCD
	bool
	prompt "IRLCD"
	select LCD4LINUX_CUSTOM_NEEDS_libusb

config LCD4LINUX_CUSTOM_DRIVER_LCD2USB
	bool
	prompt "LCD2USB"
	select LCD4LINUX_CUSTOM_NEEDS_libgd
	select LCD4LINUX_CUSTOM_NEEDS_libusb

config LCD4LINUX_CUSTOM_DRIVER_LCDLinux
	bool
	prompt "LCDLinux"
	depends on BROKEN

config LCD4LINUX_CUSTOM_DRIVER_LCDTerm
	bool
	prompt "LCDTerm"

config LCD4LINUX_CUSTOM_DRIVER_LEDMatrix
	bool
	prompt "LEDMatrix"
	select LCD4LINUX_CUSTOM_NEEDS_libgd

config LCD4LINUX_CUSTOM_DRIVER_LPH7508
	bool
	prompt "LPH7508"
	select LCD4LINUX_CUSTOM_NEEDS_libgd

config LCD4LINUX_CUSTOM_DRIVER_LUIse
	bool
	prompt "LUIse"
	select LCD4LINUX_CUSTOM_NEEDS_libgd
	#select LCD4LINUX_CUSTOM_NEEDS_libluise
	depends on BROKEN

config LCD4LINUX_CUSTOM_DRIVER_LW_ABP
	bool
	prompt "LW_ABP"

config LCD4LINUX_CUSTOM_DRIVER_M50530
	bool
	prompt "M50530"

config LCD4LINUX_CUSTOM_DRIVER_MatrixOrbital
	bool
	prompt "MatrixOrbital"

config LCD4LINUX_CUSTOM_DRIVER_MatrixOrbitalGX
	bool
	prompt "MatrixOrbitalGX"
	select LCD4LINUX_CUSTOM_NEEDS_libgd
	select LCD4LINUX_CUSTOM_NEEDS_libusb

config LCD4LINUX_CUSTOM_DRIVER_mdm166a
	bool
	prompt "mdm166a"
	select LCD4LINUX_CUSTOM_NEEDS_libgd

config LCD4LINUX_CUSTOM_DRIVER_MilfordInstruments
	bool
	prompt "MilfordInstruments"

config LCD4LINUX_CUSTOM_DRIVER_Newhaven
	bool
	prompt "Newhaven"

config LCD4LINUX_CUSTOM_DRIVER_Noritake
	bool
	prompt "Noritake"
	select LCD4LINUX_CUSTOM_NEEDS_libgd

config LCD4LINUX_CUSTOM_DRIVER_NULL
	bool
	prompt "NULL"
	default y

config LCD4LINUX_CUSTOM_DRIVER_Pertelian
	bool
	prompt "Pertelian"

config LCD4LINUX_CUSTOM_DRIVER_PHAnderson
	bool
	prompt "PHAnderson"

config LCD4LINUX_CUSTOM_DRIVER_PICGraphic
	bool
	prompt "PICGraphic"
	select LCD4LINUX_CUSTOM_NEEDS_libgd

config LCD4LINUX_CUSTOM_DRIVER_picoLCD
	bool
	prompt "picoLCD"
	select LCD4LINUX_CUSTOM_NEEDS_libusb

config LCD4LINUX_CUSTOM_DRIVER_picoLCDGraphic
	bool
	prompt "picoLCDGraphic"
	select LCD4LINUX_CUSTOM_NEEDS_libgd
	select LCD4LINUX_CUSTOM_NEEDS_libusb

config LCD4LINUX_CUSTOM_DRIVER_PNG
	bool
	prompt "PNG"
	select LCD4LINUX_CUSTOM_NEEDS_libgd

config LCD4LINUX_CUSTOM_DRIVER_PPM
	bool
	prompt "PPM"
	select LCD4LINUX_CUSTOM_NEEDS_libgd

config LCD4LINUX_CUSTOM_DRIVER_SamsungSPF
	bool
	prompt "SamsungSPF"
	select LCD4LINUX_CUSTOM_NEEDS_libgd
	select LCD4LINUX_CUSTOM_NEEDS_libjpeg

config LCD4LINUX_CUSTOM_DRIVER_serdisplib
	bool
	prompt "serdisplib"
	select LCD4LINUX_CUSTOM_NEEDS_libgd
	select LCD4LINUX_CUSTOM_NEEDS_serdisplib

config LCD4LINUX_CUSTOM_DRIVER_ShuttleVFD
	bool
	prompt "ShuttleVFD"
	select LCD4LINUX_CUSTOM_NEEDS_libusb

config LCD4LINUX_CUSTOM_DRIVER_SimpleLCD
	bool
	prompt "SimpleLCD"

config LCD4LINUX_CUSTOM_DRIVER_st2205
	bool
	prompt "st2205"
	select LCD4LINUX_CUSTOM_NEEDS_libgd
	select LCD4LINUX_CUSTOM_NEEDS_st2205tool

config LCD4LINUX_CUSTOM_DRIVER_T6963
	bool
	prompt "T6963"
	select LCD4LINUX_CUSTOM_NEEDS_libgd

config LCD4LINUX_CUSTOM_DRIVER_TeakLCM
	bool
	prompt "TeakLCM"

config LCD4LINUX_CUSTOM_DRIVER_Trefon
	bool
	prompt "Trefon"
	select LCD4LINUX_CUSTOM_NEEDS_libusb

#config LCD4LINUX_CUSTOM_DRIVER_ULA200
#	bool
#	prompt "ULA200"
#	select LCD4LINUX_CUSTOM_NEEDS_libftdi
#	select LCD4LINUX_CUSTOM_NEEDS_libusb

config LCD4LINUX_CUSTOM_DRIVER_USBHUB
	bool
	prompt "USBHUB"
	select LCD4LINUX_CUSTOM_NEEDS_libusb

config LCD4LINUX_CUSTOM_DRIVER_USBLCD
	bool
	prompt "USBLCD"
	select LCD4LINUX_CUSTOM_NEEDS_libusb

config LCD4LINUX_CUSTOM_DRIVER_VNC
	bool
	prompt "VNC"
	select LCD4LINUX_CUSTOM_NEEDS_libgd
	select LCD4LINUX_CUSTOM_NEEDS_libvncserver

config LCD4LINUX_CUSTOM_DRIVER_WincorNixdorf
	bool
	prompt "WincorNixdorf"

#config LCD4LINUX_CUSTOM_DRIVER_X11
#	bool
#	prompt "X11"
#	select LCD4LINUX_CUSTOM_NEEDS_libgd
#	select LCD4LINUX_CUSTOM_NEEDS_libX11


comment "Plugins ---"

config LCD4LINUX_CUSTOM_PLUGIN_apm
	bool
	prompt "apm"

config LCD4LINUX_CUSTOM_PLUGIN_asterisk
	bool
	prompt "asterisk"

config LCD4LINUX_CUSTOM_PLUGIN_button_exec
	bool
	prompt "button_exec"

config LCD4LINUX_CUSTOM_PLUGIN_cpuinfo
	bool
	prompt "cpuinfo"
	default y

config LCD4LINUX_CUSTOM_PLUGIN_dbus
	bool
	prompt "dbus"
	select LCD4LINUX_CUSTOM_NEEDS_libdbus

config LCD4LINUX_CUSTOM_PLUGIN_diskstats
	bool
	prompt "diskstats"

config LCD4LINUX_CUSTOM_PLUGIN_dvb
	bool
	prompt "dvb"

config LCD4LINUX_CUSTOM_PLUGIN_event
	bool
	prompt "event"

config LCD4LINUX_CUSTOM_PLUGIN_exec
	bool
	prompt "exec"

config LCD4LINUX_CUSTOM_PLUGIN_fifo
	bool
	prompt "fifo"

config LCD4LINUX_CUSTOM_PLUGIN_file
	bool
	prompt "file"

config LCD4LINUX_CUSTOM_PLUGIN_gps
	bool
	prompt "gps"
	select LCD4LINUX_CUSTOM_NEEDS_libnmeap

config LCD4LINUX_CUSTOM_PLUGIN_hddtemp
	bool
	prompt "hddtemp"

config LCD4LINUX_CUSTOM_PLUGIN_huawei
	bool
	prompt "huawei"

config LCD4LINUX_CUSTOM_PLUGIN_i2c_sensors
	bool
	prompt "i2c_sensors"

config LCD4LINUX_CUSTOM_PLUGIN_iconv
	bool
	prompt "iconv"
	select LCD4LINUX_CUSTOM_NEEDS_libiconv

config LCD4LINUX_CUSTOM_PLUGIN_imon
	bool
	prompt "imon"

config LCD4LINUX_CUSTOM_PLUGIN_isdn
	bool
	prompt "isdn"

config LCD4LINUX_CUSTOM_PLUGIN_kvv
	bool
	prompt "kvv"

config LCD4LINUX_CUSTOM_PLUGIN_loadavg
	bool
	prompt "loadavg"
	default y

config LCD4LINUX_CUSTOM_PLUGIN_meminfo
	bool
	prompt "meminfo"
	default y

config LCD4LINUX_CUSTOM_PLUGIN_mpd
	bool
	prompt "mpd"
	select LCD4LINUX_CUSTOM_NEEDS_libmpdclient

config LCD4LINUX_CUSTOM_PLUGIN_mpris_dbus
	bool
	prompt "mpris_dbus"
	select LCD4LINUX_CUSTOM_NEEDS_libdbus

config LCD4LINUX_CUSTOM_PLUGIN_mysql
	bool
	prompt "mysql"
	select LCD4LINUX_CUSTOM_NEEDS_libmysqlclient

config LCD4LINUX_CUSTOM_PLUGIN_netdev
	bool
	prompt "netdev"

config LCD4LINUX_CUSTOM_PLUGIN_netinfo
	bool
	prompt "netinfo"

config LCD4LINUX_CUSTOM_PLUGIN_pop3
	bool
	prompt "pop3"

config LCD4LINUX_CUSTOM_PLUGIN_ppp
	bool
	prompt "ppp"
	select LCD4LINUX_CUSTOM_NEEDS_ppp

config LCD4LINUX_CUSTOM_PLUGIN_proc_stat
	bool
	prompt "proc_stat"
	default y

#config LCD4LINUX_CUSTOM_PLUGIN_python
#	bool
#	prompt "python"
#	select LCD4LINUX_CUSTOM_NEEDS_python

config LCD4LINUX_CUSTOM_PLUGIN_qnaplog
	bool
	prompt "qnaplog"
	select LCD4LINUX_CUSTOM_NEEDS_libsqlite3

config LCD4LINUX_CUSTOM_PLUGIN_seti
	bool
	prompt "seti"

config LCD4LINUX_CUSTOM_PLUGIN_statfs
	bool
	prompt "statfs"

config LCD4LINUX_CUSTOM_PLUGIN_uname
	bool
	prompt "uname"

config LCD4LINUX_CUSTOM_PLUGIN_uptime
	bool
	prompt "uptime"
	default y

config LCD4LINUX_CUSTOM_PLUGIN_w1retap
	bool
	prompt "w1retap"

config LCD4LINUX_CUSTOM_PLUGIN_wireless
	bool
	prompt "wireless"
	depends on BROKEN

config LCD4LINUX_CUSTOM_PLUGIN_xmms
	bool
	prompt "xmms"

endif
```

## customfeeds/packages/utils/lxc/Config.in
```kconfig
menu "Configuration"
        depends on PACKAGE_lxc

config LXC_KERNEL_OPTIONS
	bool "Enable kernel support for LXC"
	default n
	select KERNEL_CGROUPS
	select KERNEL_NAMESPACES
	select KERNEL_DEVPTS_MULTIPLE_INSTANCES
	select KERNEL_POSIX_MQUEUE
	select KERNEL_CGROUP_SCHED
	select KERNEL_FAIR_GROUP_SCHED
	select KERNEL_RT_GROUP_SCHED
	select KERNEL_CGROUP_CPUACCT
	select KERNEL_MEMCG
	select KERNEL_MEMCG_KMEM
	select KERNEL_CPUSETS
	select PACKAGE_kmod-ikconfig
	help
	  Select needed kernel options for LXC related utilities. Options
	  include cgroups, namespaces and other miscellaneous options. These
	  options unfortunately can not be installed as a module.

config LXC_BUSYBOX_OPTIONS
	bool "Enable busybox support for lxc-create tool"
	default n
	select BUSYBOX_CUSTOM
	select BUSYBOX_CONFIG_HAVE_DOT_CONFIG
	select BUSYBOX_CONFIG_FEATURE_SEAMLESS_XZ
	select BUSYBOX_CONFIG_FEATURE_TAR_LONG_OPTIONS
	select BUSYBOX_CONFIG_UNXZ
	select BUSYBOX_CONFIG_XZ
	select BUSYBOX_CONFIG_GETOPT
	select BUSYBOX_CONFIG_FEATURE_GETOPT_LONG
	select BUSYBOX_CONFIG_MOUNTPOINT
	help
	  Select needed busybox options for lxc-create utility. This include XZ tar
	  compression, long option support for tar and built-in getopt support.

config LXC_SECCOMP
	bool "Enable support for seccomp in LXC"
	default KERNEL_SECCOMP
	depends on !arc
	help
	  Build LXC with support for seccomp filters.
	  Select libseccomp which also pulls-in the needed kernel features.

config LXC_NETWORKING
	bool "Enable networking support for LXC containers"
	default n
	select PACKAGE_kmod-veth
	select PACKAGE_kmod-macvlan
	help
	  Enable "veth pair device" and "macvlan"

endmenu
```

## customfeeds/packages/utils/mc/Config.in
```kconfig
menu "Configuration"
	depends on PACKAGE_mc

config MC_DIFFVIEWER
	bool "Enable internal diff viewer"
	default n
	help
           This option enables the built-in diff viewer.
           Disabled by default.

config MC_EDITOR
	bool "Enable internal editor"
	default y
	help
           This option enables the built-in file editor.
           Enabled by default.

config MC_SUBSHELL
	bool "Enable concurrent subshell"
	default y
	help
           This option enables concurrent subshell support.
           Enabled by default.

config MC_LARGEFILE
	bool "Enable largefile support"
	default n
	help
           This option enables support for large files (> 2 GB).
           Disabled by default.

config MC_BACKGROUND
	bool "Enable background operations"
	default n
	help
           This option enables support for background operations which
           allow to perform some tasks such as copying files in a
           separate background process. Background code is known
           to be less stable than the rest of the code.
           Disabled by default.

config MC_CHARSET
	bool "Enable charset support"
	default y
	help
           This option adds support for selecting character set of the text in
           the internal viewer and editor and converting it on the fly.
           Enabled by default.

config MC_VFS
	bool "Enable virtual filesystem support"
	default y
	help
           This option enables the Virtual File System switch code to get
           transparent access to the following file systems:
           cpio, tar, fish, sfs, ftp, sftp, extfs.
           Enabled by default.

endmenu
```

## customfeeds/packages/utils/owfs/Config.in
```kconfig
  menu "Customize libow"
    depends on PACKAGE_libow

    menu "Bus master and adapter support"
      config LIBOW_MASTER_USB
      bool "USB bus master support (requires libusb)"
      help
        Include support for USB adapters (NOT usb-serial adapters, which use
        kernel driver and are supported anyway).
        Turning this off will save ~13kB (and ~50kB weighting libusb dependency).
      default y

      config LIBOW_MASTER_I2C
      bool "I2C bus master (DS2482) support"
      default y
      help
        Include support for I2C adapters.
        Turning this feature off will save ~6kB.

      config LIBOW_MASTER_W1
      bool "Kernel W1 bus master support (requires kmod-w1)"
      help
        Support kernel 1-Wire bus masters (requires KConfig CONFIG_CONNECTOR=y
        and CONFIG_W1_CON=y).
        Turning this on will increase libow size by about 10kB.
      default n
    endmenu

    config LIBOW_ZEROCONF
    bool "Zeroconf/bonjour support"
    default y
    help
      Enable server process announcement using Zeroconf (Bonjour) protocol.
      Turning this feature on will increase owlib size by about 12kB.

    config LIBOW_DEBUG
    bool "Enable debug output (100+ kB)"
    default y
    help
      If you don't need to debug your 1-wire network, you can save as much as
      137kB disabling debug output.

    config LIBOW_OWTRAFFIC
    bool "Enable bus traffic reports"
    default n
    help
      Enable owfs traffic monitor. It's here purely for debugging purposes.
      Turning this on will increase libow size by about 3kB.
  endmenu
```

## customfeeds/packages/utils/parted/Config.in
```kconfig
menu "Configuration"
	depends on PACKAGE_parted

config PARTED_READLINE
	bool "Use readline library"
	depends on PACKAGE_parted
	default y

config PARTED_LVM2
	bool "Support LVM"
	depends on PACKAGE_parted
	default n

endmenu
```

## customfeeds/packages/utils/squashfs-tools/Config.in
```kconfig
config SQUASHFS_TOOLS_LZO_SUPPORT
	depends on PACKAGE_squashfs-tools-mksquashfs || PACKAGE_squashfs-tools-unsquashfs
	bool "Enable LZO support"
	select PACKAGE_liblzo
	default n

config SQUASHFS_TOOLS_LZ4_SUPPORT
	depends on PACKAGE_squashfs-tools-mksquashfs || PACKAGE_squashfs-tools-unsquashfs
	bool "Enable LZ4 support"
	select PACKAGE_liblz4
	default n

config SQUASHFS_TOOLS_XZ_SUPPORT
	depends on PACKAGE_squashfs-tools-mksquashfs || PACKAGE_squashfs-tools-unsquashfs
	bool "Enable XZ support"
	select PACKAGE_liblzma
	default y

config SQUASHFS_TOOLS_ZSTD_SUPPORT
	depends on PACKAGE_squashfs-tools-mksquashfs || PACKAGE_squashfs-tools-unsquashfs
	bool "Enable ZSTD support"
	select PACKAGE_libzstd
	default n
```

## customfeeds/packages/utils/yara/Config.in
```kconfig
if PACKAGE_yara
	comment "Optional modules"

	config YARA_module_magic
		bool "Magic module"
		default y
		help
		  Identify the type of the file based on the output of file command

	config YARA_module_cuckoo
		bool "Cuckoo module"
		default n
		help
		  Create rules based on behavioral info generated by a Cuckoo sandbox

	config YARA_module_dotnet
		bool "Dotnet module"
		default n
		help
		  The dotnet module allows you to create more fine-grained rules
		  for .NET files by using attributes and features of the .NET file format
endif
```
