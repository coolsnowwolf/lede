## customfeeds/packages/net/openconnect/Config.in
```kconfig
# openconnect avanced configuration

menu "Configuration"
	depends on PACKAGE_openconnect

choice
	prompt "SSL library"
	default OPENCONNECT_GNUTLS

config OPENCONNECT_GNUTLS
	bool "GnuTLS support"

config OPENCONNECT_OPENSSL
	bool "OpenSSL"

endchoice

config OPENCONNECT_STOKEN
	bool "stoken support"

endmenu
```

## customfeeds/packages/net/openssh/Config.in
```kconfig
if PACKAGE_openssh-server

config OPENSSH_LIBFIDO2
	bool
	default y
	prompt "Include libfido2 support in openssh-server"
	help
		OpenSSH version 8.2 added two new ssh authentication methods,
		namely `ecdsa_sk` and `ed25519_sk`. These two methods make use
		of hardware keys that implement the FIDO and FIDO2 protocols.
		In order to use these two types, libfido2 is required.
endif
```

## customfeeds/packages/net/privoxy/Config.in
```kconfig
if PACKAGE_privoxy

	comment "Shared libraries settings"

	config PRIVOXY_disable-pthread
		bool "Don't use POSIX libpthread (-5489b)"
		default n

	config PRIVOXY_disable-dynamic-pcre
		bool "Use the built-in, static pcre, even if libpcre is available (+25669b)"
		default n

	config PRIVOXY_disable-zlib
		bool "Don't use zlib to decompress data before filtering. (-1336b)"
		default n

	comment "Config options. Overwrites/ignore configuration file settings"

	config PRIVOXY_disable-toggle
		bool "Don't support temporary disable (+2797b)"
		default n

	config PRIVOXY_disable-force
		bool "Don't allow single-page disable (-434b)"
		default n

	config PRIVOXY_disable-fast-redirects
		bool "Don't support fast redirects (-1393b)"
		default n

	config PRIVOXY_disable-stats
		bool "Don't keep statistics (+2870b)"
		default n

	config PRIVOXY_enable-ie-images
		bool "Enable MS IE image handling. !Read help! (+2694b)"
		help
			Enable a quick but not always reliable auto-detect whether
			requests from MS Internet Explorer are for an image or not.
		default n

	config PRIVOXY_disable-image-blocking
		bool "Don't check for image request - assume HTML (-655b)"
		help
			Don't try to figure out whether a request is
			for an image or HTML - assume HTML.
		default n

	config PRIVOXY_disable-acl-support
		bool "Disable ACL access control (-3496b)"
		help
			Prevents the use of ACLs to control access to Privoxy by IP address.
		default n

	config PRIVOXY_disable-trust-files
		bool "Prevents the use of trust files. (-1302b)"
		default n

	config PRIVOXY_disable-editor
		bool "Disable web-based editor. !Read help! (-44979b)"
		help
			Prevents the use of the web-based actions file
			editor and web-based temporary disable setting.
		default n

	config PRIVOXY_enable-no-gifs
		bool "Use politically correct PNG format. !Read help! (+112b)"
		help
			Use politically correct PNG format instead of GIF
			for built-in images. May not work with all browsers.
		default n

	config PRIVOXY_enable-graceful-termination
		bool "Allow to shutdown Privoxy through the webinterface. (+1685b)"
		default n

	config PRIVOXY_enable-extended-host-patterns
		bool "Enable and require PCRE syntax in host patterns. !Read help! (-1329b)"
		help
			Enable and require PCRE syntax in host patterns. This feature hasn't
			been announced yet and it's not clear if it's a good idea. It's expected
			to work, but undocumented. You should only enable it if you know what
			PCRE is and are sure that you need it for your host patterns. You can
			use tools/url-pattern-translator.pl to convert existing action files to
			use PCRE host patterns. Please don't enable this option when creating
			packages for others that may not be expecting it.
		default n

	config PRIVOXY_enable-external-filters
		bool "Allow to filter content with scripts and programs. Experimental. (+4821b)"
		default n

	config PRIVOXY_enable-accept-filter
		bool "Try to use accf_http(9) if supported. (+-0b)"
		default n

	config PRIVOXY_enable-strptime-sanity-checks
		bool "Only trust strptime() results if ... !Read help! (+407b)"
		help
			Only trust strptime() results if an additional strftime()/strptime()
			conversion doesn't change the result. Can be useful if strptime() is
			known or suspected to be broken.
		default n

	config PRIVOXY_enable-compression
		bool "Allow Privoxy to compress buffered content. (+1275b)"
		help
			Allow Privoxy to compress buffered content 
			if the client supports it. Requires zlib support.
		depends on !PRIVOXY_no_zlib
		default n


endif
                
```

## customfeeds/packages/net/rsync/Config.in
```kconfig
if PACKAGE_rsync

	config RSYNC_xattr
		bool
		prompt "Enable xattr support"
		default y if USE_FS_ACL_ATTR
		default n

	config RSYNC_acl
		bool
		prompt "Enable ACL support"
		default y if USE_FS_ACL_ATTR
		default n

	config RSYNC_zstd
		bool
		prompt "Enable zstd stream compression"
		default n

endif
```

## customfeeds/packages/net/snort/Config.in
```kconfig
menu "Configuration"
	depends on PACKAGE_snort

config SNORT_LZMA
	bool "Enable LZMA support"
	default n
	help
           This option enables LZMA decompression.
           Disabled by default.

endmenu
```

## customfeeds/packages/net/squid/Config.in
```kconfig
if PACKAGE_squid

	comment "Optional features"

	config SQUID_enable-ipv6
		bool "Enable support for IP version 6"
		default y

	config SQUID_enable-snmp
		bool "Enable SNMP monitoring support"
		default n

	config SQUID_enable-icmp
		bool "Enable ICMP pinging and Network Measurement"
		default n

	config SQUID_enable-icap-client
		bool "Enable ICAP client support"
		default n

	config SQUID_enable-dlmalloc
		bool "Compile & use the malloc package by Doug Lea"
		default y

	config SQUID_enable-ssl-crtd
		bool "Enable dynamic SSL certificate generation "
		depends on !SQUID_use-gnutls
		default y

	config SQUID_auth-basic
		bool "Enable the Basic authentication scheme"
		default n

	config SQUID_auth-digest
		bool "Enable the Digest authentication scheme"
		default n

	config SQUID_auth-negotiate
		bool "Enable the Negotiate authentication scheme"
		default n

	config SQUID_auth-ntlm
		bool "Enable the NTLM authentication scheme"
		default n

	comment "Optional packages"

	choice
		prompt "Choose SSL Library"
		default SQUID_use-openssl

		config SQUID_use-openssl
		bool "Use OpenSSL (default)"

		config SQUID_use-gnutls
		bool "Use GnuTLS (experimental, see help)"
		help
			Use GnuTLS in place of OpenSSL for the core features of receiving
			TLS connections from clients and making TLS connections to servers.
			The GnuTLS support is still very much experimental and should be
			tested before use.

			SSL-Bump and certificate generation features are not yet supported
			by GnuTLS builds. Nor are many other less commonly used Squid
			TLS/SSL features.

			squid.conf directives and configuration options which have undergone
			name changes from 'ssl' to 'tls' prefix in Squid-4 have GnuTLS
			support, unless explicitly stated otherwise.

			Advanced configuration with specific selection of ciphers and
			similar settings should still work, but needs the GnuTLS Priority
			Strings instead of the OpenSSL options when using GnuTLS.
	endchoice

	config SQUID_with-libcap
		bool "Use libcap - Linux capabilities library"
		default n

	config SQUID_with-nettle
		bool "Use nettle - GNU crypto library"
		default n

	config SQUID_with-expat
		bool "Use expat - XML parsing library"
		default n

	config SQUID_with-libxml2
		bool "Use libxml2 - Gnome XML library"
		default n

	comment "Additional tools"

endif
```

## customfeeds/packages/net/strongswan/Config.in
```kconfig
if PACKAGE_strongswan
comment "Configuration"

# --with-routing-table
config STRONGSWAN_ROUTING_TABLE
	string
	prompt "Set the IPsec routing table ID"
	default "220"

#  --with-routing-table-prio
config STRONGSWAN_ROUTING_TABLE_PRIO
	string
	prompt "Set the IPsec routing table priority"
	default "220"

comment "Packages"

endif
```

## customfeeds/packages/net/vpnc/Config.in
```kconfig
# vpnc avanced configuration

menu "Configuration"
	depends on PACKAGE_vpnc

choice
	prompt "SSL library"
	default VPNC_GNUTLS

config VPNC_GNUTLS
	bool "GnuTLS support"

config VPNC_OPENSSL
	bool "OpenSSL"

endchoice

endmenu
```

## customfeeds/packages/net/zerotier/Config.in
```kconfig
menu "Configuration"
	depends on PACKAGE_zerotier

config ZEROTIER_ENABLE_DEBUG
	bool "Build in debug mode"
	depends on PACKAGE_zerotier
	default n

config ZEROTIER_ENABLE_SELFTEST
	bool "Build a self test program"
	depends on PACKAGE_zerotier
	default n

endmenu
```

## customfeeds/packages/net/znc/Config.in
```kconfig
#
# Copyright (C) 2010-2016 OpenWrt.org
#
# This is free software, licensed under the GNU General Public License v2.
# See /LICENSE for more information.
#

menu "Configuration"
  depends on PACKAGE_znc

config ZNC_ICU
  bool
  prompt "Enable ICU character encoding support."
  help
    Allows configuration of the charset used between clients and ZNC, and
    between ZNC and the IRC server".

endmenu
```

## customfeeds/packages/sound/fdk-aac/Config.in
```kconfig
menu "Configuration"
	depends on PACKAGE_fdk-aac

config FDK-AAC_OPTIMIZE_SPEED
	bool "Optimize for speed"
	default n
	help
		This enables additional optmization and 
		increases performance considerably at 
		the expense of binary size.

endmenu
```

## customfeeds/packages/sound/lame/Config.in
```kconfig
menu "Configuration"
	depends on PACKAGE_lame-lib

config LAME-LIB_OPTIMIZE_SPEED
	bool "Optimize for speed"
	default n
	help
		This enables additional experimental
		optmization and increases performance 
		considerably at the expense of binary size.

endmenu
```

## customfeeds/packages/sound/upmpdcli/Config.in
```kconfig
config PACKAGE_UPMPDCLI_SCCTL
	bool "scctl command for configuring SongCast receivers"
	default no
	depends on PACKAGE_upmpdcli
	help
		Installs the scctl command. See the following link for more info: 
		http://www.lesbonscomptes.com/upmpdcli/scmulti.html

config PACKAGE_UPMPDCLI_SC_WEB_INTERFACE
	bool "SongCast web server and associated files (depends on python)"
	default no
	depends on PACKAGE_upmpdcli
	select PACKAGE_python3
	select PACKAGE_UPMPDCLI_SCCTL
	help
		Installs the SongCast web interface and web server. See the following
		link for more info: http://www.lesbonscomptes.com/upmpdcli/scmulti.html
```

## customfeeds/packages/utils/btrfs-progs/Config.in
```kconfig
if PACKAGE_btrfs-progs

config BTRFS_PROGS_ZSTD
	bool "Build with zstd support"
	default n
	help
		This allows you to manage BTRFS with zstd compression

endif
```

## customfeeds/packages/utils/dockerd/Config.in
```kconfig
# These options are mostly specified by https://github.com/moby/moby/blob/master/contrib/check-config.sh

config DOCKER_CGROUP_OPTIONS
	bool "Enable available kernel support for CGroupsV1"
	default n
	depends on PACKAGE_dockerd
	select KERNEL_CGROUP_DEVICE
	select KERNEL_CGROUP_FREEZER
	select KERNEL_NET_CLS_CGROUP
	select KERNEL_CGROUP_NET_PRIO
	select PACKAGE_cgroupfs-mount
	help
		Selects kernel options to enable CGroups V1.

config DOCKER_OPTIONAL_FEATURES
	bool "Enable optional kernel support for Docker"
	default n
	depends on PACKAGE_dockerd
	select KERNEL_MEMCG_SWAP_ENABLED
	select KERNEL_CFQ_GROUP_IOSCHED
	select KERNEL_CGROUP_PERF
	select KERNEL_CGROUP_HUGETLB
	help
		Select 'Optional Features' kernel options for Docker that are unselected.
		See https://github.com/moby/moby/blob/master/contrib/check-config.sh

menu "Network"
	depends on PACKAGE_dockerd

	config DOCKER_NET_OVERLAY
		bool "Includes the Overlay network feature"
		default n
		select PACKAGE_kmod-vxlan
		help
			Selects kmod-vxlan for the Overlay network feature.

	config DOCKER_NET_ENCRYPT
		bool "Includes encrypted networking kernel modules"
		depends on DOCKER_NET_OVERLAY
		default n
		select PACKAGE_kmod-crypto-gcm
		select PACKAGE_kmod-crypto-seqiv
		select PACKAGE_kmod-crypto-ghash
		select PACKAGE_kmod-ipsec
		help
		  Select needed kernel modules for encrypted networking support.

	config DOCKER_NET_MACVLAN
		bool "Includes macvlan kernel modules"
		default n
		select PACKAGE_kmod-macvlan
		select PACKAGE_kmod-dummy

	config DOCKER_NET_TFTP
		bool "Includes ftp/tftp client kernel modules"
		default n
		select PACKAGE_kmod-nf-nathelper
		select PACKAGE_kmod-nf-nathelper-extra
endmenu

menu "Storage"
	depends on PACKAGE_dockerd

	config DOCKER_STO_EXT4
		bool "Enables support for ext3 or ext4 as the backing filesystem"
		default n
		select KERNEL_EXT4_FS_POSIX_ACL
		select KERNEL_EXT4_FS_SECURITY

	config DOCKER_STO_BTRFS
		bool "Enables support for btrfs as the backing filesystem"
		default n
		select KERNEL_BTRFS_FS_POSIX_ACL
endmenu
```

## customfeeds/packages/utils/haserl/Config.in
```kconfig
if PACKAGE_haserl

	config HASERL_with_lua
		bool
		default n

	comment "Lua support"

	config HASERL_shell_luac
		bool
		prompt "Support --shell=luac"
		select HASERL_with_lua
		default n
		help
			haserl(1):
			The luac "shell" is a precompiled lua chunk, so interactive
			editing and testing of scripts is not possible. However,
			haserl can be compiled with luac support only, and this
			allows lua support even in a small memory environment. All
			haserl lua features listed above are still available. (If
			luac is the only shell built into haserl, the
			haserl.loadfile is disabled, as the haserl parser is not
			compiled in.)

	config HASERL_shell_lua
		bool
		prompt "Support --shell=lua"
		select HASERL_with_lua
		default n
		help
			haserl(1):
			If compiled with lua support, --shell=lua will enable lua as the
			script language instead of bash shell.

endif
```
