## customfeeds/packages/net/fastd/Config.in
```kconfig
menu "Configuration"
	depends on PACKAGE_fastd

config FASTD_ENABLE_METHOD_CIPHER_TEST
	bool "Enable cipher-test method provider"
	depends on PACKAGE_fastd
	default n

config FASTD_ENABLE_METHOD_COMPOSED_GMAC
	bool "Enable composed-gmac method provider"
	depends on PACKAGE_fastd
	default y

config FASTD_ENABLE_METHOD_COMPOSED_UMAC
	bool "Enable composed-umac method provider"
	depends on PACKAGE_fastd
	default y

config FASTD_ENABLE_METHOD_GENERIC_GMAC
	bool "Enable generic-gmac method provider"
	depends on PACKAGE_fastd
	default y

config FASTD_ENABLE_METHOD_GENERIC_POLY1305
	bool "Enable generic-poly1305 method provider"
	depends on PACKAGE_fastd
	default n

config FASTD_ENABLE_METHOD_GENERIC_UMAC
	bool "Enable generic-umac method provider"
	depends on PACKAGE_fastd
	default y

config FASTD_ENABLE_METHOD_NULL
	bool "Enable null method"
	depends on PACKAGE_fastd
	default y


config FASTD_ENABLE_CIPHER_NULL
	bool "Enable the null cipher"
	depends on PACKAGE_fastd
	default y

config FASTD_ENABLE_CIPHER_SALSA20
	bool "Enable the Salsa20 cipher"
	depends on PACKAGE_fastd
	default n

config FASTD_ENABLE_CIPHER_SALSA2012
	bool "Enable the Salsa20/12 cipher"
	depends on PACKAGE_fastd
	default y


config FASTD_ENABLE_MAC_GHASH
	bool "Enable the GHASH message authentication code"
	depends on PACKAGE_fastd
	default y

config FASTD_ENABLE_MAC_UHASH
	bool "Enable the UHASH message authentication code"
	depends on PACKAGE_fastd
	default y


config FASTD_WITH_CAPABILITIES
	bool "Enable POSIX capability support"
	depends on PACKAGE_fastd
	default n

config FASTD_WITH_CMDLINE_USER
	bool "Include support for setting user/group related options on the command line"
	depends on PACKAGE_fastd
	default n

config FASTD_WITH_CMDLINE_LOGGING
	bool "Include support for setting logging related options on the command line"
	depends on PACKAGE_fastd
	default n

config FASTD_WITH_CMDLINE_OPERATION
	bool "Include support for setting options related to the VPN operation (like mode, interface, encryption method) on the command line"
	depends on PACKAGE_fastd
	default n

config FASTD_WITH_CMDLINE_COMMANDS
	bool "Include support for setting handler scripts (e.g. --on-up) on the command line"
	depends on PACKAGE_fastd
	default n

config FASTD_WITH_DYNAMIC_PEERS
	bool "Include support for dynamic peers (using on-verify handlers)"
	depends on PACKAGE_fastd
	default n

config FASTD_WITH_STATUS_SOCKET
	bool "Include support for status sockets"
	depends on PACKAGE_fastd
	default y

endmenu
```

## customfeeds/packages/net/freeradius3/Config.in
```kconfig
# FreeRADIUS avanced configuration

choice
	prompt "SSL library"
	default FREERADIUS3_OPENSSL
	depends on PACKAGE_freeradius3-common

config FREERADIUS3_NOSSL
	bool "No SSL support"

config FREERADIUS3_OPENSSL
	bool "OpenSSL"

endchoice
```

## customfeeds/packages/net/frr/Config.in
```kconfig
if PACKAGE_frr
comment "SSL support"

choice
        prompt "Selected SSL MD5 library"
        default FRR_INTERNAL

        config FRR_OPENSSL
                bool "OpenSSL"

        config FRR_INTERNAL
                bool "internal SSL support"
endchoice

comment "SNMP support"

choice
        prompt "Enable SNMP support"
        default FRR_NO_SNMP

        config FRR_SNMP
                bool "SNMP enable"

        config FRR_NO_SNMP
                bool "SNMP disable"
endchoice


comment "Packages"

endif
```

## customfeeds/packages/net/fwknop/Config.in
```kconfig
#fwknop config
menu "Configuration"
	depends on PACKAGE_fwknopd || PACKAGE_fwknop

config FWKNOPD_GPG
	bool "Enable GPG support"
	select PACKAGE_gnupg
	default n

config FWKNOPD_NFQ_CAPTURE
	bool "Enable netfilter_queue capture support (disables libpcap support)"
	select PACKAGE_iptables-mod-nfqueue
	default n

endmenu
```

## customfeeds/packages/net/ifstat/Config.in
```kconfig
        config IFSTAT_SNMP
                depends on PACKAGE_ifstat
                bool "Build with support for SNMP"
                default y
```

## customfeeds/packages/net/kadnode/Config.in
```kconfig
menu "Configuration"
	depends on PACKAGE_kadnode

config KADNODE_ENABLE_LPD
	bool "Enable Local Peer Discovery"
	depends on PACKAGE_kadnode
	default y

config KADNODE_ENABLE_CMD
	bool "Enable Command Console"
	depends on PACKAGE_kadnode
	default y

config KADNODE_ENABLE_DNS
	bool "Enable the local DNS server"
	depends on PACKAGE_kadnode
	default y

config KADNODE_ENABLE_TLS
	bool "Enable TLS authentication support"
	depends on PACKAGE_kadnode
	default y

config KADNODE_ENABLE_BOB
	bool "Enable BOB authentication support"
	depends on PACKAGE_kadnode
	default y

config KADNODE_ENABLE_UPNP
	bool "Enable UPnP support to add port forwardings on other routers"
	depends on PACKAGE_kadnode
	default n

config KADNODE_ENABLE_NATPMP
	bool "Enable NAT-PMP support to add port forwardings on other routers"
	depends on PACKAGE_kadnode
	default n

config KADNODE_ENABLE_DEBUG
	bool "Build in debug mode"
	depends on PACKAGE_kadnode
	default n

endmenu
```

## customfeeds/packages/net/keepalived/Config.in
```kconfig
if PACKAGE_keepalived

menu "Configuration"

config KEEPALIVED_BFD
	bool
	default n
	prompt "Enable BFD support"
	help
		Builds support for BFD

config KEEPALIVED_SHA1
	bool
	default y
	prompt "Enable SHA1 support in genhash"
	help
		Builds support for using SHA1 with genhash

config KEEPALIVED_LVS
	bool
	default y
	prompt "Enable IPVS support"
	help
		Builds support for IPVS

config KEEPALIVED_LVS_SYNCD
	depends on KEEPALIVED_LVS
	bool
	default y
	prompt "Enable IPVS syncd daemon control"
	help
		Builds support for configuring IPVS syncd daemon

config KEEPALIVED_LVS_64BIT_STATS
	depends on KEEPALIVED_LVS
	bool
	default y
	prompt "Enable IPVS 64 bit stats"
	help
		Builds support for IPVS 64 bit stats

config KEEPALIVED_FWMARK
	depends on KEEPALIVED_LVS
	bool
	default y
	prompt "Enable support for setting FWMARK on sockets"
	help
		Builds support for setting firewall mark on checker sockets

config KEEPALIVED_SNMP_CHECKER
	depends on KEEPALIVED_LVS
	bool
	default n
	prompt "Enable SNMP support for checker (LVS)"
	help
		Builds support for using SNMP with LVS

config KEEPALIVED_VRRP
	bool
	default y
	prompt "Enable VRRP support"
	help
		Builds support for VRRP

config KEEPALIVED_IPTABLES
	depends on KEEPALIVED_VRRP
	bool
	default y
	prompt "Enable iptables for VIP filtering"
	help
		Builds support for using iptables/ipsets for filtering packets
		to VIPs

config KEEPALIVED_SNMP_VRRP
	depends on KEEPALIVED_VRRP
	bool
	default n
	prompt "Enable SNMP support for VRRP"
	help
		Builds support for using SNMP with VRRP

config KEEPALIVED_SNMP_RFC2
	depends on KEEPALIVED_VRRP
	bool
	default n
	prompt "Enable SNMP support for VRRPv2 (RFC2787)"
	help
		Builds support for using RFC2787 SNMP support for VRRPv2

config KEEPALIVED_SNMP_RFC3
	depends on KEEPALIVED_VRRP
	bool
	default n
	prompt "Enable SNMP support for VRRPv3 (RFC6527)"
	help
		Builds support for using RFC6527 SNMP support for VRRPv3

config KEEPALIVED_SNMP_REPLY_V3_FOR_V2
	depends on KEEPALIVED_SNMP_RFC3
	bool
	default n
	prompt "Enable SNMP v3 responses for VRRPv2 instances"
	help
		Builds support for using SNMP v3 responses for VRRPv2 instances

config KEEPALIVED_DBUS
	depends on KEEPALIVED_VRRP
	bool
	default n
	prompt "Enable DBus support"
	help
		Builds support for using DBus with VRRP

config KEEPALIVED_JSON
	depends on KEEPALIVED_VRRP
	bool
	default n
	prompt "Enable JSON support with VRRP"
	help
		Builds support for using JSON output for VRRP

config KEEPALIVED_VRRP_AUTH
	depends on KEEPALIVED_VRRP
	bool
	default y
	prompt "Enable (removed) VRRPv2 authentication"
	help
		Builds support for using (removed) VRRPv2 authentication
		Note: authentication was removed from the VRRPv2 specification
		by RFC3768 in 2004.
		Use of this option is non-compliant and can cause problems.
		Avoid using if possible, except when using unicast, where it
		can be helpful.

config KEEPALIVED_CHECKSUM_COMPAT
	depends on KEEPALIVED_VRRP
	bool
	default y
	prompt "Enable checksum compatibility"
	help
		Builds support for interworking with instances using
		old(incorrect) checksum method

config KEEPALIVED_ROUTES
	depends on KEEPALIVED_VRRP
	bool
	default y
	prompt "Enable support for VRRP instances managing routes and rules"
	help
		Builds support for VRRP instances adding and removing IP
		routes and rules

config KEEPALIVED_LINKBEAT
	depends on KEEPALIVED_VRRP
	bool
	default y
	prompt "Enable support for linkbeat"
	help
		Builds support for using linkbeat polling to monitor the state
		of interfaces

endmenu

endif # PACKAGE_keepalived
```

## customfeeds/packages/net/knot-resolver/Config.in
```kconfig
menu "Configuration"
	config PACKAGE_knot-resolver_dnstap
		bool "Build with dnstap support"
		default n
		help
			knot-resolver dnstap module supports logging DNS responses
			to a unix socket in dnstap format using fstrm framing library.
			This logging is useful if you need effectivelly log all
			DNS traffic.
			The unix socket and the socket reader must be present before
			starting resolver instances.
endmenu
```

## customfeeds/packages/net/lora-gateway-hal/Config.in
```kconfig
# libloragw configuration

if PACKAGE_libloragw

config SX1301_SPI_PATH
	string "SPI Dev Path"
	default /dev/spidev0.0

config SX1301_SPI_SPEED
	string "SPI Speed (Hz)"
	default 8000000

endif
```

## customfeeds/packages/net/modemmanager/Config.in
```kconfig
menu "Configuration"
depends on PACKAGE_modemmanager

	config MODEMMANAGER_WITH_MBIM
		bool "Include MBIM support"
		default y
		help
		  Compile ModemManager with MBIM support

	config MODEMMANAGER_WITH_QMI
		bool "Include QMI support"
		default y
		help
		  Compile ModemManager with QMI support

        config MODEMMANAGER_WITH_AT_COMMAND_VIA_DBUS
                bool "Allow AT commands via DBus"
                default n
                help
                  Compile ModemManager allowing AT commands without debug flag
endmenu
```

## customfeeds/packages/net/mosquitto/Config.in
```kconfig
config MOSQUITTO_LWS
    bool "libwebsockets support"
    depends on PACKAGE_mosquitto-ssl
    default y
    help
        Includes websockets support in the broker, via libwebsockets

config MOSQUITTO_CTRL
    bool "Include mosquitto_ctrl utility"
    depends on PACKAGE_mosquitto-ssl
    default y
    help
        mosquitto_ctrl is a tool for managing the broker at run time.

config MOSQUITTO_DYNAMIC_SECURITY
    bool "Install mosquitto_dynamic_security.so"
    depends on PACKAGE_mosquitto-ssl
    default y
    help
        This enables the dynamic security modes documented at
        https://mosquitto.org/documentation/dynamic-security/
        but does add ~88kB.  If you're not using it, you can disable it

config MOSQUITTO_PASSWD
    bool "Include mosquitto_passwd utility"
    depends on PACKAGE_mosquitto-ssl
    default y
    help
        mosquitto_passwd is a tool for managing password files for mosquitto.
```

## customfeeds/packages/net/mstpd/Config.in
```kconfig
menu "Configuration"
	depends on PACKAGE_mstpd

config MSTPD_RTNL_RCV_BUFSIZE
	int "Netlink receive buffer size"
	default 262144

config MSTPD_RTNL_SND_BUFSIZE
	int "Netlink send buffer size"
	default 262144

endmenu
```

## customfeeds/packages/net/nfs-kernel-server/Config.in
```kconfig
menu "Select nfs-kernel-server configuration options"
        depends on PACKAGE_nfs-kernel-server

config NFS_KERNEL_SERVER_V4
	bool "Include support for NFSv4"
	default y

endmenu
```

## customfeeds/packages/net/nut/Config.in
```kconfig
	config NUT_SSL
		depends on PACKAGE_nut
		bool "Build with support for OpenSSL"
		help
			SSL allows sessions between upsd and clients to be encrypted and can
			also be used to authenticate servers. This means that stealing port
			3493 from upsd will no longer net you interesting passwords. SSL is
			available via OpenSSL on OpenWRT (NSS doesn't seem to work). If you
			are happy with using passwords to authenticate clients, you can save
			some space and build NUT without SSL support.
		default n
	
	config NUT_DRIVER_USB
		depends on PACKAGE_nut
		bool "Build with support for USB drivers"
		help
			If you have a UPS connected via USB, select this.
		default y
	
	config NUT_DRIVER_SNMP
		depends on PACKAGE_nut
		bool "Build with support for SNMP drivers"
		help
			If you have a UPS you can connect to via SNMP, select this.
		default n

	config NUT_DRIVER_SERIAL
		depends on PACKAGE_nut
		bool "Build with suport for serial drivers"
		help
			If you have a UPS connected via serial cable, select this.
		default y
```

## customfeeds/packages/net/ocserv/Config.in
```kconfig
# ocserv avanced configuration

menu "Configuration"
	depends on PACKAGE_ocserv

config OCSERV_PAM
	bool "enable PAM"
	default n

config OCSERV_SECCOMP
	bool "enable seccomp"
	depends on !arc
	default n

config OCSERV_RADIUS
	bool "enable radius authentication"
	default n

config OCSERV_PROTOBUF
	bool "use external libprotobuf"
	default y

config OCSERV_HTTP_PARSER
	bool "use external libhttp-parser"
	default y

endmenu
```
