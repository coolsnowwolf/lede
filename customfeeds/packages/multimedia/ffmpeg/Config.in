## customfeeds/packages/multimedia/gst1-libav/Config.in
```kconfig
menu "Select GStreamer libav configuration options"
	depends on PACKAGE_gst1-libav

config GST1_LIBAV_IPV6
	bool "Enable IPv6"
	default IPV6

config GST1_LIBAV_PATENTED
	bool "Include patented codecs and technologies"
	default BUILD_PATENTED

config GET_LIBAV_COMMON_AV_SUPPORT
	bool "Include support for common audio/video decoders"
	default y
	select GST1_LIBAV_DECODER_aac if GST1_LIBAV_PATENTED
	select GST1_LIBAV_DECODER_ac3
	select GST1_LIBAV_DECODER_h264 if GST1_LIBAV_PATENTED
	select GST1_LIBAV_DECODER_atrac3 if GST1_LIBAV_PATENTED
	select GST1_LIBAV_DECODER_jpegls
	select GST1_LIBAV_DECODER_mp3
	select GST1_LIBAV_DECODER_mpeg1video
	select GST1_LIBAV_DECODER_mpeg2video
	select GST1_LIBAV_DECODER_mpeg4 if GST1_LIBAV_PATENTED
	select GST1_LIBAV_DECODER_mpeg4aac if GST1_LIBAV_PATENTED
	select GST1_LIBAV_DECODER_mpegvideo
	select GST1_LIBAV_DECODER_pcm_s16be
	select GST1_LIBAV_DECODER_pcm_s16le
	select GST1_LIBAV_DECODER_vorbis
	select GST1_LIBAV_DECODER_wmav1 if GST1_LIBAV_PATENTED
	select GST1_LIBAV_DECODER_wmav2 if GST1_LIBAV_PATENTED
	select GST1_LIBAV_DECODER_png
	select GST1_LIBAV_PARSER_aac if GST1_LIBAV_PATENTED
	select GST1_LIBAV_PARSER_h264 if GST1_LIBAV_PATENTED
	select GST1_LIBAV_PARSER_mpegaudio
	select GST1_LIBAV_PARSER_mpegvideo
	select GST1_LIBAV_PARSER_mpeg4video
	select GST1_LIBAV_DEMUXER_ac3
	select GST1_LIBAV_DEMUXER_h264 if GST1_LIBAV_PATENTED
	select GST1_LIBAV_DEMUXER_mp3
	select GST1_LIBAV_DEMUXER_mpegvideo
	select GST1_LIBAV_DEMUXER_ogg

comment "Encoders ---"

config GST1_LIBAV_ENCODER_ac3
	bool "AC3"
	select GST1_LIBAV_PARSER_ac3

config GST1_LIBAV_ENCODER_jpegls
	bool "JPEG-LS"

config GST1_LIBAV_ENCODER_mpeg1video
	bool "MPEG-1 Video"

config GST1_LIBAV_ENCODER_mpeg2video
	bool "MPEG-2 Video"

config GST1_LIBAV_ENCODER_mpeg4
	bool "MPEG-4"
	depends on GST1_LIBAV_PATENTED

config GST1_LIBAV_ENCODER_pcm_s16be
	bool "PCM signed 16-bit big-endian"

config GST1_LIBAV_ENCODER_pcm_s16le
	bool "PCM signed 16-bit little-endian"

config GST1_LIBAV_ENCODER_png
	bool "PNG"
	select GST1_LIBAV_ENCODER_zlib

config GST1_LIBAV_ENCODER_vorbis
	bool "Vorbis"

config GST1_LIBAV_ENCODER_zlib
	bool "Zlib"

comment "Decoders ---"

config GST1_LIBAV_DECODER_aac
	bool "AAC (Advanced Audio Coding)"
	depends on GST1_LIBAV_PATENTED
	select GST1_LIBAV_PARSER_aac

config GST1_LIBAV_DECODER_ac3
	bool "AC3"
	select GST1_LIBAV_PARSER_ac3

config GST1_LIBAV_DECODER_atrac3
	bool "ATRAC3"
	depends on GST1_LIBAV_PATENTED

config GST1_LIBAV_DECODER_gif
	bool "GIF"

config GST1_LIBAV_DECODER_h264
	bool "H.264"
	depends on GST1_LIBAV_PATENTED

config GST1_LIBAV_DECODER_jpegls
	bool "JPEG-LS"

config GST1_LIBAV_DECODER_mp2
	bool "MP2 (MPEG Audio Layer 2)"

config GST1_LIBAV_DECODER_mp3
	bool "MP3 (MPEG Audio Layer 2)"

config GST1_LIBAV_DECODER_mpegvideo
	bool "MPEG Video"

config GST1_LIBAV_DECODER_mpeg1video
	bool "MPEG-1 Video"

config GST1_LIBAV_DECODER_mpeg2video
	bool "MPEG-2 Video"

config GST1_LIBAV_DECODER_mpeg4
	bool "MPEG-4"
	depends on GST1_LIBAV_PATENTED

config GST1_LIBAV_DECODER_mpeg4aac
	bool "MPEG-4 (AAC)"
	depends on GST1_LIBAV_PATENTED

config GST1_LIBAV_DECODER_pcm_s16be
	bool "PCM signed 16-bit big-endian"

config GST1_LIBAV_DECODER_pcm_s16le
	bool "PCM signed 16-bit little-endian"

config GST1_LIBAV_DECODER_png
	bool "PNG"
	select GST1_LIBAV_DECODER_zlib

config GST1_LIBAV_DECODER_vorbis
	bool "Vorbis"

config GST1_LIBAV_DECODER_wmav1
	bool "WMAv1"
	depends on GST1_LIBAV_PATENTED

config GST1_LIBAV_DECODER_wmav2
	bool "WMAv2"
	depends on GST1_LIBAV_PATENTED

config GST1_LIBAV_DECODER_zlib
	bool "Zlib"

comment "Muxers ---"

config GST1_LIBAV_MUXER_ac3
	bool "AC3"

config GST1_LIBAV_MUXER_ffm
	bool "FFM (ffserver live feed)"

config GST1_LIBAV_MUXER_h264
	bool "H.264"
	depends on GST1_LIBAV_PATENTED

config GST1_LIBAV_MUXER_mp3
	bool "MP3 (MPEG Audio Layer 3)"

config GST1_LIBAV_MUXER_mp4
	bool "MP4"

config GST1_LIBAV_MUXER_mpeg1video
	bool "MPEG-1 Video"

config GST1_LIBAV_MUXER_mpeg2video
	bool "MPEG-2 Video"

config GST1_LIBAV_MUXER_mpegts
	bool "MPEG-2 (TS)"

config GST1_LIBAV_MUXER_ogg
	bool "Ogg"

config GST1_LIBAV_MUXER_oss
	bool "OSS (Open Sound System playback)"

config GST1_LIBAV_MUXER_rtp
	bool "RTP"

comment "Demuxers ---"

config GST1_LIBAV_DEMUXER_ac3
	bool "AC3"

config GST1_LIBAV_DEMUXER_ffm
	bool "FFM (ffserver live feed)"

config GST1_LIBAV_DEMUXER_h264
	bool "H.264"
	depends on GST1_LIBAV_PATENTED

config GST1_LIBAV_DEMUXER_mp3
	bool "MP3 (MPEG Audio Layer 3)"

config GST1_LIBAV_DEMUXER_mpegvideo
	bool "MPEG Video"

config GST1_LIBAV_DEMUXER_mpegps
	bool "MPEG-2 (PS)"

config GST1_LIBAV_DEMUXER_mpegts
	bool "MPEG-2 (TS)"

config GST1_LIBAV_DEMUXER_ogg
	bool "Ogg"

config GST1_LIBAV_DEMUXER_rm
	bool "RM"
	help
	  RealMedia format demuxer

config GST1_LIBAV_DEMUXER_rtsp
	bool "RTSP"
	select GST1_LIBAV_DEMUXER_rm
	select GST1_LIBAV_DEMUXER_sdp

config GST1_LIBAV_DEMUXER_sdp
	bool "SDP"
	select GST1_LIBAV_DEMUXER_mpegts

comment "Parsers ---"

config GST1_LIBAV_PARSER_aac
	bool "AAC (Advanced Audio Coding)"
	depends on GST1_LIBAV_PATENTED

config GST1_LIBAV_PARSER_ac3
	bool "AC3"

config GST1_LIBAV_PARSER_h264
	bool "H.264"
	depends on GST1_LIBAV_PATENTED
	select GST1_LIBAV_DECODER_h264

config GST1_LIBAV_PARSER_mpegaudio
	bool "MPEG Audio"

config GST1_LIBAV_PARSER_mpegvideo
	bool "MPEG Video"

config GST1_LIBAV_PARSER_mpeg4video
	bool "MPEG-4 Video"

comment "Protocols ---"

config GST1_LIBAV_PROTOCOL_file
	bool "file:"

config GST1_LIBAV_PROTOCOL_http
	bool "http:"

config GST1_LIBAV_PROTOCOL_pipe
	bool "pipe:"

config GST1_LIBAV_PROTOCOL_rtp
	bool "rtp:"
	select GST1_LIBAV_PROTOCOL_udp

config GST1_LIBAV_PROTOCOL_tcp
	bool "tcp:"

config GST1_LIBAV_PROTOCOL_udp
	bool "udp:"

endmenu
```

## customfeeds/packages/multimedia/tvheadend/Config.in
```kconfig
config TVHEADEND_CWC_SUPPORT
	bool "NewCamd support"
	default y

config TVHEADEND_LINUXDVB_SUPPORT
	bool "Linux DVB support"
	default y

config TVHEADEND_DVBSCAN_SUPPORT
	bool "Fetch DVB-scan data"
	depends on TVHEADEND_LINUXDVB_SUPPORT
	default TVHEADEND_LINUXDVB_SUPPORT

config TVHEADEND_AVAHI_SUPPORT
	bool "Avahi client support"
	select PACKAGE_libavahi-client
	default n
```

## customfeeds/packages/net/aircrack-ng/Config.in
```kconfig
if PACKAGE_aircrack-ng

comment "SSL support"

choice
    prompt "Select SSL library"
    default AIRCRACK_NG_OPENSSL

    config AIRCRACK_NG_OPENSSL
        bool "openssl"

    config AIRCRACK_NG_GCRYPT
        bool "gcrypt"
endchoice

config AIRCRACK_NG_OPTIMIZE_SPEED
    bool "Optimize for speed"
    default n
    help
        This enables additional optimization and
        increases performance considerably at the
        expense of binary size.

comment "Miscellaneous"

config AIRCRACK_NG_HWLOC
    bool "Hwloc support"
    default n

config AIRCRACK_NG_SQLITE3
    bool "Sqlite3 support"
    default n

endif
```

## customfeeds/packages/net/aria2/Config.in
```kconfig
menu "Aria2 Configuration"
	depends on PACKAGE_aria2

choice
	prompt "SSL Library"
	default ARIA2_OPENSSL

config ARIA2_OPENSSL
	bool "OpenSSL"

config ARIA2_GNUTLS
	bool "GnuTLS"

config ARIA2_NOSSL
	bool "No SSL Support"

endchoice

choice
	prompt "Crypto Library"
	depends on !ARIA2_OPENSSL
	default ARIA2_NOCRYPTO

config ARIA2_NETTLE
	bool "Nettle"

config ARIA2_LIBGCRYPT
	bool "Libgcrypt"

config ARIA2_NOCRYPTO
	bool "No Crypto Library"

endchoice

choice
	prompt "XML Library"
	default ARIA2_NOXML

config ARIA2_LIBXML2
	bool "Libxml2"

config ARIA2_EXPAT
	bool "Expat"

config ARIA2_NOXML
	bool "No XML Library"

endchoice

config ARIA2_GMP
	bool "GNU Multiple Precision Arithmetic Library"
	depends on ARIA2_NETTLE
	default n

config ARIA2_BITTORRENT
	bool "Enable Bittorrent Support"
	depends on ARIA2_OPENSSL || ARIA2_LIBGCRYPT || \
		(ARIA2_NETTLE && ARIA2_GMP)
	default y

config ARIA2_METALINK
	bool "Enable Metalink Support"
	depends on !ARIA2_NOXML
	default n

config ARIA2_SFTP
	bool "Enable SFTP Support"
	default n

config ARIA2_ASYNC_DNS
	bool "Enable Async DNS Support"
	default n

config ARIA2_COOKIE
	bool "Enable Firefox3/Chromium Cookie Support"
	default n

config ARIA2_WEBSOCKET
	bool "Enable JSON-RPC over WebSocket Support"
	depends on ARIA2_OPENSSL || ARIA2_LIBGCRYPT || ARIA2_NETTLE
	default y

endmenu
```

## customfeeds/packages/net/bind/Config.in
```kconfig
if PACKAGE_bind-server

config BIND_LIBJSON
	bool
	default n
	prompt "Include libjson support in bind-server"
	help
		BIND 9 supports reporting statistics about usage. libjson
		is required to report server statistics in JSON format. 
		Building with libjson support will require the libjson-c
		package to be installed as well.

config BIND_LIBXML2
	bool
	default n
	prompt "Include libxml2 support in bind-server"
	help
		BIND 9 supports reporting statistics about usage. 
		libxml2 is required to report server statistics in XML
		format. Building with libjson support will require the
		libxml2 package to be installed as well.
endif
```

## customfeeds/packages/net/bwm-ng/Config.in
```kconfig
# bwm-ng advanced configuration

menu "Configuration"
	depends on PACKAGE_bwm-ng

config BWMNG_CONFIGFILE
	bool "enable configfile support"
	default n

config BWMNG_HTML
	bool "enable html output"
	default n

config BWMNG_CSV
	bool "enable csv output"
	default n

config BWMNG_EXTENDEDSTATS
	bool "enable max, sum and avg stats"
	default y

config BWMNG_LIBNCURSES
	bool "enable libncurses support"
	default n

config BWMNG_TIME
	bool "enable accurate time calculating"
	default y

config BWMNG_GETOPT_LONG
	bool "enable long options"
	default n

endmenu
```

## customfeeds/packages/net/coova-chilli/Config.in
```kconfig
# CoovaChilli advanced configuration

if PACKAGE_coova-chilli

config COOVACHILLI_PROXY
	bool "Enable support for chilli proxy. Required for AAA Proxy through http"
	default n

config COOVACHILLI_REDIR
	bool "Enable support for redir server. Required for uamregex"
	default n

config COOVACHILLI_MINIPORTAL
	bool "Enable support Coova miniportal"
	default n

config COOVACHILLI_USERAGENT
	bool "Enable recording user-agent"
	default n

config COOVACHILLI_UAMDOMAINFILE
	bool "Enable loading of mass uamdomains from file"
	default n

config COOVACHILLI_LARGELIMITS
	bool "Enable larger limits for use with non-embedded systems"
	default n

config COOVACHILLI_JSONINTERFACE
	bool "Enable the JSON interface for the CoovaChilli Controller"
	default n

choice
	prompt "SSL library"
	default COOVACHILLI_NOSSL

config COOVACHILLI_NOSSL
	bool "No SSL support"

config COOVACHILLI_WOLFSSL
	bool "wolfSSL"

config COOVACHILLI_OPENSSL
	bool "OpenSSL"

endchoice

endif
```

## customfeeds/packages/net/curl/Config.in
```kconfig
if PACKAGE_libcurl

comment "SSL support"

choice
	prompt "Selected SSL library"
	default LIBCURL_OPENSSL

	config LIBCURL_MBEDTLS
		bool "mbed TLS"

	config LIBCURL_WOLFSSL
		bool "wolfSSL"

	config LIBCURL_OPENSSL
		bool "OpenSSL"

	config LIBCURL_GNUTLS
		bool "GNUTLS"

	config LIBCURL_NOSSL
		bool "No SSL support"

endchoice

comment "Supported protocols"

config LIBCURL_DICT
	bool "DICT protocol"
	default n

config LIBCURL_FILE
	bool "FILE protocol"
	default y

config LIBCURL_FTP
	bool "FTP / FTPS protocol"
	default y

config LIBCURL_GOPHER
	bool "Gopher protocol"
	default n

config LIBCURL_HTTP
	bool "HTTP / HTTPS protocol"
	default y

config LIBCURL_COOKIES
	bool "Enable Cookies support"
	depends on LIBCURL_HTTP
	default y

config LIBCURL_IMAP
	bool "IMAP / IMAPS protocol"
	default n

config LIBCURL_LDAP
	bool "LDAP protocol"
	default n

config LIBCURL_LDAPS
	bool "Enable LDAPS support"
	depends on LIBCURL_LDAP && !LIBCURL_NOSSL
	default y

config LIBCURL_POP3
	bool "POP3 / POP3S protocol"
	default n

config LIBCURL_RTSP
	bool "RTSP protocol"
	depends on LIBCURL_HTTP
	default n
config LIBCURL_NO_RTSP
	string "RTSP require HTTP protocol"
	depends on !LIBCURL_HTTP
	default "!"

config LIBCURL_SSH2
	bool "SCP / SFTP protocol"
	default n

config LIBCURL_SMB
	bool "SMB protocol (CIFS)"
	depends on LIBCURL_CRYPTO_AUTH && (LIBCURL_GNUTLS || LIBCURL_OPENSSL)
	default n
config LIBCURL_NO_SMB
	string "SMB require 'cryptographic authentication' and either 'GnuTLS' or 'OpenSSL'"
	depends on !LIBCURL_CRYPTO_AUTH || (!LIBCURL_GNUTLS && !LIBCURL_OPENSSL)
	default "!"

config LIBCURL_SMTP
	bool "SMTP / SMTPS protocol"
	default n

config LIBCURL_TELNET
	bool "TELNET protocol"
	default n

config LIBCURL_TFTP
	bool "TFTP protocol"
	default n

config LIBCURL_NGHTTP2
	bool "HTTP2 protocol"
	default n

comment "Miscellaneous"

config LIBCURL_PROXY
	bool "Enable proxy support"
	default y

config LIBCURL_CRYPTO_AUTH
	bool "Enable cryptographic authentication"
	default n

config LIBCURL_TLS_SRP
	bool "Enable TLS-SRP authentication"
	default n

config LIBCURL_LIBIDN2
	bool "Enable IDN2 support"
	default n

config LIBCURL_THREADED_RESOLVER
	bool "Enable threaded DNS resolver"
	default n
	help
		Enable POSIX threaded asynchronous DNS resolution

config LIBCURL_ZLIB
	bool "Enable zlib support"
	default n

config LIBCURL_ZSTD
	bool "Enable zstd support"
	default n

config LIBCURL_UNIX_SOCKETS
	bool "Enable unix domain socket support"
	default n
	help
		Enable HTTP over unix domain sockets.
		To use this with the curl command line, you specify the socket path to the new --unix-domain option.
		This feature is actually not limited to HTTP, you can do all the TCP-based protocols 
		except FTP over the unix domain socket, but it is only HTTP that is regularly used this way. 
		The reason FTP isn't supported is of course its use of two connections 
		which would be even weirder to do like this.

config LIBCURL_LIBCURL_OPTION
	bool "Enable generation of C code"
	default n

config LIBCURL_VERBOSE
	bool "Enable verbose error strings"
	default n

config LIBCURL_NTLM
	bool "Enable NTLM support"
	depends on LIBCURL_CRYPTO_AUTH && !LIBCURL_NOSSL
	default n

endif
```

## customfeeds/packages/net/dnscrypt-proxy/Config.in
```kconfig
menu "Configuration"
	depends on PACKAGE_dnscrypt-proxy

config DNSCRYPT_ENABLE_PLUGINS
	bool "Enable plugin support (includes libldns and plugins, increases size by 125kB)"
	default n

endmenu
```
