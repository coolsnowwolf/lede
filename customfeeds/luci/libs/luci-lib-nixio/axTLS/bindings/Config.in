## customfeeds/luci/libs/luci-lib-nixio/axTLS/bindings/Config.in
```kconfig
#
# For a description of the syntax of this configuration file,
# see scripts/config/Kconfig-language.txt
#
menu "Language Bindings"

config CONFIG_BINDINGS
    bool "Create language bindings"
    default n
    help
        axTLS supports language bindings in C#, VB.NET, Java and Perl.

        Select Y here if you want to build the various language bindings.

config CONFIG_CSHARP_BINDINGS
    bool "Create C# bindings"
    default n
    depends on CONFIG_BINDINGS
    help
        Build C# bindings.

        This requires .NET to be installed on Win32 platforms and mono to be
        installed on all other platforms.

config CONFIG_VBNET_BINDINGS
    bool "Create VB.NET bindings"
    default n
    depends on CONFIG_BINDINGS
    help
        Build VB.NET bindings.

        This requires the .NET to be installed and is only built under Win32
        platforms.

menu ".Net Framework"
depends on CONFIG_CSHARP_BINDINGS || CONFIG_VBNET_BINDINGS
config CONFIG_DOT_NET_FRAMEWORK_BASE
    string "Location of .NET Framework"
    default "c:\\WINDOWS\\Microsoft.NET\\Framework\\v2.0.50727"
endmenu

config CONFIG_JAVA_BINDINGS
    bool "Create Java bindings"
    default n
    depends on CONFIG_BINDINGS
    help
        Build Java bindings.

        Current Issues (see README): 
        * Needs Java 1.4 or better.
        * If building under Win32 it will use the Win32 JDK.

menu "Java Home"
depends on CONFIG_JAVA_BINDINGS
config CONFIG_JAVA_HOME
    string "Location of JDK"
    default "c:\\Program Files\\Java\\jdk1.5.0_06" if CONFIG_PLATFORM_WIN32 || CONFIG_PLATFORM_CYGWIN
    default "/usr/local/jdk142" if !CONFIG_PLATFORM_WIN32 && !CONFIG_PLATFORM_CYGWIN
    depends on CONFIG_JAVA_BINDINGS 
    help
        The location of Sun's JDK.
endmenu

config CONFIG_PERL_BINDINGS
    bool "Create Perl bindings"
    default n
    depends on CONFIG_BINDINGS
    help
        Build Perl bindings.

        Current Issues (see README):
        * 64 bit versions don't work at present.
        * libperl.so needs to be in the shared library path.

menu "Perl Home"
depends on CONFIG_PERL_BINDINGS && CONFIG_PLATFORM_WIN32
config CONFIG_PERL_CORE
    string "Location of Perl CORE"
    default "c:\\perl\\lib\\CORE"
    help:
        works with ActiveState
        "http://www.activestate.com/Products/ActivePerl"

config CONFIG_PERL_LIB
    string "Name of Perl Library"
    default "perl58.lib"
endmenu

config CONFIG_LUA_BINDINGS
    bool "Create Lua bindings"
    default n
    depends on CONFIG_BINDINGS && !CONFIG_PLATFORM_WIN32
    help
        Build Lua bindings (see www.lua.org).

menu "Lua Home"
depends on CONFIG_LUA_BINDINGS 
config CONFIG_LUA_CORE
    string "Location of Lua CORE"
    default "/usr/local"
    help:
        If the Lua exists on another directory then this needs to be changed
endmenu

endmenu
```

## customfeeds/luci/libs/luci-lib-nixio/axTLS/config/Config.in
```kconfig
#
# For a description of the syntax of this configuration file,
# see scripts/config/Kconfig-language.txt
#

mainmenu "axTLS Configuration"

config HAVE_DOT_CONFIG
    bool
    default y

choice 
    prompt "Platform"
    default CONFIG_PLATFORM_LINUX

config CONFIG_PLATFORM_LINUX
    bool "Linux"

config CONFIG_PLATFORM_CYGWIN
    bool "Cygwin"

config CONFIG_PLATFORM_WIN32
    bool "Win32"

endchoice 

menu "General Configuration"

config PREFIX
    string "axTLS installation prefix"
    depends on !CONFIG_PLATFORM_WIN32
    default "/usr/local"
    help
      Define your directory to install axTLS files/subdirs in.

config CONFIG_DEBUG
    bool "Build axTLS with Debugging symbols"
    default n
    help
      Say Y here if you wish to compile axTLS with debugging symbols.
      This will allow you to use a debugger to examine axTLS internals.  
      This increases the size of the binary considerably and should only be 
      used when doing development.
      If you are doing development and want to debug axTLS, answer Y.

      Most people should answer N.

config CONFIG_STRIP_UNWANTED_SECTIONS
    depends on !CONFIG_PLATFORM_WIN32 && !CONFIG_DEBUG
    bool "Strip unwanted sections from elf binaries"
    default y
    help
        Strip unwanted sections from the resulting binaries

menu "Microsoft Compiler Options"
depends on CONFIG_PLATFORM_WIN32

choice 
    prompt "Compiler"
    depends on CONFIG_PLATFORM_WIN32
    default CONFIG_VISUAL_STUDIO_7_0

config CONFIG_VISUAL_STUDIO_7_0
    bool "Visual Studio 7.0 (2003)"
    help 
        Use Microsoft's Visual Studio 2003 platform.

config CONFIG_VISUAL_STUDIO_8_0
    bool "Visual Studio 8.0 (2005)"
    help 
        Use Microsoft's Visual Studio 2005 platform.

endchoice

config CONFIG_VISUAL_STUDIO_7_0_BASE
    string "Base"
    depends on CONFIG_VISUAL_STUDIO_7_0
    default "c:\\Program Files\\Microsoft Visual Studio .NET 2003"

config CONFIG_VISUAL_STUDIO_8_0_BASE
    string "Base"
    depends on CONFIG_VISUAL_STUDIO_8_0
    default "c:\\Program Files\\Microsoft Visual Studio 8"

endmenu

config CONFIG_EXTRA_CFLAGS_OPTIONS
    string "Any extra CFLAGS options for the compiler?"
    help
        Do you want to pass any extra CFLAGS options to the compiler as  
        you build axTLS? If so, this is the option for you...  For
        example, if you want to add some simple compiler switches (like
        -march=i686), or check for warnings using -Werror, just those 
        options here.

config CONFIG_EXTRA_LDFLAGS_OPTIONS
    string "Any extra LDFLAGS options for the compiler?"
    help
        Do you want to pass any extra LDFLAGS options to the compiler?

endmenu

source ssl/Config.in
config CONFIG_AXHTTPD
    bool "Enable HTTP/HTTPS Web Server"
    default y
    help
        Build the AXHTTPD web server

source httpd/Config.in
source bindings/Config.in
source samples/Config.in
source ssl/BigIntConfig.in
```

## customfeeds/luci/libs/luci-lib-nixio/axTLS/httpd/Config.in
```kconfig
#
# For a description of the syntax of this configuration file,
# see scripts/config/Kconfig-language.txt
#

menu "Axhttpd Configuration"
depends on CONFIG_AXHTTPD

config CONFIG_HTTP_STATIC_BUILD
    bool "Static Build"
    default n
    help
        Select y if you want axhttpd to be a static build (i.e. don't use the
        axtls shared library or dll).
        
config CONFIG_HTTP_PORT
    int "HTTP port"
    default 80
    help
        The port number of the normal HTTP server. 

        You must be a root user in order to use the default port.

config CONFIG_HTTP_HTTPS_PORT
    int "HTTPS port"
    default 443
    help
        The port number of the HTTPS server.

        You must be a root user in order to use the default port.

config CONFIG_HTTP_SESSION_CACHE_SIZE
    int "SSL session cache size"
    default 5
    help
        The size of the SSL session cache.
        
        This is not actually related to the number of concurrent users, but 
        for optimum performance they should be the same (with a penalty 
        in memory usage).

config CONFIG_HTTP_WEBROOT
    string "Web root location"
    default "../www" if !CONFIG_PLATFORM_WIN32
    default "..\\www" if CONFIG_PLATFORM_WIN32
    help
        The location of the web root in relation to axhttpd. This is 
        the directory where index.html lives.

config CONFIG_HTTP_TIMEOUT
    int "Timeout"
    default 300
    help
        Set the timeout of a connection in seconds.

menu "CGI"
depends on !CONFIG_PLATFORM_WIN32

config CONFIG_HTTP_HAS_CGI
    bool "Enable CGI"
    default y
    depends on !CONFIG_PLATFORM_WIN32
    help
        Enable the CGI capability. Not available on Win32 platforms.

config CONFIG_HTTP_CGI_EXTENSIONS
    string "CGI File Extension(s)"
    default ".lua,.lp"
    depends on CONFIG_HTTP_HAS_CGI
    help
        Tell axhhtpd what file extension(s) are used for CGI.

        This is a comma separated list - e.g. ".php,.pl" etc

config CONFIG_HTTP_ENABLE_LUA
    bool "Enable Lua"
    default y
    depends on CONFIG_HTTP_HAS_CGI
    help
        Lua is a powerful, fast, light-weight, embeddable scripting language.

        See http://www.lua.org for details.

config CONFIG_HTTP_LUA_PREFIX
    string "Lua's Installation Prefix"
    default "/usr/local"
    depends on CONFIG_HTTP_ENABLE_LUA

    help
        The location of Lua's installation prefix. This is also necessary for
        Lua's cgi launcher application.

config CONFIG_HTTP_LUA_CGI_LAUNCHER
    string "CGI launcher location"
    default "/bin/cgi.exe" if CONFIG_PLATFORM_CYGWIN
    default "/bin/cgi" if !CONFIG_PLATFORM_CYGWIN
    depends on CONFIG_HTTP_ENABLE_LUA
    help
        The location of LUA's CGI launcher application (after
        the CONFIG_HTTP_LUA_PREFIX)

config CONFIG_HTTP_BUILD_LUA
    bool "Build Lua"
    default n
    depends on CONFIG_HTTP_ENABLE_LUA
    help
        Build Lua and install in /usr/local/bin

endmenu

config CONFIG_HTTP_DIRECTORIES
    bool "Enable Directory Listing"
    default y
    help
        Enable directory listing.
    
config CONFIG_HTTP_HAS_AUTHORIZATION
    bool "Enable authorization"
    default y
    help
        Pages/directories can have passwords associated with them.

config CONFIG_HTTP_HAS_IPV6
    bool "Enable IPv6"
    default n
    depends on !CONFIG_PLATFORM_WIN32
    help
        Use IPv6 instead of IPv4.
    
        Does not work under Win32

config CONFIG_HTTP_ENABLE_DIFFERENT_USER
    bool "Enable different user"
    default n
    depends on !CONFIG_PLATFORM_WIN32
    help
        Allow the web server to be run as a different user
    
config CONFIG_HTTP_USER
    string "As User"
    default "nobody"
    depends on CONFIG_HTTP_ENABLE_DIFFERENT_USER
    help
        The user name that will be used to run axhttpd.

config CONFIG_HTTP_VERBOSE
    bool "Verbose Mode"
    default y if CONFIG_SSL_FULL_MODE
    default n if !CONFIG_SSL_FULL_MODE
    help
        Enable extra statements used when using axhttpd.

config CONFIG_HTTP_IS_DAEMON
    bool "Run as a daemon"
    default n
    depends on !CONFIG_PLATFORM_WIN32
    help 
        Run axhttpd as a background process.

        Does not work under Win32

endmenu
```

## customfeeds/luci/libs/luci-lib-nixio/axTLS/samples/Config.in
```kconfig
#
# For a description of the syntax of this configuration file,
# see scripts/config/Kconfig-language.txt
#
menu "Samples"

config CONFIG_SAMPLES
    bool "Create Samples"
    default y
    help
        axTLS contains various sample code.

        Select Y here if you want to build the various samples.

config CONFIG_C_SAMPLES
    bool "axssl - C version"
    default y
    depends on CONFIG_SAMPLES
    help
        Build the "C" version of axssl. The features enabled are very
        dependent on the build mode ('full' mode will give all features).

config CONFIG_CSHARP_SAMPLES
    bool "axssl - C# version"
    default y
    depends on CONFIG_SAMPLES && CONFIG_CSHARP_BINDINGS
    help
        Build the "C#" version of axssl. The features enabled are very
        dependent on the build mode ('full' mode will give all features).

config CONFIG_VBNET_SAMPLES
    bool "axssl - VB.NET version"
    default y
    depends on CONFIG_SAMPLES && CONFIG_VBNET_BINDINGS
    help
        Build the "VB.NET" version of axssl. The features enabled are very
        dependent on the build mode ('full' mode will give all features).

config CONFIG_JAVA_SAMPLES
    bool "axssl - Java version"
    default y
    depends on CONFIG_SAMPLES && CONFIG_JAVA_BINDINGS
    help
        Build the "Java" version of axssl. The features enabled are very
        dependent on the build mode ('full' mode will give all features).

config CONFIG_PERL_SAMPLES
    bool "axssl - Perl version"
    default y
    depends on CONFIG_SAMPLES && CONFIG_PERL_BINDINGS
    help
        Build the "Perl" version of axssl. The features enabled are very
        dependent on the build mode ('full' mode will give all features).

config CONFIG_LUA_SAMPLES
    bool "axssl - Lua version"
    default y
    depends on CONFIG_SAMPLES && CONFIG_LUA_BINDINGS
    help
        Build the "Lua" version of axssl. The features enabled are very
        dependent on the build mode ('full' mode will give all features).
endmenu
```
