## customfeeds/packages/libs/afalg_engine/Config.in
```kconfig
if PACKAGE_libopenssl-afalg_sync
    comment "Build Options"

    config AFALG_DIGESTS
	bool "Build support for digest acceleration"
	help
	    Digests are fast in software, and accessing AF_ALG adds latency, so
	    you'll need a large request (16KB) just to match software speed.
	    This increases memory usage, and has problems when process fork
	    with open digest contexts (openssh will not work because of it).

    config AFALG_FALLBACK
	bool "Enable software fallback feature"
	default y
	help
	    Use software to fulfill small requests.  Using AF_ALG adds latency,
	    which makes it slow to perform small requests.  Enabling this
	    option overcomes this problem, at the cost of increased memory
	    and CPU usage.  This is a new, experimental feature; if you
	    encounter any problem, this is the first option to disable.
	    The fallback will fail if you enable this engine alongside
	    devcrypto, so you'll not be able to install both at the same
	    time if this option is enabled.

    config AFALG_UPDATE_CTR_IV
	bool "Don't rely on kernel to update CTR IV"
	default y
	help
	    Don't count on the kernel driver to update the CTR-mode counter
	    (IV).  At least one driver does not update the IV as a workaround
	    for DMA issues.  With this option turned on, the engine will keep
	    track of the counter, and the IV will be sent with every update.
	    If fallback is enabled, then the counter needs to be updated by
	    the engine anyway, and sent with the request everytime there's a
	    switch from software to hardware, so this won't bring much gain in
	    that case.

    config AFALG_ZERO_COPY
	bool "Use Zero-Copy Mode"
	help
	    Uses a Zero-Copy interface.  Even though it is supposed to improve
	    performance, actual measurements indicate otherwise.
endif
```

## customfeeds/packages/libs/getdns/Config.in
```kconfig
menu "Configuration"
	depends on PACKAGE_getdns

config GETDNS_ENABLE_STUB_ONLY
	bool "GETDNS_ENABLE_STUB_ONLY"
	help
		getdns can be configured for stub resolution mode only. (Removes libunbound dependency)
	default y
	
config GETDNS_ENABLE_IDN_LIBIDN2
	bool "GETDNS_ENABLE_IDN_LIBIDN2"
	help 
		getdns can be configured with some IDN Support. (Requires libidn2 dependency)
	default n

endmenu
```

## customfeeds/packages/libs/gnutls/Config.in
```kconfig
# gnutls avanced configuration

menu "Configuration"
	depends on PACKAGE_libgnutls

config GNUTLS_DTLS_SRTP
	bool "enable DTLS SRTP support"
	default y

config GNUTLS_ALPN
	bool "enable ALPN support"
	default y

config GNUTLS_OCSP
	bool "enable ocsp support"
	default y

config GNUTLS_CRYPTODEV
	bool "enable /dev/crypto support"
	default n

config GNUTLS_HEARTBEAT
	bool "enable DTLS heartbeat support"
	default y

config GNUTLS_SRP
	bool "enable SRP authentication support"
	default n

config GNUTLS_PSK
	bool "enable PSK authentication support"
	default y

config GNUTLS_ANON
	bool "enable anonymous authentication support"
	default y

config GNUTLS_TPM
	bool "enable tpm support"
	select GNUTLS_PKCS11
	default n

config GNUTLS_PKCS11
	bool "enable smart card (PKCS11) support"
	select GNUTLS_EXT_LIBTASN1
	default n

config GNUTLS_EXT_LIBTASN1
	bool "use external libtasn1"
	default n

endmenu
```

## customfeeds/packages/libs/libdrm/Config.in
```kconfig
menu "Select libdrm build options"
		depends on PACKAGE_libdrm

config LIBDRM_INTEL
	bool "Intel support"
	default n
	depends on x86_64 || i386
	help
		Installs the Intel driver.

config LIBDRM_NOUVEAU
	bool "Nouveau support"
	default n
	help
		Installs the Nouveau driver.

config LIBDRM_RADEON
	bool "Radeon support"
	default n
	help
		Installs the Radeon driver.

endmenu
```

## customfeeds/packages/libs/libdvbcsa/Config.in
```kconfig
config LIBDVBCSA_DEBUG
	bool "Enable debugging"
	default n

config LIBDVBCSA_MMX
	bool "Use MMX for bitslice"
	depends on (!LIBDVBCSA_SSE2 && (x86_64 || i386))
	default n

config LIBDVBCSA_SSE2
	bool "Use SSE2 for bitslice"
	depends on (x86_64 || i386)
	default y

config LIBDVBCSA_ALTIVEC
	bool "Use AltiVec for bitslice"
	depends on (BROKEN && (powerpc || powerpc64))
	default y

config LIBDVBCSA_NEON
	bool "Use ARM NEON for bitslice"
	depends on (arm || aarch64)
	default y if aarch64
```

## customfeeds/packages/libs/liblz4/Config.in
```kconfig
config LZ4_OPTIMIZE_SPEED
	bool "Optimize for speed"
	depends on PACKAGE_liblz4
	help
		This enables additional optimization and
		increases performance considerably at
		the expense of binary size.
```

## customfeeds/packages/libs/libpqxx/Config.in
```kconfig
menu "Options"
	 depends on PACKAGE_libpqxx

config LIBPQXX_STATIC
    bool "Build static library"
	default y
	help
		Build static (.a) library

config LIBPQXX_SHARED
    bool "Build and install shared library"
	default n
	help
		Build and install shared (.so) library

config LIBPQXX_INSTALL_TEST
    bool "Build and install test suite"
	default n
	depends on LIBPQXX_STATIC || LIBPQXX_SHARED
	help
		Build and install a test suite against a real server.
		One can run this suite on a target platform to ensure
		that the library is built the way it should and operating
		correctly.

endmenu
```

## customfeeds/packages/libs/libqmi/Config.in
```kconfig
menu "Configuration"
	depends on PACKAGE_libqmi

config LIBQMI_WITH_MBIM_QMUX
	bool "Include MBIM QMUX service support"
	default y
	help
	  Compile libqmi with QMI-over-MBIM support

config LIBQMI_WITH_QRTR_GLIB
	bool "Include QRTR support"
	default y
	help
	  Compile libqmi with QRTR support

endmenu
```

## customfeeds/packages/libs/libradcli/Config.in
```kconfig
# radcli avanced configuration

menu "Configuration"
	depends on PACKAGE_libradcli

config RADCLI_TLS
	bool "enable TLS support"
	default y

endmenu
```

## customfeeds/packages/libs/libstrophe/Config.in
```kconfig
choice
	depends on PACKAGE_libstrophe
	prompt "Select XML library"
	default libstrophe-expat

config libstrophe-expat
	bool "expat"
	select PACKAGE_libexpat

config libstrophe-libxml2
	bool "libxml2"
	select PACKAGE_libxml2

endchoice
```

## customfeeds/packages/libs/libtins/Config.in
```kconfig
# libtins configuration
menu "Configuration"
	depends on PACKAGE_libtins

config LIBTINS_ENABLE_ACK_TRACKER
	bool "Enable ACK tracker"
	default n

config LIBTINS_ENABLE_CXX11
	bool "Enable C++11"
	default y

config LIBTINS_ENABLE_DOT11
	bool "Enable IEEE 802.11 support (select this to access ENABLE_WPA2 option)"
	help
		If selected, this also allows configuring WPA2 support which requires openssl
	default n

config LIBTINS_ENABLE_PCAP
	bool "Enable PCAP library support"
	default y

config LIBTINS_ENABLE_TCP_STREAM_CUSTOM_DATA
	bool "Enable TCP stream custom data"
	default n

config LIBTINS_ENABLE_WPA2
	depends on LIBTINS_ENABLE_DOT11
	bool "Enable WPA2 (this selects libopenssl)"
	default n
endmenu
```

## customfeeds/packages/libs/pcre2/Config.in
```kconfig
config PCRE2_JIT_ENABLED
	bool
	depends on PACKAGE_libpcre2 && (aarch64 || aarch64_be || arm || i386 || i686 || x86_64 || mips || mipsel || mips64 || mips64el || powerpc || powerpc64 || powerpcle || sparc)
	default y if (arm || i686 || x86_64)
	prompt "Enable JIT compiler support"
	help
		Enable JIT (Just-In-Time) compiler support.

		Just-in-time compiling is a heavyweight optimization that can greatly
		speed up pattern matching. However, it comes at the cost of extra
		processing before the match is performed, so it is of most benefit when
		the same pattern is going to be matched many times. This does not
		necessarily mean many calls of a matching function; if the pattern is
		not anchored, matching attempts may take place many times at various
		positions in the subject, even for a single call. Therefore, if the
		subject string is very long, it may still pay to use JIT even for
		one-off matches. JIT support is available for all of the 8-bit, 16-bit
		and 32-bit PCRE2 libraries and adds about 100KB to the resulting
		libpcre2.so. JIT support applies only to the traditional Perl-compatible
		matching function. It does not apply when the DFA matching function is
		being used.

		Enabling this option can give an about 10x performance increase on JIT
		operations. It can be desireable for e.g. high performance Apache
		mod_rewrite or HA-Proxy reqrep operations.

		However, JIT should _only_ be enabled on architectures that are supported.
		Enabling JIT on unsupported platforms will result in a compilation
		failure. A list of supported architectures can be found here:
		https://pcre.org/current/doc/html/pcre2jit.html#SEC2
```

## customfeeds/packages/mail/dovecot/Config.in
```kconfig
menu "Select dovecot build options"
		depends on PACKAGE_dovecot

config DOVECOT_GSSAPI
	bool "GSSAPI support"
	default n
	help
		Implements GSSAPI support in dovecot.

config DOVECOT_LDAP
	bool "LDAP support"
	default n
	help
		Implements LDAP support in dovecot.

config DOVECOT_MYSQL
	bool "MYSQL support"
	default n
	help
		Implements MYSQL support in dovecot.

config DOVECOT_PGSQL
	bool "PostgreSQL support"
	default n
	help
		Implements PostgreSQL support in dovecot.

config DOVECOT_SQLITE
	bool "SQLite support"
	default n
	help
		Implements SQLite DB support in dovecot.

config DOVECOT_ICU
bool "Enable i18n features"
	default n
	help
		Enable ICU (International Components for Unicode) support.

endmenu
```

## customfeeds/packages/mail/fdm/Config.in
```kconfig
menu "Configuration"
	depends on PACKAGE_fdm

config FDM_WITH_PCRE
	bool
	default y
	select libpcre
	prompt "Enable PCRE support (elsewhere POSIX regex)"

endmenu
```
